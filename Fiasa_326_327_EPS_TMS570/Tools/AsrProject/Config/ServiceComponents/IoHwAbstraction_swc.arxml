AUTOSAR XML (schema 301)
package /ComponentType
  ecu abstraction component type IoHwAbstraction
    13 x provide port:
      EpsEn: provided-interface=EpsEn
      PwrSwitchEn: provided-interface=PwrSwitchEn
      FetDrvCntl: provided-interface=FetDrvCntl
      FetFlt2Clk: provided-interface=FetFlt2Clk
      FetFlt1Data: provided-interface=FetFlt1Data
      SysFault2: provided-interface=SysFault2
      WdMonitor: provided-interface=WdMonitor
      FetDrvReset: provided-interface=FetDrvReset
      WdReset: provided-interface=WdReset
      TODReset: provided-interface=TODReset
      OvrVoltFdbk: provided-interface=OvrVoltFdbk
      IoHwAbPortConfig: provided-interface=IoHwAbPortConfig
      SysFault3: provided-interface=SysFault3
  internal behavior IoHwAbstractionBehave: component=IoHwAbstraction
    17 x operation invoked event:
      TREpsEn: start-on-event=IoHwAb_GetEpsEn, operation=EpsEn.OP_GET
      TRPwrSwitchEn: start-on-event=IoHwAb_GetPwrSwitchEn, operation=PwrSwitchEn.OP_GET
      TRFetDrvCntl: start-on-event=IoHwAb_GetFetDrvCntl, operation=FetDrvCntl.OP_GET
      TWFetFlt2Clk: start-on-event=IoHwAb_SetFetFlt2Clk, operation=FetFlt2Clk.OP_SET
      TRFetFlt2Clk: start-on-event=IoHwAb_GetFetFlt2Clk, operation=FetFlt2Clk.OP_GET
      TRFetFlt1Data: start-on-event=IoHwAb_GetFetFlt1Data, operation=FetFlt1Data.OP_GET
      TWSysFault2: start-on-event=IoHwAb_SetSysFault2, operation=SysFault2.OP_SET
      TRSysFault2: start-on-event=IoHwAb_GetSysFault2, operation=SysFault2.OP_GET
      TWWdMonitor: start-on-event=IoHwAb_SetWdMonitor, operation=WdMonitor.OP_SET
      TWFetDrvReset: start-on-event=IoHwAb_SetFetDrvReset, operation=FetDrvReset.OP_SET
      TRFetDrvReset: start-on-event=IoHwAb_GetFetDrvReset, operation=FetDrvReset.OP_GET
      TWWdReset: start-on-event=IoHwAb_SetWdReset, operation=WdReset.OP_SET
      TWTODReset: start-on-event=IoHwAb_SetTODReset, operation=TODReset.OP_SET
      TROvrVoltFdbk: start-on-event=IoHwAb_GetOvrVoltFdbk, operation=OvrVoltFdbk.OP_GET
      TRSetFetFlt2ToOutput: start-on-event=IoHwAb_SetFetFlt2ToOutput, operation=IoHwAbPortConfig.SetFetFlt2ToOutput
      TROP_GET: start-on-event=IoHwAb_OP_GET, operation=SysFault3.OP_GET
      TROP_SET: start-on-event=IoHwAb_OP_SET, operation=SysFault3.OP_SET
    17 x runnable, all with can-be-invoked-concurrently=true:
      IoHwAb_GetEpsEn
      IoHwAb_GetPwrSwitchEn
      IoHwAb_GetFetDrvCntl
      IoHwAb_GetFetFlt2Clk
      IoHwAb_SetFetFlt2Clk
      IoHwAb_GetFetFlt1Data
      IoHwAb_GetSysFault2
      IoHwAb_SetSysFault2
      IoHwAb_SetWdMonitor
      IoHwAb_GetFetDrvReset
      IoHwAb_SetFetDrvReset
      IoHwAb_SetWdReset
      IoHwAb_SetTODReset
      IoHwAb_GetOvrVoltFdbk
      IoHwAb_SetFetFlt2ToOutput: symbol=IoHwAb_OutputSetFetFlt2ToOutput
      IoHwAb_OP_GET: symbol=IoHwAb_InputOP_GET
      IoHwAb_OP_SET: symbol=IoHwAb_OutputOP_SET
  swc implementation IoHwAbstractionImpl: behavior=IoHwAbstractionBehave
package /PortInterface
  13 x client server interface:
    EpsEn
      operation OP_GET: possible-error=EpsEn/E_NOT_OK
        arg signal: type=IoHwAb_BoolType, direction=OUT
      error E_NOT_OK: error-code=1
    PwrSwitchEn
      operation OP_GET: possible-error=PwrSwitchEn/E_NOT_OK
        arg signal: type=IoHwAb_BoolType, direction=OUT
      error E_NOT_OK: error-code=1
    FetDrvCntl
      operation OP_GET: possible-error=FetDrvCntl/E_NOT_OK
        arg signal: type=IoHwAb_BoolType, direction=OUT
      error E_NOT_OK: error-code=1
    FetFlt2Clk
      operation OP_SET: possible-error=FetFlt2Clk/E_NOT_OK
        arg signal: type=IoHwAb_BoolType, direction=IN
      operation OP_GET: possible-error=FetFlt2Clk/E_NOT_OK
        arg signal: type=IoHwAb_BoolType, direction=OUT
      error E_NOT_OK: error-code=1
    FetFlt1Data
      operation OP_GET: possible-error=FetFlt1Data/E_NOT_OK
        arg signal: type=IoHwAb_BoolType, direction=OUT
      error E_NOT_OK: error-code=1
    SysFault2
      operation OP_SET: possible-error=SysFault2/E_NOT_OK
        arg signal: type=IoHwAb_BoolType, direction=IN
      operation OP_GET: possible-error=SysFault2/E_NOT_OK
        arg signal: type=IoHwAb_BoolType, direction=OUT
      error E_NOT_OK: error-code=1
    WdMonitor
      operation OP_SET: possible-error=WdMonitor/E_NOT_OK
        arg signal: type=IoHwAb_BoolType, direction=IN
      error E_NOT_OK: error-code=1
    FetDrvReset
      operation OP_SET: possible-error=FetDrvReset/E_NOT_OK
        arg signal: type=IoHwAb_BoolType, direction=IN
      operation OP_GET: possible-error=FetDrvReset/E_NOT_OK
        arg signal: type=IoHwAb_BoolType, direction=OUT
      error E_NOT_OK: error-code=1
    WdReset
      operation OP_SET: possible-error=WdReset/E_NOT_OK
        arg signal: type=IoHwAb_BoolType, direction=IN
      error E_NOT_OK: error-code=1
    TODReset
      operation OP_SET: possible-error=TODReset/E_NOT_OK
        arg signal: type=IoHwAb_BoolType, direction=IN
      error E_NOT_OK: error-code=1
    OvrVoltFdbk
      operation OP_GET: possible-error=OvrVoltFdbk/E_NOT_OK
        arg signal: type=IoHwAb_BoolType, direction=OUT
      error E_NOT_OK: error-code=1
    IoHwAbPortConfig
      operation SetFetFlt2ToOutput: possible-error=IoHwAbPortConfig/E_NOT_OK
        arg signal: type=IoHwAb_BoolType, direction=IN
      error E_NOT_OK: error-code=1
    SysFault3
      operation OP_GET: possible-error=SysFault3/E_NOT_OK
        arg signal: type=IoHwAb_BoolType, direction=OUT
      operation OP_SET: possible-error=SysFault3/E_NOT_OK
        arg signal: type=IoHwAb_BoolType, direction=IN
      error E_NOT_OK: error-code=1
package /DataType
  8 x integer type, all with lower-limit=0:
    IoHwAb_BoolType: upper-limit=1
    IoHwAb_DiscreteGroupType: upper-limit=255
    IoHwAb_CurrentType: upper-limit=65535
    IoHwAb_VoltageType: upper-limit=65535
    IoHwAb_ResistanceType: upper-limit=65535
    IoHwAb_SignalDiagnosisType: upper-limit=65535
    IoHwAb_PwxPeriodType: upper-limit=65535
    IoHwAb_PwxDutyCycleType: upper-limit=65535
