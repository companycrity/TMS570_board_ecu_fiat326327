AUTOSAR XML (schema 3.2.1)
standard types defined: UInt8
package /ComponentType
  service component type EcuM: category=ServiceComponent
  swc implementation EcuMImpl: behavior=EcuMBehave
  internal behavior EcuMBehave: component=EcuM
    timing event TMT_EcuM_MainFunction: start-on-event=EcuM_MainFunction, period=0.01
    runnable EcuM_MainFunction
