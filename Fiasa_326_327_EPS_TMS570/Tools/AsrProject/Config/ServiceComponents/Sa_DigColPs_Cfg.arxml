AUTOSAR XML (schema 321)
package /ComponentType
  sensor actuator software component type Sa_DigColPs
  internal behavior Sa_DigColPs_InternalBehavior: component=Sa_DigColPs
  swc implementation Sa_DigColPs_Implementation: behavior=Sa_DigColPs_InternalBehavior
    code-descriptors:
      code Code: type=SRC
package /PortInterface
  client server interface WdgM_CheckpointReached: is-service=true
    operation CheckpointReached: possible-error=E_NOT_OK  # Indicates to the Watchdog Manager that a Checkpoint within a Supervised Entity has been reached.
    error E_NOT_OK: error-code=1
