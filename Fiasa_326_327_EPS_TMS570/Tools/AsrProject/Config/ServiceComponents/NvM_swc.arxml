AUTOSAR XML (schema 3.0.1)
standard types defined: Boolean, UInt8
package /ComponentType
  service component type NvM: category=ServiceComponent  # Software Component description for NvM generated from Ecuc Package: ActiveEcuC
    124 x provide port:
      PS_Rte_NvmBlock_Polarity_Polarity_Cnt_Str: provided-interface=NvM_AC3_SRBS_Srv  # PPort_Rte_NvmBlock_Polarity_Polarity_Cnt_Str : NvM_AC3_SRBS_Srv | P-Port Prototype of NvM_AC3_SRBS_Srv for NVRAM Block Rte_NvmBlock_Polarity_Polarity_Cnt_Str
      PS_NVM_BLOCK_DIAGMGR_NTCSTRG: provided-interface=NvM_AC3_SRBS_Srv  # PPort_NVM_BLOCK_DIAGMGR_NTCSTRG : NvM_AC3_SRBS_Srv | P-Port Prototype of NvM_AC3_SRBS_Srv for NVRAM Block NVM_BLOCK_DIAGMGR_NTCSTRG
      PS_NVM_BLOCK_EPSDEFEATS: provided-interface=NvM_AC3_SRBS_Srv  # PPort_NVM_BLOCK_EPSDEFEATS : NvM_AC3_SRBS_Srv | P-Port Prototype of NvM_AC3_SRBS_Srv for NVRAM Block NVM_BLOCK_EPSDEFEATS
      PS_NvM_NVM_BLOCK_DEM: provided-interface=NvM_AC3_SRBS_Srv  # PPort_NvM_NVM_BLOCK_DEM : NvM_AC3_SRBS_Srv | P-Port Prototype of NvM_AC3_SRBS_Srv for NVRAM Block NvM_NVM_BLOCK_DEM
      PS_Rte_NvmBlock_StaMd_TypeHRamBuffer: provided-interface=NvM_AC3_SRBS_Srv  # PPort_Rte_NvmBlock_StaMd_TypeHRamBuffer : NvM_AC3_SRBS_Srv | P-Port Prototype of NvM_AC3_SRBS_Srv for NVRAM Block Rte_NvmBlock_StaMd_TypeHRamBuffer
      PS_Deprecated_NvmBlock_TrqCmdScl_TorqueCmdSF_Uls_f32: provided-interface=NvM_AC3_SRBS_Srv  # PPort_Deprecated_NvmBlock_TrqCmdScl_TorqueCmdSF_Uls_f32 : NvM_AC3_SRBS_Srv | P-Port Prototype of NvM_AC3_SRBS_Srv for NVRAM Block Deprecated_NvmBlock_TrqCmdScl_TorqueCmdSF_Uls_f32
      PS_Deprecated_NvmBlock_CmMtrCurr_CurrTempOffset: provided-interface=NvM_AC3_SRBS_Srv  # PPort_Deprecated_NvmBlock_CmMtrCurr_CurrTempOffset : NvM_AC3_SRBS_Srv | P-Port Prototype of NvM_AC3_SRBS_Srv for NVRAM Block Deprecated_NvmBlock_CmMtrCurr_CurrTempOffset
      PS_Deprecated_NvmBlock_CmMtrCurr_ShCurrCal: provided-interface=NvM_AC3_SRBS_Srv  # PPort_Deprecated_NvmBlock_CmMtrCurr_ShCurrCal : NvM_AC3_SRBS_Srv | P-Port Prototype of NvM_AC3_SRBS_Srv for NVRAM Block Deprecated_NvmBlock_CmMtrCurr_ShCurrCal
      PS_Rte_NvmBlock_CurrParamComp_EOLNomMtrParam: provided-interface=NvM_AC3_SRBS_Srv  # PPort_Rte_NvmBlock_CurrParamComp_EOLNomMtrParam : NvM_AC3_SRBS_Srv | P-Port Prototype of NvM_AC3_SRBS_Srv for NVRAM Block Rte_NvmBlock_CurrParamComp_EOLNomMtrParam
      PS_Deprecated_NvmBlock_LrnEOT_LearnedEOT: provided-interface=NvM_AC3_SRBS_Srv  # PPort_Deprecated_NvmBlock_LrnEOT_LearnedEOT : NvM_AC3_SRBS_Srv | P-Port Prototype of NvM_AC3_SRBS_Srv for NVRAM Block Deprecated_NvmBlock_LrnEOT_LearnedEOT
      PS_Deprecated_NvmBlock_TrqCanc_CogTrqCal: provided-interface=NvM_AC3_SRBS_Srv  # PPort_Deprecated_NvmBlock_TrqCanc_CogTrqCal : NvM_AC3_SRBS_Srv | P-Port Prototype of NvM_AC3_SRBS_Srv for NVRAM Block Deprecated_NvmBlock_TrqCanc_CogTrqCal
      PS_NVM_BLOCK_CMS_NXTRMEC: provided-interface=NvM_AC3_SRBS_Srv  # PPort_NVM_BLOCK_CMS_NXTRMEC : NvM_AC3_SRBS_Srv | P-Port Prototype of NvM_AC3_SRBS_Srv for NVRAM Block NVM_BLOCK_CMS_NXTRMEC
      PS_NVM_BLOCK_CMS_ECUSRLNUM: provided-interface=NvM_AC3_SRBS_Srv  # PPort_NVM_BLOCK_CMS_ECUSRLNUM : NvM_AC3_SRBS_Srv | P-Port Prototype of NvM_AC3_SRBS_Srv for NVRAM Block NVM_BLOCK_CMS_ECUSRLNUM
      PS_NVM_BLOCK_CMS_EPSSRLNUM: provided-interface=NvM_AC3_SRBS_Srv  # PPort_NVM_BLOCK_CMS_EPSSRLNUM : NvM_AC3_SRBS_Srv | P-Port Prototype of NvM_AC3_SRBS_Srv for NVRAM Block NVM_BLOCK_CMS_EPSSRLNUM
      PS_NVM_BLOCK_CMS_ECUHWPN: provided-interface=NvM_AC3_SRBS_Srv  # PPort_NVM_BLOCK_CMS_ECUHWPN : NvM_AC3_SRBS_Srv | P-Port Prototype of NvM_AC3_SRBS_Srv for NVRAM Block NVM_BLOCK_CMS_ECUHWPN
      PS_NVM_BLOCK_CMS_NXTRMANUFSCRATCHPAD: provided-interface=NvM_AC3_SRBS_Srv  # PPort_NVM_BLOCK_CMS_NXTRMANUFSCRATCHPAD : NvM_AC3_SRBS_Srv | P-Port Prototype of NvM_AC3_SRBS_Srv for NVRAM Block NVM_BLOCK_CMS_NXTRMANUFSCRATCHPAD
      PS_NVM_BLOCK_CMS_IGNCNTR: provided-interface=NvM_AC3_SRBS_Srv  # PPort_NVM_BLOCK_CMS_IGNCNTR : NvM_AC3_SRBS_Srv | P-Port Prototype of NvM_AC3_SRBS_Srv for NVRAM Block NVM_BLOCK_CMS_IGNCNTR
      PS_Rte_NvmBlock_StaMd_CloseCheckData: provided-interface=NvM_AC3_SRBS_Srv  # PPort_Rte_NvmBlock_StaMd_CloseCheckData : NvM_AC3_SRBS_Srv | P-Port Prototype of NvM_AC3_SRBS_Srv for NVRAM Block Rte_NvmBlock_StaMd_CloseCheckData
      PS_NVM_BLOCK_DIAGMGR_BLACKBOX: provided-interface=NvM_AC3_SRBS_Srv  # PPort_NVM_BLOCK_DIAGMGR_BLACKBOX : NvM_AC3_SRBS_Srv | P-Port Prototype of NvM_AC3_SRBS_Srv for NVRAM Block NVM_BLOCK_DIAGMGR_BLACKBOX
      PS_Deprecated_NvmBlock_AvgFricLrn_AvgFricLrnData: provided-interface=NvM_AC3_SRBS_Srv  # PPort_Deprecated_NvmBlock_AvgFricLrn_AvgFricLrnData : NvM_AC3_SRBS_Srv | P-Port Prototype of NvM_AC3_SRBS_Srv for NVRAM Block Deprecated_NvmBlock_AvgFricLrn_AvgFricLrnData
      PS_Rte_NvmBlock_BatteryVoltage_OvervoltageData: provided-interface=NvM_AC3_SRBS_Srv  # PPort_Rte_NvmBlock_BatteryVoltage_OvervoltageData : NvM_AC3_SRBS_Srv | P-Port Prototype of NvM_AC3_SRBS_Srv for NVRAM Block Rte_NvmBlock_BatteryVoltage_OvervoltageData
      PS_Rte_NvmBlock_DigMSB_DigMSBEOLData: provided-interface=NvM_AC3_SRBS_Srv  # PPort_Rte_NvmBlock_DigMSB_DigMSBEOLData : NvM_AC3_SRBS_Srv | P-Port Prototype of NvM_AC3_SRBS_Srv for NVRAM Block Rte_NvmBlock_DigMSB_DigMSBEOLData
      PS_Deprecated_NvmBlock_DigHwTrqSENT_DigTrqTrim: provided-interface=NvM_AC3_SRBS_Srv  # PPort_Deprecated_NvmBlock_DigHwTrqSENT_DigTrqTrim : NvM_AC3_SRBS_Srv | P-Port Prototype of NvM_AC3_SRBS_Srv for NVRAM Block Deprecated_NvmBlock_DigHwTrqSENT_DigTrqTrim
      PS_Deprecated_NvmBlock_AbsHwPos_EOLVehCntrOffset: provided-interface=NvM_AC3_SRBS_Srv  # PPort_Deprecated_NvmBlock_AbsHwPos_EOLVehCntrOffset : NvM_AC3_SRBS_Srv | P-Port Prototype of NvM_AC3_SRBS_Srv for NVRAM Block Deprecated_NvmBlock_AbsHwPos_EOLVehCntrOffset
      PS_Rte_NvmBlock_DiagSvc_TuningSetSelectData: provided-interface=NvM_AC3_SRBS_Srv  # PPort_Rte_NvmBlock_DiagSvc_TuningSetSelectData : NvM_AC3_SRBS_Srv | P-Port Prototype of NvM_AC3_SRBS_Srv for NVRAM Block Rte_NvmBlock_DiagSvc_TuningSetSelectData
      PS_Deprecated_NvmBlock_AbsHwPos_EOLVehCntrOffset1: provided-interface=NvM_AC3_SRBS_Srv  # PPort_Deprecated_NvmBlock_AbsHwPos_EOLVehCntrOffset1 : NvM_AC3_SRBS_Srv | P-Port Prototype of NvM_AC3_SRBS_Srv for NVRAM Block Deprecated_NvmBlock_AbsHwPos_EOLVehCntrOffset1
      PS_Deprecated_NvmBlock_TrqCanc_CogTrqRplComp: provided-interface=NvM_AC3_SRBS_Srv  # PPort_Deprecated_NvmBlock_TrqCanc_CogTrqRplComp : NvM_AC3_SRBS_Srv | P-Port Prototype of NvM_AC3_SRBS_Srv for NVRAM Block Deprecated_NvmBlock_TrqCanc_CogTrqRplComp
      PS_Deprecated_NvmBlock_AstLmt_SteerAsstDefeat: provided-interface=NvM_AC3_SRBS_Srv  # PPort_Deprecated_NvmBlock_AstLmt_SteerAsstDefeat : NvM_AC3_SRBS_Srv | P-Port Prototype of NvM_AC3_SRBS_Srv for NVRAM Block Deprecated_NvmBlock_AstLmt_SteerAsstDefeat
      PS_Rte_NvmBlock_ThrmlDutyCycle_ThrmlDutyCycle_FltStVal: provided-interface=NvM_AC3_SRBS_Srv  # PPort_Rte_NvmBlock_ThrmlDutyCycle_ThrmlDutyCycle_FltStVal : NvM_AC3_SRBS_Srv | P-Port Prototype of NvM_AC3_SRBS_Srv for NVRAM Block Rte_NvmBlock_ThrmlDutyCycle_ThrmlDutyCycle_FltStVal
      PS_NVM_BLOCK_DIAGMGR_LATCHCNTRS: provided-interface=NvM_AC3_SRBS_Srv  # PPort_NVM_BLOCK_DIAGMGR_LATCHCNTRS : NvM_AC3_SRBS_Srv | P-Port Prototype of NvM_AC3_SRBS_Srv for NVRAM Block NVM_BLOCK_DIAGMGR_LATCHCNTRS
      PS_Rte_NvmBlock_LrnEOT_LearnedEOT: provided-interface=NvM_AC3_SRBS_Srv_Defs  # PPort_Rte_NvmBlock_LrnEOT_LearnedEOT : NvM_AC3_SRBS_Srv_Defs | P-Port Prototype of NvM_AC3_SRBS_Srv_Defs for NVRAM Block Rte_NvmBlock_LrnEOT_LearnedEOT
      PS_Rte_NvmBlock_AvgFricLrn_AvgFricLrnData: provided-interface=NvM_AC3_SRBS_Srv_Defs  # PPort_Rte_NvmBlock_AvgFricLrn_AvgFricLrnData : NvM_AC3_SRBS_Srv_Defs | P-Port Prototype of NvM_AC3_SRBS_Srv_Defs for NVRAM Block Rte_NvmBlock_AvgFricLrn_AvgFricLrnData
      PS_Rte_NvmBlock_DigHwTrqSENT_DigTrqTrim: provided-interface=NvM_AC3_SRBS_Srv  # PPort_Rte_NvmBlock_DigHwTrqSENT_DigTrqTrim : NvM_AC3_SRBS_Srv | P-Port Prototype of NvM_AC3_SRBS_Srv for NVRAM Block Rte_NvmBlock_DigHwTrqSENT_DigTrqTrim
      PS_Rte_NvmBlock_CmMtrCurr_CurrTempOffset: provided-interface=NvM_AC3_SRBS_Srv  # PPort_Rte_NvmBlock_CmMtrCurr_CurrTempOffset : NvM_AC3_SRBS_Srv | P-Port Prototype of NvM_AC3_SRBS_Srv for NVRAM Block Rte_NvmBlock_CmMtrCurr_CurrTempOffset
      PS_Rte_NvmBlock_CmMtrCurr_ShCurrCal: provided-interface=NvM_AC3_SRBS_Srv  # PPort_Rte_NvmBlock_CmMtrCurr_ShCurrCal : NvM_AC3_SRBS_Srv | P-Port Prototype of NvM_AC3_SRBS_Srv for NVRAM Block Rte_NvmBlock_CmMtrCurr_ShCurrCal
      PS_Rte_NvmBlock_TrqCanc_CogTrqCal: provided-interface=NvM_AC3_SRBS_Srv  # PPort_Rte_NvmBlock_TrqCanc_CogTrqCal : NvM_AC3_SRBS_Srv | P-Port Prototype of NvM_AC3_SRBS_Srv for NVRAM Block Rte_NvmBlock_TrqCanc_CogTrqCal
      PS_Rte_NvmBlock_TrqCanc_CogTrqRplComp: provided-interface=NvM_AC3_SRBS_Srv  # PPort_Rte_NvmBlock_TrqCanc_CogTrqRplComp : NvM_AC3_SRBS_Srv | P-Port Prototype of NvM_AC3_SRBS_Srv for NVRAM Block Rte_NvmBlock_TrqCanc_CogTrqRplComp
      PS_Rte_NvmBlock_AstLmt_SteerAsstDefeat: provided-interface=NvM_AC3_SRBS_Srv  # PPort_Rte_NvmBlock_AstLmt_SteerAsstDefeat : NvM_AC3_SRBS_Srv | P-Port Prototype of NvM_AC3_SRBS_Srv for NVRAM Block Rte_NvmBlock_AstLmt_SteerAsstDefeat
      PS_Rte_NvmBlock_TrqCmdScl_TorqueCmdSF_Uls_f32: provided-interface=NvM_AC3_SRBS_Srv  # PPort_Rte_NvmBlock_TrqCmdScl_TorqueCmdSF_Uls_f32 : NvM_AC3_SRBS_Srv | P-Port Prototype of NvM_AC3_SRBS_Srv for NVRAM Block Rte_NvmBlock_TrqCmdScl_TorqueCmdSF_Uls_f32
      PS_Rte_NvmBlock_AbsHwPos_EOLVehCntrOffset: provided-interface=NvM_AC3_SRBS_Srv  # PPort_Rte_NvmBlock_AbsHwPos_EOLVehCntrOffset : NvM_AC3_SRBS_Srv | P-Port Prototype of NvM_AC3_SRBS_Srv for NVRAM Block Rte_NvmBlock_AbsHwPos_EOLVehCntrOffset
      PS_Rte_NvmBlock_VehDyn_MotPosReset: provided-interface=NvM_AC3_SRBS_Srv  # PPort_Rte_NvmBlock_VehDyn_MotPosReset : NvM_AC3_SRBS_Srv | P-Port Prototype of NvM_AC3_SRBS_Srv for NVRAM Block Rte_NvmBlock_VehDyn_MotPosReset
      PS_Rte_NvmBlock_DiagSvc_BootSwFingerPrint: provided-interface=NvM_AC3_SRBS_Srv  # PPort_Rte_NvmBlock_DiagSvc_BootSwFingerPrint : NvM_AC3_SRBS_Srv | P-Port Prototype of NvM_AC3_SRBS_Srv for NVRAM Block Rte_NvmBlock_DiagSvc_BootSwFingerPrint
      PS_Rte_NvmBlock_DiagSvc_AppSwFingerPrint: provided-interface=NvM_AC3_SRBS_Srv  # PPort_Rte_NvmBlock_DiagSvc_AppSwFingerPrint : NvM_AC3_SRBS_Srv | P-Port Prototype of NvM_AC3_SRBS_Srv for NVRAM Block Rte_NvmBlock_DiagSvc_AppSwFingerPrint
      PS_Rte_NvmBlock_DiagSvc_ECUSparePartNo: provided-interface=NvM_AC3_SRBS_Srv  # PPort_Rte_NvmBlock_DiagSvc_ECUSparePartNo : NvM_AC3_SRBS_Srv | P-Port Prototype of NvM_AC3_SRBS_Srv for NVRAM Block Rte_NvmBlock_DiagSvc_ECUSparePartNo
      PS_Rte_NvmBlock_DiagSvc_VINCurrent: provided-interface=NvM_AC3_SRBS_Srv  # PPort_Rte_NvmBlock_DiagSvc_VINCurrent : NvM_AC3_SRBS_Srv | P-Port Prototype of NvM_AC3_SRBS_Srv for NVRAM Block Rte_NvmBlock_DiagSvc_VINCurrent
      PS_Rte_NvmBlock_DiagSvc_EraseRoutineStatus: provided-interface=NvM_AC3_SRBS_Srv  # PPort_Rte_NvmBlock_DiagSvc_EraseRoutineStatus : NvM_AC3_SRBS_Srv | P-Port Prototype of NvM_AC3_SRBS_Srv for NVRAM Block Rte_NvmBlock_DiagSvc_EraseRoutineStatus
      PS_Rte_NvmBlock_DiagSvc_ProgrammingStatus: provided-interface=NvM_AC3_SRBS_Srv  # PPort_Rte_NvmBlock_DiagSvc_ProgrammingStatus : NvM_AC3_SRBS_Srv | P-Port Prototype of NvM_AC3_SRBS_Srv for NVRAM Block Rte_NvmBlock_DiagSvc_ProgrammingStatus
      PS_Rte_NvmBlock_Sa_DigColPs_DigColPsEOL: provided-interface=NvM_AC3_SRBS_Srv  # PPort_Rte_NvmBlock_Sa_DigColPs_DigColPsEOL : NvM_AC3_SRBS_Srv | P-Port Prototype of NvM_AC3_SRBS_Srv for NVRAM Block Rte_NvmBlock_Sa_DigColPs_DigColPsEOL
      PS_Deprecated_Rte_NvmBlock_DiagSvc_ProxiConfigurationData: provided-interface=NvM_AC3_SRBS_Srv  # PPort_Deprecated_Rte_NvmBlock_DiagSvc_ProxiConfigurationData : NvM_AC3_SRBS_Srv | P-Port Prototype of NvM_AC3_SRBS_Srv for NVRAM Block Deprecated_Rte_NvmBlock_DiagSvc_ProxiConfigurationData
      PS_Rte_NvmBlock_DiagSvc_ProxiConfigurationData: provided-interface=NvM_AC3_SRBS_Srv  # PPort_Rte_NvmBlock_DiagSvc_ProxiConfigurationData : NvM_AC3_SRBS_Srv | P-Port Prototype of NvM_AC3_SRBS_Srv for NVRAM Block Rte_NvmBlock_DiagSvc_ProxiConfigurationData
      PS_Rte_NvmBlock_DiagSvc_ProxiCounter: provided-interface=NvM_AC3_SRBS_Srv  # PPort_Rte_NvmBlock_DiagSvc_ProxiCounter : NvM_AC3_SRBS_Srv | P-Port Prototype of NvM_AC3_SRBS_Srv for NVRAM Block Rte_NvmBlock_DiagSvc_ProxiCounter
      PS_Rte_NvmBlock_DiagSvc_CalSwFingerPrint: provided-interface=NvM_AC3_SRBS_Srv  # PPort_Rte_NvmBlock_DiagSvc_CalSwFingerPrint : NvM_AC3_SRBS_Srv | P-Port Prototype of NvM_AC3_SRBS_Srv for NVRAM Block Rte_NvmBlock_DiagSvc_CalSwFingerPrint
      PS_Rte_NvmBlock_DiagSvc_ECULifeTimeMins: provided-interface=NvM_AC3_SRBS_Srv  # PPort_Rte_NvmBlock_DiagSvc_ECULifeTimeMins : NvM_AC3_SRBS_Srv | P-Port Prototype of NvM_AC3_SRBS_Srv for NVRAM Block Rte_NvmBlock_DiagSvc_ECULifeTimeMins
      PS_Rte_NvmBlock_DiagSvc_FirstDTCDetectMins: provided-interface=NvM_AC3_SRBS_Srv  # PPort_Rte_NvmBlock_DiagSvc_FirstDTCDetectMins : NvM_AC3_SRBS_Srv | P-Port Prototype of NvM_AC3_SRBS_Srv for NVRAM Block Rte_NvmBlock_DiagSvc_FirstDTCDetectMins
      PS_Rte_NvmBlock_DiagSvc_FirstDTCDetectSecs: provided-interface=NvM_AC3_SRBS_Srv  # PPort_Rte_NvmBlock_DiagSvc_FirstDTCDetectSecs : NvM_AC3_SRBS_Srv | P-Port Prototype of NvM_AC3_SRBS_Srv for NVRAM Block Rte_NvmBlock_DiagSvc_FirstDTCDetectSecs
      PS_Rte_NvmBlock_DiagSvc_EOLConfigData: provided-interface=NvM_AC3_SRBS_Srv  # PPort_Rte_NvmBlock_DiagSvc_EOLConfigData : NvM_AC3_SRBS_Srv | P-Port Prototype of NvM_AC3_SRBS_Srv for NVRAM Block Rte_NvmBlock_DiagSvc_EOLConfigData
      PS_Rte_NvmBlock_DiagSvc_ProgAttemptsCounter: provided-interface=NvM_AC3_SRBS_Srv  # PPort_Rte_NvmBlock_DiagSvc_ProgAttemptsCounter : NvM_AC3_SRBS_Srv | P-Port Prototype of NvM_AC3_SRBS_Srv for NVRAM Block Rte_NvmBlock_DiagSvc_ProgAttemptsCounter
      PS_Rte_NvmBlock_DiagSvc_VINOriginal: provided-interface=NvM_AC3_SRBS_Srv  # PPort_Rte_NvmBlock_DiagSvc_VINOriginal : NvM_AC3_SRBS_Srv | P-Port Prototype of NvM_AC3_SRBS_Srv for NVRAM Block Rte_NvmBlock_DiagSvc_VINOriginal
      PS_Rte_NvmBlock_DiagSvc_ECUSerialNumber: provided-interface=NvM_AC3_SRBS_Srv  # PPort_Rte_NvmBlock_DiagSvc_ECUSerialNumber : NvM_AC3_SRBS_Srv | P-Port Prototype of NvM_AC3_SRBS_Srv for NVRAM Block Rte_NvmBlock_DiagSvc_ECUSerialNumber
      PS_Rte_NvmBlock_DiagSvc_TotalOdometer: provided-interface=NvM_AC3_SRBS_Srv  # PPort_Rte_NvmBlock_DiagSvc_TotalOdometer : NvM_AC3_SRBS_Srv | P-Port Prototype of NvM_AC3_SRBS_Srv for NVRAM Block Rte_NvmBlock_DiagSvc_TotalOdometer
      PS_Rte_NvmBlock_DiagSvc_OdometerFlashProg: provided-interface=NvM_AC3_SRBS_Srv  # PPort_Rte_NvmBlock_DiagSvc_OdometerFlashProg : NvM_AC3_SRBS_Srv | P-Port Prototype of NvM_AC3_SRBS_Srv for NVRAM Block Rte_NvmBlock_DiagSvc_OdometerFlashProg
      PS_ConfigBlock: provided-interface=NvM_AC3_SRBS_Srv  # PPort_ConfigBlock : NvM_AC3_SRBS_Srv | P-Port Prototype of NvM_AC3_SRBS_Srv for NVRAM Block ConfigBlock
      PAdmin_Rte_NvmBlock_Polarity_Polarity_Cnt_Str: provided-interface=NvM_Administration  # PPort_Rte_NvmBlock_Polarity_Polarity_Cnt_Str : NvM_Administration | P-Port Prototype of NvM_Administration for NVRAM Block Rte_NvmBlock_Polarity_Polarity_Cnt_Str
      PAdmin_NVM_BLOCK_DIAGMGR_NTCSTRG: provided-interface=NvM_Administration  # PPort_NVM_BLOCK_DIAGMGR_NTCSTRG : NvM_Administration | P-Port Prototype of NvM_Administration for NVRAM Block NVM_BLOCK_DIAGMGR_NTCSTRG
      PAdmin_NVM_BLOCK_EPSDEFEATS: provided-interface=NvM_Administration  # PPort_NVM_BLOCK_EPSDEFEATS : NvM_Administration | P-Port Prototype of NvM_Administration for NVRAM Block NVM_BLOCK_EPSDEFEATS
      PAdmin_NvM_NVM_BLOCK_DEM: provided-interface=NvM_Administration  # PPort_NvM_NVM_BLOCK_DEM : NvM_Administration | P-Port Prototype of NvM_Administration for NVRAM Block NvM_NVM_BLOCK_DEM
      PAdmin_Rte_NvmBlock_StaMd_TypeHRamBuffer: provided-interface=NvM_Administration  # PPort_Rte_NvmBlock_StaMd_TypeHRamBuffer : NvM_Administration | P-Port Prototype of NvM_Administration for NVRAM Block Rte_NvmBlock_StaMd_TypeHRamBuffer
      PAdmin_Deprecated_NvmBlock_TrqCmdScl_TorqueCmdSF_Uls_f32: provided-interface=NvM_Administration  # PPort_Deprecated_NvmBlock_TrqCmdScl_TorqueCmdSF_Uls_f32 : NvM_Administration | P-Port Prototype of NvM_Administration for NVRAM Block Deprecated_NvmBlock_TrqCmdScl_TorqueCmdSF_Uls_f32
      PAdmin_Deprecated_NvmBlock_CmMtrCurr_CurrTempOffset: provided-interface=NvM_Administration  # PPort_Deprecated_NvmBlock_CmMtrCurr_CurrTempOffset : NvM_Administration | P-Port Prototype of NvM_Administration for NVRAM Block Deprecated_NvmBlock_CmMtrCurr_CurrTempOffset
      PAdmin_Deprecated_NvmBlock_CmMtrCurr_ShCurrCal: provided-interface=NvM_Administration  # PPort_Deprecated_NvmBlock_CmMtrCurr_ShCurrCal : NvM_Administration | P-Port Prototype of NvM_Administration for NVRAM Block Deprecated_NvmBlock_CmMtrCurr_ShCurrCal
      PAdmin_Rte_NvmBlock_CurrParamComp_EOLNomMtrParam: provided-interface=NvM_Administration  # PPort_Rte_NvmBlock_CurrParamComp_EOLNomMtrParam : NvM_Administration | P-Port Prototype of NvM_Administration for NVRAM Block Rte_NvmBlock_CurrParamComp_EOLNomMtrParam
      PAdmin_Deprecated_NvmBlock_LrnEOT_LearnedEOT: provided-interface=NvM_Administration  # PPort_Deprecated_NvmBlock_LrnEOT_LearnedEOT : NvM_Administration | P-Port Prototype of NvM_Administration for NVRAM Block Deprecated_NvmBlock_LrnEOT_LearnedEOT
      PAdmin_Deprecated_NvmBlock_TrqCanc_CogTrqCal: provided-interface=NvM_Administration  # PPort_Deprecated_NvmBlock_TrqCanc_CogTrqCal : NvM_Administration | P-Port Prototype of NvM_Administration for NVRAM Block Deprecated_NvmBlock_TrqCanc_CogTrqCal
      PAdmin_NVM_BLOCK_CMS_NXTRMEC: provided-interface=NvM_Administration  # PPort_NVM_BLOCK_CMS_NXTRMEC : NvM_Administration | P-Port Prototype of NvM_Administration for NVRAM Block NVM_BLOCK_CMS_NXTRMEC
      PAdmin_NVM_BLOCK_CMS_ECUSRLNUM: provided-interface=NvM_Administration  # PPort_NVM_BLOCK_CMS_ECUSRLNUM : NvM_Administration | P-Port Prototype of NvM_Administration for NVRAM Block NVM_BLOCK_CMS_ECUSRLNUM
      PAdmin_NVM_BLOCK_CMS_EPSSRLNUM: provided-interface=NvM_Administration  # PPort_NVM_BLOCK_CMS_EPSSRLNUM : NvM_Administration | P-Port Prototype of NvM_Administration for NVRAM Block NVM_BLOCK_CMS_EPSSRLNUM
      PAdmin_NVM_BLOCK_CMS_ECUHWPN: provided-interface=NvM_Administration  # PPort_NVM_BLOCK_CMS_ECUHWPN : NvM_Administration | P-Port Prototype of NvM_Administration for NVRAM Block NVM_BLOCK_CMS_ECUHWPN
      PAdmin_NVM_BLOCK_CMS_NXTRMANUFSCRATCHPAD: provided-interface=NvM_Administration  # PPort_NVM_BLOCK_CMS_NXTRMANUFSCRATCHPAD : NvM_Administration | P-Port Prototype of NvM_Administration for NVRAM Block NVM_BLOCK_CMS_NXTRMANUFSCRATCHPAD
      PAdmin_NVM_BLOCK_CMS_IGNCNTR: provided-interface=NvM_Administration  # PPort_NVM_BLOCK_CMS_IGNCNTR : NvM_Administration | P-Port Prototype of NvM_Administration for NVRAM Block NVM_BLOCK_CMS_IGNCNTR
      PAdmin_Rte_NvmBlock_StaMd_CloseCheckData: provided-interface=NvM_Administration  # PPort_Rte_NvmBlock_StaMd_CloseCheckData : NvM_Administration | P-Port Prototype of NvM_Administration for NVRAM Block Rte_NvmBlock_StaMd_CloseCheckData
      PAdmin_NVM_BLOCK_DIAGMGR_BLACKBOX: provided-interface=NvM_Administration  # PPort_NVM_BLOCK_DIAGMGR_BLACKBOX : NvM_Administration | P-Port Prototype of NvM_Administration for NVRAM Block NVM_BLOCK_DIAGMGR_BLACKBOX
      PAdmin_Deprecated_NvmBlock_AvgFricLrn_AvgFricLrnData: provided-interface=NvM_Administration  # PPort_Deprecated_NvmBlock_AvgFricLrn_AvgFricLrnData : NvM_Administration | P-Port Prototype of NvM_Administration for NVRAM Block Deprecated_NvmBlock_AvgFricLrn_AvgFricLrnData
      PAdmin_Rte_NvmBlock_BatteryVoltage_OvervoltageData: provided-interface=NvM_Administration  # PPort_Rte_NvmBlock_BatteryVoltage_OvervoltageData : NvM_Administration | P-Port Prototype of NvM_Administration for NVRAM Block Rte_NvmBlock_BatteryVoltage_OvervoltageData
      PAdmin_Rte_NvmBlock_DigMSB_DigMSBEOLData: provided-interface=NvM_Administration  # PPort_Rte_NvmBlock_DigMSB_DigMSBEOLData : NvM_Administration | P-Port Prototype of NvM_Administration for NVRAM Block Rte_NvmBlock_DigMSB_DigMSBEOLData
      PAdmin_Deprecated_NvmBlock_DigHwTrqSENT_DigTrqTrim: provided-interface=NvM_Administration  # PPort_Deprecated_NvmBlock_DigHwTrqSENT_DigTrqTrim : NvM_Administration | P-Port Prototype of NvM_Administration for NVRAM Block Deprecated_NvmBlock_DigHwTrqSENT_DigTrqTrim
      PAdmin_Deprecated_NvmBlock_AbsHwPos_EOLVehCntrOffset: provided-interface=NvM_Administration  # PPort_Deprecated_NvmBlock_AbsHwPos_EOLVehCntrOffset : NvM_Administration | P-Port Prototype of NvM_Administration for NVRAM Block Deprecated_NvmBlock_AbsHwPos_EOLVehCntrOffset
      PAdmin_Rte_NvmBlock_DiagSvc_TuningSetSelectData: provided-interface=NvM_Administration  # PPort_Rte_NvmBlock_DiagSvc_TuningSetSelectData : NvM_Administration | P-Port Prototype of NvM_Administration for NVRAM Block Rte_NvmBlock_DiagSvc_TuningSetSelectData
      PAdmin_Deprecated_NvmBlock_AbsHwPos_EOLVehCntrOffset1: provided-interface=NvM_Administration  # PPort_Deprecated_NvmBlock_AbsHwPos_EOLVehCntrOffset1 : NvM_Administration | P-Port Prototype of NvM_Administration for NVRAM Block Deprecated_NvmBlock_AbsHwPos_EOLVehCntrOffset1
      PAdmin_Deprecated_NvmBlock_TrqCanc_CogTrqRplComp: provided-interface=NvM_Administration  # PPort_Deprecated_NvmBlock_TrqCanc_CogTrqRplComp : NvM_Administration | P-Port Prototype of NvM_Administration for NVRAM Block Deprecated_NvmBlock_TrqCanc_CogTrqRplComp
      PAdmin_Deprecated_NvmBlock_AstLmt_SteerAsstDefeat: provided-interface=NvM_Administration  # PPort_Deprecated_NvmBlock_AstLmt_SteerAsstDefeat : NvM_Administration | P-Port Prototype of NvM_Administration for NVRAM Block Deprecated_NvmBlock_AstLmt_SteerAsstDefeat
      PAdmin_Rte_NvmBlock_ThrmlDutyCycle_ThrmlDutyCycle_FltStVal: provided-interface=NvM_Administration  # PPort_Rte_NvmBlock_ThrmlDutyCycle_ThrmlDutyCycle_FltStVal : NvM_Administration | P-Port Prototype of NvM_Administration for NVRAM Block Rte_NvmBlock_ThrmlDutyCycle_ThrmlDutyCycle_FltStVal
      PAdmin_NVM_BLOCK_DIAGMGR_LATCHCNTRS: provided-interface=NvM_Administration  # PPort_NVM_BLOCK_DIAGMGR_LATCHCNTRS : NvM_Administration | P-Port Prototype of NvM_Administration for NVRAM Block NVM_BLOCK_DIAGMGR_LATCHCNTRS
      PAdmin_Rte_NvmBlock_LrnEOT_LearnedEOT: provided-interface=NvM_Administration  # PPort_Rte_NvmBlock_LrnEOT_LearnedEOT : NvM_Administration | P-Port Prototype of NvM_Administration for NVRAM Block Rte_NvmBlock_LrnEOT_LearnedEOT
      PAdmin_Rte_NvmBlock_AvgFricLrn_AvgFricLrnData: provided-interface=NvM_Administration  # PPort_Rte_NvmBlock_AvgFricLrn_AvgFricLrnData : NvM_Administration | P-Port Prototype of NvM_Administration for NVRAM Block Rte_NvmBlock_AvgFricLrn_AvgFricLrnData
      PAdmin_Rte_NvmBlock_DigHwTrqSENT_DigTrqTrim: provided-interface=NvM_Administration  # PPort_Rte_NvmBlock_DigHwTrqSENT_DigTrqTrim : NvM_Administration | P-Port Prototype of NvM_Administration for NVRAM Block Rte_NvmBlock_DigHwTrqSENT_DigTrqTrim
      PAdmin_Rte_NvmBlock_CmMtrCurr_CurrTempOffset: provided-interface=NvM_Administration  # PPort_Rte_NvmBlock_CmMtrCurr_CurrTempOffset : NvM_Administration | P-Port Prototype of NvM_Administration for NVRAM Block Rte_NvmBlock_CmMtrCurr_CurrTempOffset
      PAdmin_Rte_NvmBlock_CmMtrCurr_ShCurrCal: provided-interface=NvM_Administration  # PPort_Rte_NvmBlock_CmMtrCurr_ShCurrCal : NvM_Administration | P-Port Prototype of NvM_Administration for NVRAM Block Rte_NvmBlock_CmMtrCurr_ShCurrCal
      PAdmin_Rte_NvmBlock_TrqCanc_CogTrqCal: provided-interface=NvM_Administration  # PPort_Rte_NvmBlock_TrqCanc_CogTrqCal : NvM_Administration | P-Port Prototype of NvM_Administration for NVRAM Block Rte_NvmBlock_TrqCanc_CogTrqCal
      PAdmin_Rte_NvmBlock_TrqCanc_CogTrqRplComp: provided-interface=NvM_Administration  # PPort_Rte_NvmBlock_TrqCanc_CogTrqRplComp : NvM_Administration | P-Port Prototype of NvM_Administration for NVRAM Block Rte_NvmBlock_TrqCanc_CogTrqRplComp
      PAdmin_Rte_NvmBlock_AstLmt_SteerAsstDefeat: provided-interface=NvM_Administration  # PPort_Rte_NvmBlock_AstLmt_SteerAsstDefeat : NvM_Administration | P-Port Prototype of NvM_Administration for NVRAM Block Rte_NvmBlock_AstLmt_SteerAsstDefeat
      PAdmin_Rte_NvmBlock_TrqCmdScl_TorqueCmdSF_Uls_f32: provided-interface=NvM_Administration  # PPort_Rte_NvmBlock_TrqCmdScl_TorqueCmdSF_Uls_f32 : NvM_Administration | P-Port Prototype of NvM_Administration for NVRAM Block Rte_NvmBlock_TrqCmdScl_TorqueCmdSF_Uls_f32
      PAdmin_Rte_NvmBlock_AbsHwPos_EOLVehCntrOffset: provided-interface=NvM_Administration  # PPort_Rte_NvmBlock_AbsHwPos_EOLVehCntrOffset : NvM_Administration | P-Port Prototype of NvM_Administration for NVRAM Block Rte_NvmBlock_AbsHwPos_EOLVehCntrOffset
      PAdmin_Rte_NvmBlock_VehDyn_MotPosReset: provided-interface=NvM_Administration  # PPort_Rte_NvmBlock_VehDyn_MotPosReset : NvM_Administration | P-Port Prototype of NvM_Administration for NVRAM Block Rte_NvmBlock_VehDyn_MotPosReset
      PAdmin_Rte_NvmBlock_DiagSvc_BootSwFingerPrint: provided-interface=NvM_Administration  # PPort_Rte_NvmBlock_DiagSvc_BootSwFingerPrint : NvM_Administration | P-Port Prototype of NvM_Administration for NVRAM Block Rte_NvmBlock_DiagSvc_BootSwFingerPrint
      PAdmin_Rte_NvmBlock_DiagSvc_AppSwFingerPrint: provided-interface=NvM_Administration  # PPort_Rte_NvmBlock_DiagSvc_AppSwFingerPrint : NvM_Administration | P-Port Prototype of NvM_Administration for NVRAM Block Rte_NvmBlock_DiagSvc_AppSwFingerPrint
      PAdmin_Rte_NvmBlock_DiagSvc_ECUSparePartNo: provided-interface=NvM_Administration  # PPort_Rte_NvmBlock_DiagSvc_ECUSparePartNo : NvM_Administration | P-Port Prototype of NvM_Administration for NVRAM Block Rte_NvmBlock_DiagSvc_ECUSparePartNo
      PAdmin_Rte_NvmBlock_DiagSvc_VINCurrent: provided-interface=NvM_Administration  # PPort_Rte_NvmBlock_DiagSvc_VINCurrent : NvM_Administration | P-Port Prototype of NvM_Administration for NVRAM Block Rte_NvmBlock_DiagSvc_VINCurrent
      PAdmin_Rte_NvmBlock_DiagSvc_EraseRoutineStatus: provided-interface=NvM_Administration  # PPort_Rte_NvmBlock_DiagSvc_EraseRoutineStatus : NvM_Administration | P-Port Prototype of NvM_Administration for NVRAM Block Rte_NvmBlock_DiagSvc_EraseRoutineStatus
      PAdmin_Rte_NvmBlock_DiagSvc_ProgrammingStatus: provided-interface=NvM_Administration  # PPort_Rte_NvmBlock_DiagSvc_ProgrammingStatus : NvM_Administration | P-Port Prototype of NvM_Administration for NVRAM Block Rte_NvmBlock_DiagSvc_ProgrammingStatus
      PAdmin_Rte_NvmBlock_Sa_DigColPs_DigColPsEOL: provided-interface=NvM_Administration  # PPort_Rte_NvmBlock_Sa_DigColPs_DigColPsEOL : NvM_Administration | P-Port Prototype of NvM_Administration for NVRAM Block Rte_NvmBlock_Sa_DigColPs_DigColPsEOL
      PAdmin_Deprecated_Rte_NvmBlock_DiagSvc_ProxiConfigurationData: provided-interface=NvM_Administration  # PPort_Deprecated_Rte_NvmBlock_DiagSvc_ProxiConfigurationData : NvM_Administration | P-Port Prototype of NvM_Administration for NVRAM Block Deprecated_Rte_NvmBlock_DiagSvc_ProxiConfigurationData
      PAdmin_Rte_NvmBlock_DiagSvc_ProxiConfigurationData: provided-interface=NvM_Administration  # PPort_Rte_NvmBlock_DiagSvc_ProxiConfigurationData : NvM_Administration | P-Port Prototype of NvM_Administration for NVRAM Block Rte_NvmBlock_DiagSvc_ProxiConfigurationData
      PAdmin_Rte_NvmBlock_DiagSvc_ProxiCounter: provided-interface=NvM_Administration  # PPort_Rte_NvmBlock_DiagSvc_ProxiCounter : NvM_Administration | P-Port Prototype of NvM_Administration for NVRAM Block Rte_NvmBlock_DiagSvc_ProxiCounter
      PAdmin_Rte_NvmBlock_DiagSvc_CalSwFingerPrint: provided-interface=NvM_Administration  # PPort_Rte_NvmBlock_DiagSvc_CalSwFingerPrint : NvM_Administration | P-Port Prototype of NvM_Administration for NVRAM Block Rte_NvmBlock_DiagSvc_CalSwFingerPrint
      PAdmin_Rte_NvmBlock_DiagSvc_ECULifeTimeMins: provided-interface=NvM_Administration  # PPort_Rte_NvmBlock_DiagSvc_ECULifeTimeMins : NvM_Administration | P-Port Prototype of NvM_Administration for NVRAM Block Rte_NvmBlock_DiagSvc_ECULifeTimeMins
      PAdmin_Rte_NvmBlock_DiagSvc_FirstDTCDetectMins: provided-interface=NvM_Administration  # PPort_Rte_NvmBlock_DiagSvc_FirstDTCDetectMins : NvM_Administration | P-Port Prototype of NvM_Administration for NVRAM Block Rte_NvmBlock_DiagSvc_FirstDTCDetectMins
      PAdmin_Rte_NvmBlock_DiagSvc_FirstDTCDetectSecs: provided-interface=NvM_Administration  # PPort_Rte_NvmBlock_DiagSvc_FirstDTCDetectSecs : NvM_Administration | P-Port Prototype of NvM_Administration for NVRAM Block Rte_NvmBlock_DiagSvc_FirstDTCDetectSecs
      PAdmin_Rte_NvmBlock_DiagSvc_EOLConfigData: provided-interface=NvM_Administration  # PPort_Rte_NvmBlock_DiagSvc_EOLConfigData : NvM_Administration | P-Port Prototype of NvM_Administration for NVRAM Block Rte_NvmBlock_DiagSvc_EOLConfigData
      PAdmin_Rte_NvmBlock_DiagSvc_ProgAttemptsCounter: provided-interface=NvM_Administration  # PPort_Rte_NvmBlock_DiagSvc_ProgAttemptsCounter : NvM_Administration | P-Port Prototype of NvM_Administration for NVRAM Block Rte_NvmBlock_DiagSvc_ProgAttemptsCounter
      PAdmin_Rte_NvmBlock_DiagSvc_VINOriginal: provided-interface=NvM_Administration  # PPort_Rte_NvmBlock_DiagSvc_VINOriginal : NvM_Administration | P-Port Prototype of NvM_Administration for NVRAM Block Rte_NvmBlock_DiagSvc_VINOriginal
      PAdmin_Rte_NvmBlock_DiagSvc_ECUSerialNumber: provided-interface=NvM_Administration  # PPort_Rte_NvmBlock_DiagSvc_ECUSerialNumber : NvM_Administration | P-Port Prototype of NvM_Administration for NVRAM Block Rte_NvmBlock_DiagSvc_ECUSerialNumber
      PAdmin_Rte_NvmBlock_DiagSvc_TotalOdometer: provided-interface=NvM_Administration  # PPort_Rte_NvmBlock_DiagSvc_TotalOdometer : NvM_Administration | P-Port Prototype of NvM_Administration for NVRAM Block Rte_NvmBlock_DiagSvc_TotalOdometer
      PAdmin_Rte_NvmBlock_DiagSvc_OdometerFlashProg: provided-interface=NvM_Administration  # PPort_Rte_NvmBlock_DiagSvc_OdometerFlashProg : NvM_Administration | P-Port Prototype of NvM_Administration for NVRAM Block Rte_NvmBlock_DiagSvc_OdometerFlashProg
      PAdmin_ConfigBlock: provided-interface=NvM_Administration  # PPort_ConfigBlock : NvM_Administration | P-Port Prototype of NvM_Administration for NVRAM Block ConfigBlock
  swc implementation NvM_Impl: behavior=NvM_Behavior
  internal behavior NvM_Behavior: component=NvM
    436 x operation invoked event:
      V_2_GetErrorStatus: start-on-event=GetErrorStatus, operation=PS_Rte_NvmBlock_Polarity_Polarity_Cnt_Str.GetErrorStatus
      V_2_SetRamBlockStatus: start-on-event=SetRamBlockStatus, operation=PS_Rte_NvmBlock_Polarity_Polarity_Cnt_Str.SetRamBlockStatus
      V_2_ReadBlock: start-on-event=ReadBlock, operation=PS_Rte_NvmBlock_Polarity_Polarity_Cnt_Str.ReadBlock
      V_2_WriteBlock: start-on-event=WriteBlock, operation=PS_Rte_NvmBlock_Polarity_Polarity_Cnt_Str.WriteBlock
      V_2_InvalidateNvBlock: start-on-event=InvalidateNvBlock, operation=PS_Rte_NvmBlock_Polarity_Polarity_Cnt_Str.InvalidateNvBlock
      V_2_EraseBlock: start-on-event=EraseBlock, operation=PS_Rte_NvmBlock_Polarity_Polarity_Cnt_Str.EraseBlock
      V_2_SetBlockProtection: start-on-event=SetBlockProtection, operation=PAdmin_Rte_NvmBlock_Polarity_Polarity_Cnt_Str.SetBlockProtection
      V_3_GetErrorStatus: start-on-event=GetErrorStatus, operation=PS_NVM_BLOCK_DIAGMGR_NTCSTRG.GetErrorStatus
      V_3_SetRamBlockStatus: start-on-event=SetRamBlockStatus, operation=PS_NVM_BLOCK_DIAGMGR_NTCSTRG.SetRamBlockStatus
      V_3_ReadBlock: start-on-event=ReadBlock, operation=PS_NVM_BLOCK_DIAGMGR_NTCSTRG.ReadBlock
      V_3_WriteBlock: start-on-event=WriteBlock, operation=PS_NVM_BLOCK_DIAGMGR_NTCSTRG.WriteBlock
      V_3_InvalidateNvBlock: start-on-event=InvalidateNvBlock, operation=PS_NVM_BLOCK_DIAGMGR_NTCSTRG.InvalidateNvBlock
      V_3_EraseBlock: start-on-event=EraseBlock, operation=PS_NVM_BLOCK_DIAGMGR_NTCSTRG.EraseBlock
      V_3_SetBlockProtection: start-on-event=SetBlockProtection, operation=PAdmin_NVM_BLOCK_DIAGMGR_NTCSTRG.SetBlockProtection
      V_4_GetErrorStatus: start-on-event=GetErrorStatus, operation=PS_NVM_BLOCK_EPSDEFEATS.GetErrorStatus
      V_4_SetRamBlockStatus: start-on-event=SetRamBlockStatus, operation=PS_NVM_BLOCK_EPSDEFEATS.SetRamBlockStatus
      V_4_ReadBlock: start-on-event=ReadBlock, operation=PS_NVM_BLOCK_EPSDEFEATS.ReadBlock
      V_4_WriteBlock: start-on-event=WriteBlock, operation=PS_NVM_BLOCK_EPSDEFEATS.WriteBlock
      V_4_InvalidateNvBlock: start-on-event=InvalidateNvBlock, operation=PS_NVM_BLOCK_EPSDEFEATS.InvalidateNvBlock
      V_4_EraseBlock: start-on-event=EraseBlock, operation=PS_NVM_BLOCK_EPSDEFEATS.EraseBlock
      V_4_SetBlockProtection: start-on-event=SetBlockProtection, operation=PAdmin_NVM_BLOCK_EPSDEFEATS.SetBlockProtection
      V_5_GetErrorStatus: start-on-event=GetErrorStatus, operation=PS_NvM_NVM_BLOCK_DEM.GetErrorStatus
      V_5_SetRamBlockStatus: start-on-event=SetRamBlockStatus, operation=PS_NvM_NVM_BLOCK_DEM.SetRamBlockStatus
      V_5_ReadBlock: start-on-event=ReadBlock, operation=PS_NvM_NVM_BLOCK_DEM.ReadBlock
      V_5_WriteBlock: start-on-event=WriteBlock, operation=PS_NvM_NVM_BLOCK_DEM.WriteBlock
      V_5_InvalidateNvBlock: start-on-event=InvalidateNvBlock, operation=PS_NvM_NVM_BLOCK_DEM.InvalidateNvBlock
      V_5_EraseBlock: start-on-event=EraseBlock, operation=PS_NvM_NVM_BLOCK_DEM.EraseBlock
      V_5_SetBlockProtection: start-on-event=SetBlockProtection, operation=PAdmin_NvM_NVM_BLOCK_DEM.SetBlockProtection
      V_6_GetErrorStatus: start-on-event=GetErrorStatus, operation=PS_Rte_NvmBlock_StaMd_TypeHRamBuffer.GetErrorStatus
      V_6_SetRamBlockStatus: start-on-event=SetRamBlockStatus, operation=PS_Rte_NvmBlock_StaMd_TypeHRamBuffer.SetRamBlockStatus
      V_6_ReadBlock: start-on-event=ReadBlock, operation=PS_Rte_NvmBlock_StaMd_TypeHRamBuffer.ReadBlock
      V_6_WriteBlock: start-on-event=WriteBlock, operation=PS_Rte_NvmBlock_StaMd_TypeHRamBuffer.WriteBlock
      V_6_InvalidateNvBlock: start-on-event=InvalidateNvBlock, operation=PS_Rte_NvmBlock_StaMd_TypeHRamBuffer.InvalidateNvBlock
      V_6_EraseBlock: start-on-event=EraseBlock, operation=PS_Rte_NvmBlock_StaMd_TypeHRamBuffer.EraseBlock
      V_6_SetBlockProtection: start-on-event=SetBlockProtection, operation=PAdmin_Rte_NvmBlock_StaMd_TypeHRamBuffer.SetBlockProtection
      V_7_GetErrorStatus: start-on-event=GetErrorStatus, operation=PS_Deprecated_NvmBlock_TrqCmdScl_TorqueCmdSF_Uls_f32.GetErrorStatus
      V_7_SetRamBlockStatus: start-on-event=SetRamBlockStatus, operation=PS_Deprecated_NvmBlock_TrqCmdScl_TorqueCmdSF_Uls_f32.SetRamBlockStatus
      V_7_ReadBlock: start-on-event=ReadBlock, operation=PS_Deprecated_NvmBlock_TrqCmdScl_TorqueCmdSF_Uls_f32.ReadBlock
      V_7_WriteBlock: start-on-event=WriteBlock, operation=PS_Deprecated_NvmBlock_TrqCmdScl_TorqueCmdSF_Uls_f32.WriteBlock
      V_7_InvalidateNvBlock: start-on-event=InvalidateNvBlock, operation=PS_Deprecated_NvmBlock_TrqCmdScl_TorqueCmdSF_Uls_f32.InvalidateNvBlock
      V_7_EraseBlock: start-on-event=EraseBlock, operation=PS_Deprecated_NvmBlock_TrqCmdScl_TorqueCmdSF_Uls_f32.EraseBlock
      V_7_SetBlockProtection: start-on-event=SetBlockProtection, operation=PAdmin_Deprecated_NvmBlock_TrqCmdScl_TorqueCmdSF_Uls_f32.SetBlockProtection
      V_8_GetErrorStatus: start-on-event=GetErrorStatus, operation=PS_Deprecated_NvmBlock_CmMtrCurr_CurrTempOffset.GetErrorStatus
      V_8_SetRamBlockStatus: start-on-event=SetRamBlockStatus, operation=PS_Deprecated_NvmBlock_CmMtrCurr_CurrTempOffset.SetRamBlockStatus
      V_8_ReadBlock: start-on-event=ReadBlock, operation=PS_Deprecated_NvmBlock_CmMtrCurr_CurrTempOffset.ReadBlock
      V_8_WriteBlock: start-on-event=WriteBlock, operation=PS_Deprecated_NvmBlock_CmMtrCurr_CurrTempOffset.WriteBlock
      V_8_InvalidateNvBlock: start-on-event=InvalidateNvBlock, operation=PS_Deprecated_NvmBlock_CmMtrCurr_CurrTempOffset.InvalidateNvBlock
      V_8_EraseBlock: start-on-event=EraseBlock, operation=PS_Deprecated_NvmBlock_CmMtrCurr_CurrTempOffset.EraseBlock
      V_8_SetBlockProtection: start-on-event=SetBlockProtection, operation=PAdmin_Deprecated_NvmBlock_CmMtrCurr_CurrTempOffset.SetBlockProtection
      V_9_GetErrorStatus: start-on-event=GetErrorStatus, operation=PS_Deprecated_NvmBlock_CmMtrCurr_ShCurrCal.GetErrorStatus
      V_9_SetRamBlockStatus: start-on-event=SetRamBlockStatus, operation=PS_Deprecated_NvmBlock_CmMtrCurr_ShCurrCal.SetRamBlockStatus
      V_9_ReadBlock: start-on-event=ReadBlock, operation=PS_Deprecated_NvmBlock_CmMtrCurr_ShCurrCal.ReadBlock
      V_9_WriteBlock: start-on-event=WriteBlock, operation=PS_Deprecated_NvmBlock_CmMtrCurr_ShCurrCal.WriteBlock
      V_9_InvalidateNvBlock: start-on-event=InvalidateNvBlock, operation=PS_Deprecated_NvmBlock_CmMtrCurr_ShCurrCal.InvalidateNvBlock
      V_9_EraseBlock: start-on-event=EraseBlock, operation=PS_Deprecated_NvmBlock_CmMtrCurr_ShCurrCal.EraseBlock
      V_9_SetBlockProtection: start-on-event=SetBlockProtection, operation=PAdmin_Deprecated_NvmBlock_CmMtrCurr_ShCurrCal.SetBlockProtection
      V_10_GetErrorStatus: start-on-event=GetErrorStatus, operation=PS_Rte_NvmBlock_CurrParamComp_EOLNomMtrParam.GetErrorStatus
      V_10_SetRamBlockStatus: start-on-event=SetRamBlockStatus, operation=PS_Rte_NvmBlock_CurrParamComp_EOLNomMtrParam.SetRamBlockStatus
      V_10_ReadBlock: start-on-event=ReadBlock, operation=PS_Rte_NvmBlock_CurrParamComp_EOLNomMtrParam.ReadBlock
      V_10_WriteBlock: start-on-event=WriteBlock, operation=PS_Rte_NvmBlock_CurrParamComp_EOLNomMtrParam.WriteBlock
      V_10_InvalidateNvBlock: start-on-event=InvalidateNvBlock, operation=PS_Rte_NvmBlock_CurrParamComp_EOLNomMtrParam.InvalidateNvBlock
      V_10_EraseBlock: start-on-event=EraseBlock, operation=PS_Rte_NvmBlock_CurrParamComp_EOLNomMtrParam.EraseBlock
      V_10_SetBlockProtection: start-on-event=SetBlockProtection, operation=PAdmin_Rte_NvmBlock_CurrParamComp_EOLNomMtrParam.SetBlockProtection
      V_11_GetErrorStatus: start-on-event=GetErrorStatus, operation=PS_Deprecated_NvmBlock_LrnEOT_LearnedEOT.GetErrorStatus
      V_11_SetRamBlockStatus: start-on-event=SetRamBlockStatus, operation=PS_Deprecated_NvmBlock_LrnEOT_LearnedEOT.SetRamBlockStatus
      V_11_ReadBlock: start-on-event=ReadBlock, operation=PS_Deprecated_NvmBlock_LrnEOT_LearnedEOT.ReadBlock
      V_11_WriteBlock: start-on-event=WriteBlock, operation=PS_Deprecated_NvmBlock_LrnEOT_LearnedEOT.WriteBlock
      V_11_InvalidateNvBlock: start-on-event=InvalidateNvBlock, operation=PS_Deprecated_NvmBlock_LrnEOT_LearnedEOT.InvalidateNvBlock
      V_11_EraseBlock: start-on-event=EraseBlock, operation=PS_Deprecated_NvmBlock_LrnEOT_LearnedEOT.EraseBlock
      V_11_SetBlockProtection: start-on-event=SetBlockProtection, operation=PAdmin_Deprecated_NvmBlock_LrnEOT_LearnedEOT.SetBlockProtection
      V_12_GetErrorStatus: start-on-event=GetErrorStatus, operation=PS_Deprecated_NvmBlock_TrqCanc_CogTrqCal.GetErrorStatus
      V_12_SetRamBlockStatus: start-on-event=SetRamBlockStatus, operation=PS_Deprecated_NvmBlock_TrqCanc_CogTrqCal.SetRamBlockStatus
      V_12_ReadBlock: start-on-event=ReadBlock, operation=PS_Deprecated_NvmBlock_TrqCanc_CogTrqCal.ReadBlock
      V_12_WriteBlock: start-on-event=WriteBlock, operation=PS_Deprecated_NvmBlock_TrqCanc_CogTrqCal.WriteBlock
      V_12_InvalidateNvBlock: start-on-event=InvalidateNvBlock, operation=PS_Deprecated_NvmBlock_TrqCanc_CogTrqCal.InvalidateNvBlock
      V_12_EraseBlock: start-on-event=EraseBlock, operation=PS_Deprecated_NvmBlock_TrqCanc_CogTrqCal.EraseBlock
      V_12_SetBlockProtection: start-on-event=SetBlockProtection, operation=PAdmin_Deprecated_NvmBlock_TrqCanc_CogTrqCal.SetBlockProtection
      V_13_GetErrorStatus: start-on-event=GetErrorStatus, operation=PS_NVM_BLOCK_CMS_NXTRMEC.GetErrorStatus
      V_13_SetRamBlockStatus: start-on-event=SetRamBlockStatus, operation=PS_NVM_BLOCK_CMS_NXTRMEC.SetRamBlockStatus
      V_13_ReadBlock: start-on-event=ReadBlock, operation=PS_NVM_BLOCK_CMS_NXTRMEC.ReadBlock
      V_13_WriteBlock: start-on-event=WriteBlock, operation=PS_NVM_BLOCK_CMS_NXTRMEC.WriteBlock
      V_13_InvalidateNvBlock: start-on-event=InvalidateNvBlock, operation=PS_NVM_BLOCK_CMS_NXTRMEC.InvalidateNvBlock
      V_13_EraseBlock: start-on-event=EraseBlock, operation=PS_NVM_BLOCK_CMS_NXTRMEC.EraseBlock
      V_13_SetBlockProtection: start-on-event=SetBlockProtection, operation=PAdmin_NVM_BLOCK_CMS_NXTRMEC.SetBlockProtection
      V_14_GetErrorStatus: start-on-event=GetErrorStatus, operation=PS_NVM_BLOCK_CMS_ECUSRLNUM.GetErrorStatus
      V_14_SetRamBlockStatus: start-on-event=SetRamBlockStatus, operation=PS_NVM_BLOCK_CMS_ECUSRLNUM.SetRamBlockStatus
      V_14_ReadBlock: start-on-event=ReadBlock, operation=PS_NVM_BLOCK_CMS_ECUSRLNUM.ReadBlock
      V_14_WriteBlock: start-on-event=WriteBlock, operation=PS_NVM_BLOCK_CMS_ECUSRLNUM.WriteBlock
      V_14_InvalidateNvBlock: start-on-event=InvalidateNvBlock, operation=PS_NVM_BLOCK_CMS_ECUSRLNUM.InvalidateNvBlock
      V_14_EraseBlock: start-on-event=EraseBlock, operation=PS_NVM_BLOCK_CMS_ECUSRLNUM.EraseBlock
      V_14_SetBlockProtection: start-on-event=SetBlockProtection, operation=PAdmin_NVM_BLOCK_CMS_ECUSRLNUM.SetBlockProtection
      V_15_GetErrorStatus: start-on-event=GetErrorStatus, operation=PS_NVM_BLOCK_CMS_EPSSRLNUM.GetErrorStatus
      V_15_SetRamBlockStatus: start-on-event=SetRamBlockStatus, operation=PS_NVM_BLOCK_CMS_EPSSRLNUM.SetRamBlockStatus
      V_15_ReadBlock: start-on-event=ReadBlock, operation=PS_NVM_BLOCK_CMS_EPSSRLNUM.ReadBlock
      V_15_WriteBlock: start-on-event=WriteBlock, operation=PS_NVM_BLOCK_CMS_EPSSRLNUM.WriteBlock
      V_15_InvalidateNvBlock: start-on-event=InvalidateNvBlock, operation=PS_NVM_BLOCK_CMS_EPSSRLNUM.InvalidateNvBlock
      V_15_EraseBlock: start-on-event=EraseBlock, operation=PS_NVM_BLOCK_CMS_EPSSRLNUM.EraseBlock
      V_15_SetBlockProtection: start-on-event=SetBlockProtection, operation=PAdmin_NVM_BLOCK_CMS_EPSSRLNUM.SetBlockProtection
      V_16_GetErrorStatus: start-on-event=GetErrorStatus, operation=PS_NVM_BLOCK_CMS_ECUHWPN.GetErrorStatus
      V_16_SetRamBlockStatus: start-on-event=SetRamBlockStatus, operation=PS_NVM_BLOCK_CMS_ECUHWPN.SetRamBlockStatus
      V_16_ReadBlock: start-on-event=ReadBlock, operation=PS_NVM_BLOCK_CMS_ECUHWPN.ReadBlock
      V_16_WriteBlock: start-on-event=WriteBlock, operation=PS_NVM_BLOCK_CMS_ECUHWPN.WriteBlock
      V_16_InvalidateNvBlock: start-on-event=InvalidateNvBlock, operation=PS_NVM_BLOCK_CMS_ECUHWPN.InvalidateNvBlock
      V_16_EraseBlock: start-on-event=EraseBlock, operation=PS_NVM_BLOCK_CMS_ECUHWPN.EraseBlock
      V_16_SetBlockProtection: start-on-event=SetBlockProtection, operation=PAdmin_NVM_BLOCK_CMS_ECUHWPN.SetBlockProtection
      V_17_GetErrorStatus: start-on-event=GetErrorStatus, operation=PS_NVM_BLOCK_CMS_NXTRMANUFSCRATCHPAD.GetErrorStatus
      V_17_SetRamBlockStatus: start-on-event=SetRamBlockStatus, operation=PS_NVM_BLOCK_CMS_NXTRMANUFSCRATCHPAD.SetRamBlockStatus
      V_17_ReadBlock: start-on-event=ReadBlock, operation=PS_NVM_BLOCK_CMS_NXTRMANUFSCRATCHPAD.ReadBlock
      V_17_WriteBlock: start-on-event=WriteBlock, operation=PS_NVM_BLOCK_CMS_NXTRMANUFSCRATCHPAD.WriteBlock
      V_17_InvalidateNvBlock: start-on-event=InvalidateNvBlock, operation=PS_NVM_BLOCK_CMS_NXTRMANUFSCRATCHPAD.InvalidateNvBlock
      V_17_EraseBlock: start-on-event=EraseBlock, operation=PS_NVM_BLOCK_CMS_NXTRMANUFSCRATCHPAD.EraseBlock
      V_17_SetBlockProtection: start-on-event=SetBlockProtection, operation=PAdmin_NVM_BLOCK_CMS_NXTRMANUFSCRATCHPAD.SetBlockProtection
      V_18_GetErrorStatus: start-on-event=GetErrorStatus, operation=PS_NVM_BLOCK_CMS_IGNCNTR.GetErrorStatus
      V_18_SetRamBlockStatus: start-on-event=SetRamBlockStatus, operation=PS_NVM_BLOCK_CMS_IGNCNTR.SetRamBlockStatus
      V_18_ReadBlock: start-on-event=ReadBlock, operation=PS_NVM_BLOCK_CMS_IGNCNTR.ReadBlock
      V_18_WriteBlock: start-on-event=WriteBlock, operation=PS_NVM_BLOCK_CMS_IGNCNTR.WriteBlock
      V_18_InvalidateNvBlock: start-on-event=InvalidateNvBlock, operation=PS_NVM_BLOCK_CMS_IGNCNTR.InvalidateNvBlock
      V_18_EraseBlock: start-on-event=EraseBlock, operation=PS_NVM_BLOCK_CMS_IGNCNTR.EraseBlock
      V_18_SetBlockProtection: start-on-event=SetBlockProtection, operation=PAdmin_NVM_BLOCK_CMS_IGNCNTR.SetBlockProtection
      V_19_GetErrorStatus: start-on-event=GetErrorStatus, operation=PS_Rte_NvmBlock_StaMd_CloseCheckData.GetErrorStatus
      V_19_SetRamBlockStatus: start-on-event=SetRamBlockStatus, operation=PS_Rte_NvmBlock_StaMd_CloseCheckData.SetRamBlockStatus
      V_19_ReadBlock: start-on-event=ReadBlock, operation=PS_Rte_NvmBlock_StaMd_CloseCheckData.ReadBlock
      V_19_WriteBlock: start-on-event=WriteBlock, operation=PS_Rte_NvmBlock_StaMd_CloseCheckData.WriteBlock
      V_19_InvalidateNvBlock: start-on-event=InvalidateNvBlock, operation=PS_Rte_NvmBlock_StaMd_CloseCheckData.InvalidateNvBlock
      V_19_EraseBlock: start-on-event=EraseBlock, operation=PS_Rte_NvmBlock_StaMd_CloseCheckData.EraseBlock
      V_19_SetBlockProtection: start-on-event=SetBlockProtection, operation=PAdmin_Rte_NvmBlock_StaMd_CloseCheckData.SetBlockProtection
      V_20_GetErrorStatus: start-on-event=GetErrorStatus, operation=PS_NVM_BLOCK_DIAGMGR_BLACKBOX.GetErrorStatus
      V_20_SetRamBlockStatus: start-on-event=SetRamBlockStatus, operation=PS_NVM_BLOCK_DIAGMGR_BLACKBOX.SetRamBlockStatus
      V_20_ReadBlock: start-on-event=ReadBlock, operation=PS_NVM_BLOCK_DIAGMGR_BLACKBOX.ReadBlock
      V_20_WriteBlock: start-on-event=WriteBlock, operation=PS_NVM_BLOCK_DIAGMGR_BLACKBOX.WriteBlock
      V_20_InvalidateNvBlock: start-on-event=InvalidateNvBlock, operation=PS_NVM_BLOCK_DIAGMGR_BLACKBOX.InvalidateNvBlock
      V_20_EraseBlock: start-on-event=EraseBlock, operation=PS_NVM_BLOCK_DIAGMGR_BLACKBOX.EraseBlock
      V_20_SetBlockProtection: start-on-event=SetBlockProtection, operation=PAdmin_NVM_BLOCK_DIAGMGR_BLACKBOX.SetBlockProtection
      V_21_GetErrorStatus: start-on-event=GetErrorStatus, operation=PS_Deprecated_NvmBlock_AvgFricLrn_AvgFricLrnData.GetErrorStatus
      V_21_SetRamBlockStatus: start-on-event=SetRamBlockStatus, operation=PS_Deprecated_NvmBlock_AvgFricLrn_AvgFricLrnData.SetRamBlockStatus
      V_21_ReadBlock: start-on-event=ReadBlock, operation=PS_Deprecated_NvmBlock_AvgFricLrn_AvgFricLrnData.ReadBlock
      V_21_WriteBlock: start-on-event=WriteBlock, operation=PS_Deprecated_NvmBlock_AvgFricLrn_AvgFricLrnData.WriteBlock
      V_21_InvalidateNvBlock: start-on-event=InvalidateNvBlock, operation=PS_Deprecated_NvmBlock_AvgFricLrn_AvgFricLrnData.InvalidateNvBlock
      V_21_EraseBlock: start-on-event=EraseBlock, operation=PS_Deprecated_NvmBlock_AvgFricLrn_AvgFricLrnData.EraseBlock
      V_21_SetBlockProtection: start-on-event=SetBlockProtection, operation=PAdmin_Deprecated_NvmBlock_AvgFricLrn_AvgFricLrnData.SetBlockProtection
      V_22_GetErrorStatus: start-on-event=GetErrorStatus, operation=PS_Rte_NvmBlock_BatteryVoltage_OvervoltageData.GetErrorStatus
      V_22_SetRamBlockStatus: start-on-event=SetRamBlockStatus, operation=PS_Rte_NvmBlock_BatteryVoltage_OvervoltageData.SetRamBlockStatus
      V_22_ReadBlock: start-on-event=ReadBlock, operation=PS_Rte_NvmBlock_BatteryVoltage_OvervoltageData.ReadBlock
      V_22_WriteBlock: start-on-event=WriteBlock, operation=PS_Rte_NvmBlock_BatteryVoltage_OvervoltageData.WriteBlock
      V_22_InvalidateNvBlock: start-on-event=InvalidateNvBlock, operation=PS_Rte_NvmBlock_BatteryVoltage_OvervoltageData.InvalidateNvBlock
      V_22_EraseBlock: start-on-event=EraseBlock, operation=PS_Rte_NvmBlock_BatteryVoltage_OvervoltageData.EraseBlock
      V_22_SetBlockProtection: start-on-event=SetBlockProtection, operation=PAdmin_Rte_NvmBlock_BatteryVoltage_OvervoltageData.SetBlockProtection
      V_23_GetErrorStatus: start-on-event=GetErrorStatus, operation=PS_Rte_NvmBlock_DigMSB_DigMSBEOLData.GetErrorStatus
      V_23_SetRamBlockStatus: start-on-event=SetRamBlockStatus, operation=PS_Rte_NvmBlock_DigMSB_DigMSBEOLData.SetRamBlockStatus
      V_23_ReadBlock: start-on-event=ReadBlock, operation=PS_Rte_NvmBlock_DigMSB_DigMSBEOLData.ReadBlock
      V_23_WriteBlock: start-on-event=WriteBlock, operation=PS_Rte_NvmBlock_DigMSB_DigMSBEOLData.WriteBlock
      V_23_InvalidateNvBlock: start-on-event=InvalidateNvBlock, operation=PS_Rte_NvmBlock_DigMSB_DigMSBEOLData.InvalidateNvBlock
      V_23_EraseBlock: start-on-event=EraseBlock, operation=PS_Rte_NvmBlock_DigMSB_DigMSBEOLData.EraseBlock
      V_23_SetBlockProtection: start-on-event=SetBlockProtection, operation=PAdmin_Rte_NvmBlock_DigMSB_DigMSBEOLData.SetBlockProtection
      V_24_GetErrorStatus: start-on-event=GetErrorStatus, operation=PS_Deprecated_NvmBlock_DigHwTrqSENT_DigTrqTrim.GetErrorStatus
      V_24_SetRamBlockStatus: start-on-event=SetRamBlockStatus, operation=PS_Deprecated_NvmBlock_DigHwTrqSENT_DigTrqTrim.SetRamBlockStatus
      V_24_ReadBlock: start-on-event=ReadBlock, operation=PS_Deprecated_NvmBlock_DigHwTrqSENT_DigTrqTrim.ReadBlock
      V_24_WriteBlock: start-on-event=WriteBlock, operation=PS_Deprecated_NvmBlock_DigHwTrqSENT_DigTrqTrim.WriteBlock
      V_24_InvalidateNvBlock: start-on-event=InvalidateNvBlock, operation=PS_Deprecated_NvmBlock_DigHwTrqSENT_DigTrqTrim.InvalidateNvBlock
      V_24_EraseBlock: start-on-event=EraseBlock, operation=PS_Deprecated_NvmBlock_DigHwTrqSENT_DigTrqTrim.EraseBlock
      V_24_SetBlockProtection: start-on-event=SetBlockProtection, operation=PAdmin_Deprecated_NvmBlock_DigHwTrqSENT_DigTrqTrim.SetBlockProtection
      V_25_GetErrorStatus: start-on-event=GetErrorStatus, operation=PS_Deprecated_NvmBlock_AbsHwPos_EOLVehCntrOffset.GetErrorStatus
      V_25_SetRamBlockStatus: start-on-event=SetRamBlockStatus, operation=PS_Deprecated_NvmBlock_AbsHwPos_EOLVehCntrOffset.SetRamBlockStatus
      V_25_ReadBlock: start-on-event=ReadBlock, operation=PS_Deprecated_NvmBlock_AbsHwPos_EOLVehCntrOffset.ReadBlock
      V_25_WriteBlock: start-on-event=WriteBlock, operation=PS_Deprecated_NvmBlock_AbsHwPos_EOLVehCntrOffset.WriteBlock
      V_25_InvalidateNvBlock: start-on-event=InvalidateNvBlock, operation=PS_Deprecated_NvmBlock_AbsHwPos_EOLVehCntrOffset.InvalidateNvBlock
      V_25_EraseBlock: start-on-event=EraseBlock, operation=PS_Deprecated_NvmBlock_AbsHwPos_EOLVehCntrOffset.EraseBlock
      V_25_SetBlockProtection: start-on-event=SetBlockProtection, operation=PAdmin_Deprecated_NvmBlock_AbsHwPos_EOLVehCntrOffset.SetBlockProtection
      V_26_GetErrorStatus: start-on-event=GetErrorStatus, operation=PS_Rte_NvmBlock_DiagSvc_TuningSetSelectData.GetErrorStatus
      V_26_SetRamBlockStatus: start-on-event=SetRamBlockStatus, operation=PS_Rte_NvmBlock_DiagSvc_TuningSetSelectData.SetRamBlockStatus
      V_26_ReadBlock: start-on-event=ReadBlock, operation=PS_Rte_NvmBlock_DiagSvc_TuningSetSelectData.ReadBlock
      V_26_WriteBlock: start-on-event=WriteBlock, operation=PS_Rte_NvmBlock_DiagSvc_TuningSetSelectData.WriteBlock
      V_26_InvalidateNvBlock: start-on-event=InvalidateNvBlock, operation=PS_Rte_NvmBlock_DiagSvc_TuningSetSelectData.InvalidateNvBlock
      V_26_EraseBlock: start-on-event=EraseBlock, operation=PS_Rte_NvmBlock_DiagSvc_TuningSetSelectData.EraseBlock
      V_26_SetBlockProtection: start-on-event=SetBlockProtection, operation=PAdmin_Rte_NvmBlock_DiagSvc_TuningSetSelectData.SetBlockProtection
      V_27_GetErrorStatus: start-on-event=GetErrorStatus, operation=PS_Deprecated_NvmBlock_AbsHwPos_EOLVehCntrOffset1.GetErrorStatus
      V_27_SetRamBlockStatus: start-on-event=SetRamBlockStatus, operation=PS_Deprecated_NvmBlock_AbsHwPos_EOLVehCntrOffset1.SetRamBlockStatus
      V_27_ReadBlock: start-on-event=ReadBlock, operation=PS_Deprecated_NvmBlock_AbsHwPos_EOLVehCntrOffset1.ReadBlock
      V_27_WriteBlock: start-on-event=WriteBlock, operation=PS_Deprecated_NvmBlock_AbsHwPos_EOLVehCntrOffset1.WriteBlock
      V_27_InvalidateNvBlock: start-on-event=InvalidateNvBlock, operation=PS_Deprecated_NvmBlock_AbsHwPos_EOLVehCntrOffset1.InvalidateNvBlock
      V_27_EraseBlock: start-on-event=EraseBlock, operation=PS_Deprecated_NvmBlock_AbsHwPos_EOLVehCntrOffset1.EraseBlock
      V_27_SetBlockProtection: start-on-event=SetBlockProtection, operation=PAdmin_Deprecated_NvmBlock_AbsHwPos_EOLVehCntrOffset1.SetBlockProtection
      V_28_GetErrorStatus: start-on-event=GetErrorStatus, operation=PS_Deprecated_NvmBlock_TrqCanc_CogTrqRplComp.GetErrorStatus
      V_28_SetRamBlockStatus: start-on-event=SetRamBlockStatus, operation=PS_Deprecated_NvmBlock_TrqCanc_CogTrqRplComp.SetRamBlockStatus
      V_28_ReadBlock: start-on-event=ReadBlock, operation=PS_Deprecated_NvmBlock_TrqCanc_CogTrqRplComp.ReadBlock
      V_28_WriteBlock: start-on-event=WriteBlock, operation=PS_Deprecated_NvmBlock_TrqCanc_CogTrqRplComp.WriteBlock
      V_28_InvalidateNvBlock: start-on-event=InvalidateNvBlock, operation=PS_Deprecated_NvmBlock_TrqCanc_CogTrqRplComp.InvalidateNvBlock
      V_28_EraseBlock: start-on-event=EraseBlock, operation=PS_Deprecated_NvmBlock_TrqCanc_CogTrqRplComp.EraseBlock
      V_28_SetBlockProtection: start-on-event=SetBlockProtection, operation=PAdmin_Deprecated_NvmBlock_TrqCanc_CogTrqRplComp.SetBlockProtection
      V_29_GetErrorStatus: start-on-event=GetErrorStatus, operation=PS_Deprecated_NvmBlock_AstLmt_SteerAsstDefeat.GetErrorStatus
      V_29_SetRamBlockStatus: start-on-event=SetRamBlockStatus, operation=PS_Deprecated_NvmBlock_AstLmt_SteerAsstDefeat.SetRamBlockStatus
      V_29_ReadBlock: start-on-event=ReadBlock, operation=PS_Deprecated_NvmBlock_AstLmt_SteerAsstDefeat.ReadBlock
      V_29_WriteBlock: start-on-event=WriteBlock, operation=PS_Deprecated_NvmBlock_AstLmt_SteerAsstDefeat.WriteBlock
      V_29_InvalidateNvBlock: start-on-event=InvalidateNvBlock, operation=PS_Deprecated_NvmBlock_AstLmt_SteerAsstDefeat.InvalidateNvBlock
      V_29_EraseBlock: start-on-event=EraseBlock, operation=PS_Deprecated_NvmBlock_AstLmt_SteerAsstDefeat.EraseBlock
      V_29_SetBlockProtection: start-on-event=SetBlockProtection, operation=PAdmin_Deprecated_NvmBlock_AstLmt_SteerAsstDefeat.SetBlockProtection
      V_30_GetErrorStatus: start-on-event=GetErrorStatus, operation=PS_Rte_NvmBlock_ThrmlDutyCycle_ThrmlDutyCycle_FltStVal.GetErrorStatus
      V_30_SetRamBlockStatus: start-on-event=SetRamBlockStatus, operation=PS_Rte_NvmBlock_ThrmlDutyCycle_ThrmlDutyCycle_FltStVal.SetRamBlockStatus
      V_30_ReadBlock: start-on-event=ReadBlock, operation=PS_Rte_NvmBlock_ThrmlDutyCycle_ThrmlDutyCycle_FltStVal.ReadBlock
      V_30_WriteBlock: start-on-event=WriteBlock, operation=PS_Rte_NvmBlock_ThrmlDutyCycle_ThrmlDutyCycle_FltStVal.WriteBlock
      V_30_InvalidateNvBlock: start-on-event=InvalidateNvBlock, operation=PS_Rte_NvmBlock_ThrmlDutyCycle_ThrmlDutyCycle_FltStVal.InvalidateNvBlock
      V_30_EraseBlock: start-on-event=EraseBlock, operation=PS_Rte_NvmBlock_ThrmlDutyCycle_ThrmlDutyCycle_FltStVal.EraseBlock
      V_30_SetBlockProtection: start-on-event=SetBlockProtection, operation=PAdmin_Rte_NvmBlock_ThrmlDutyCycle_ThrmlDutyCycle_FltStVal.SetBlockProtection
      V_31_GetErrorStatus: start-on-event=GetErrorStatus, operation=PS_NVM_BLOCK_DIAGMGR_LATCHCNTRS.GetErrorStatus
      V_31_SetRamBlockStatus: start-on-event=SetRamBlockStatus, operation=PS_NVM_BLOCK_DIAGMGR_LATCHCNTRS.SetRamBlockStatus
      V_31_ReadBlock: start-on-event=ReadBlock, operation=PS_NVM_BLOCK_DIAGMGR_LATCHCNTRS.ReadBlock
      V_31_WriteBlock: start-on-event=WriteBlock, operation=PS_NVM_BLOCK_DIAGMGR_LATCHCNTRS.WriteBlock
      V_31_InvalidateNvBlock: start-on-event=InvalidateNvBlock, operation=PS_NVM_BLOCK_DIAGMGR_LATCHCNTRS.InvalidateNvBlock
      V_31_EraseBlock: start-on-event=EraseBlock, operation=PS_NVM_BLOCK_DIAGMGR_LATCHCNTRS.EraseBlock
      V_31_SetBlockProtection: start-on-event=SetBlockProtection, operation=PAdmin_NVM_BLOCK_DIAGMGR_LATCHCNTRS.SetBlockProtection
      V_32_GetErrorStatus: start-on-event=GetErrorStatus, operation=PS_Rte_NvmBlock_LrnEOT_LearnedEOT.GetErrorStatus
      V_32_SetRamBlockStatus: start-on-event=SetRamBlockStatus, operation=PS_Rte_NvmBlock_LrnEOT_LearnedEOT.SetRamBlockStatus
      V_32_ReadBlock: start-on-event=ReadBlock, operation=PS_Rte_NvmBlock_LrnEOT_LearnedEOT.ReadBlock
      V_32_WriteBlock: start-on-event=WriteBlock, operation=PS_Rte_NvmBlock_LrnEOT_LearnedEOT.WriteBlock
      V_32_RestoreBlockDefaults: start-on-event=RestoreBlockDefaults, operation=PS_Rte_NvmBlock_LrnEOT_LearnedEOT.RestoreBlockDefaults
      V_32_InvalidateNvBlock: start-on-event=InvalidateNvBlock, operation=PS_Rte_NvmBlock_LrnEOT_LearnedEOT.InvalidateNvBlock
      V_32_EraseBlock: start-on-event=EraseBlock, operation=PS_Rte_NvmBlock_LrnEOT_LearnedEOT.EraseBlock
      V_32_SetBlockProtection: start-on-event=SetBlockProtection, operation=PAdmin_Rte_NvmBlock_LrnEOT_LearnedEOT.SetBlockProtection
      V_33_GetErrorStatus: start-on-event=GetErrorStatus, operation=PS_Rte_NvmBlock_AvgFricLrn_AvgFricLrnData.GetErrorStatus
      V_33_SetRamBlockStatus: start-on-event=SetRamBlockStatus, operation=PS_Rte_NvmBlock_AvgFricLrn_AvgFricLrnData.SetRamBlockStatus
      V_33_ReadBlock: start-on-event=ReadBlock, operation=PS_Rte_NvmBlock_AvgFricLrn_AvgFricLrnData.ReadBlock
      V_33_WriteBlock: start-on-event=WriteBlock, operation=PS_Rte_NvmBlock_AvgFricLrn_AvgFricLrnData.WriteBlock
      V_33_RestoreBlockDefaults: start-on-event=RestoreBlockDefaults, operation=PS_Rte_NvmBlock_AvgFricLrn_AvgFricLrnData.RestoreBlockDefaults
      V_33_InvalidateNvBlock: start-on-event=InvalidateNvBlock, operation=PS_Rte_NvmBlock_AvgFricLrn_AvgFricLrnData.InvalidateNvBlock
      V_33_EraseBlock: start-on-event=EraseBlock, operation=PS_Rte_NvmBlock_AvgFricLrn_AvgFricLrnData.EraseBlock
      V_33_SetBlockProtection: start-on-event=SetBlockProtection, operation=PAdmin_Rte_NvmBlock_AvgFricLrn_AvgFricLrnData.SetBlockProtection
      V_34_GetErrorStatus: start-on-event=GetErrorStatus, operation=PS_Rte_NvmBlock_DigHwTrqSENT_DigTrqTrim.GetErrorStatus
      V_34_SetRamBlockStatus: start-on-event=SetRamBlockStatus, operation=PS_Rte_NvmBlock_DigHwTrqSENT_DigTrqTrim.SetRamBlockStatus
      V_34_ReadBlock: start-on-event=ReadBlock, operation=PS_Rte_NvmBlock_DigHwTrqSENT_DigTrqTrim.ReadBlock
      V_34_WriteBlock: start-on-event=WriteBlock, operation=PS_Rte_NvmBlock_DigHwTrqSENT_DigTrqTrim.WriteBlock
      V_34_InvalidateNvBlock: start-on-event=InvalidateNvBlock, operation=PS_Rte_NvmBlock_DigHwTrqSENT_DigTrqTrim.InvalidateNvBlock
      V_34_EraseBlock: start-on-event=EraseBlock, operation=PS_Rte_NvmBlock_DigHwTrqSENT_DigTrqTrim.EraseBlock
      V_34_SetBlockProtection: start-on-event=SetBlockProtection, operation=PAdmin_Rte_NvmBlock_DigHwTrqSENT_DigTrqTrim.SetBlockProtection
      V_35_GetErrorStatus: start-on-event=GetErrorStatus, operation=PS_Rte_NvmBlock_CmMtrCurr_CurrTempOffset.GetErrorStatus
      V_35_SetRamBlockStatus: start-on-event=SetRamBlockStatus, operation=PS_Rte_NvmBlock_CmMtrCurr_CurrTempOffset.SetRamBlockStatus
      V_35_ReadBlock: start-on-event=ReadBlock, operation=PS_Rte_NvmBlock_CmMtrCurr_CurrTempOffset.ReadBlock
      V_35_WriteBlock: start-on-event=WriteBlock, operation=PS_Rte_NvmBlock_CmMtrCurr_CurrTempOffset.WriteBlock
      V_35_InvalidateNvBlock: start-on-event=InvalidateNvBlock, operation=PS_Rte_NvmBlock_CmMtrCurr_CurrTempOffset.InvalidateNvBlock
      V_35_EraseBlock: start-on-event=EraseBlock, operation=PS_Rte_NvmBlock_CmMtrCurr_CurrTempOffset.EraseBlock
      V_35_SetBlockProtection: start-on-event=SetBlockProtection, operation=PAdmin_Rte_NvmBlock_CmMtrCurr_CurrTempOffset.SetBlockProtection
      V_36_GetErrorStatus: start-on-event=GetErrorStatus, operation=PS_Rte_NvmBlock_CmMtrCurr_ShCurrCal.GetErrorStatus
      V_36_SetRamBlockStatus: start-on-event=SetRamBlockStatus, operation=PS_Rte_NvmBlock_CmMtrCurr_ShCurrCal.SetRamBlockStatus
      V_36_ReadBlock: start-on-event=ReadBlock, operation=PS_Rte_NvmBlock_CmMtrCurr_ShCurrCal.ReadBlock
      V_36_WriteBlock: start-on-event=WriteBlock, operation=PS_Rte_NvmBlock_CmMtrCurr_ShCurrCal.WriteBlock
      V_36_InvalidateNvBlock: start-on-event=InvalidateNvBlock, operation=PS_Rte_NvmBlock_CmMtrCurr_ShCurrCal.InvalidateNvBlock
      V_36_EraseBlock: start-on-event=EraseBlock, operation=PS_Rte_NvmBlock_CmMtrCurr_ShCurrCal.EraseBlock
      V_36_SetBlockProtection: start-on-event=SetBlockProtection, operation=PAdmin_Rte_NvmBlock_CmMtrCurr_ShCurrCal.SetBlockProtection
      V_37_GetErrorStatus: start-on-event=GetErrorStatus, operation=PS_Rte_NvmBlock_TrqCanc_CogTrqCal.GetErrorStatus
      V_37_SetRamBlockStatus: start-on-event=SetRamBlockStatus, operation=PS_Rte_NvmBlock_TrqCanc_CogTrqCal.SetRamBlockStatus
      V_37_ReadBlock: start-on-event=ReadBlock, operation=PS_Rte_NvmBlock_TrqCanc_CogTrqCal.ReadBlock
      V_37_WriteBlock: start-on-event=WriteBlock, operation=PS_Rte_NvmBlock_TrqCanc_CogTrqCal.WriteBlock
      V_37_InvalidateNvBlock: start-on-event=InvalidateNvBlock, operation=PS_Rte_NvmBlock_TrqCanc_CogTrqCal.InvalidateNvBlock
      V_37_EraseBlock: start-on-event=EraseBlock, operation=PS_Rte_NvmBlock_TrqCanc_CogTrqCal.EraseBlock
      V_37_SetBlockProtection: start-on-event=SetBlockProtection, operation=PAdmin_Rte_NvmBlock_TrqCanc_CogTrqCal.SetBlockProtection
      V_38_GetErrorStatus: start-on-event=GetErrorStatus, operation=PS_Rte_NvmBlock_TrqCanc_CogTrqRplComp.GetErrorStatus
      V_38_SetRamBlockStatus: start-on-event=SetRamBlockStatus, operation=PS_Rte_NvmBlock_TrqCanc_CogTrqRplComp.SetRamBlockStatus
      V_38_ReadBlock: start-on-event=ReadBlock, operation=PS_Rte_NvmBlock_TrqCanc_CogTrqRplComp.ReadBlock
      V_38_WriteBlock: start-on-event=WriteBlock, operation=PS_Rte_NvmBlock_TrqCanc_CogTrqRplComp.WriteBlock
      V_38_InvalidateNvBlock: start-on-event=InvalidateNvBlock, operation=PS_Rte_NvmBlock_TrqCanc_CogTrqRplComp.InvalidateNvBlock
      V_38_EraseBlock: start-on-event=EraseBlock, operation=PS_Rte_NvmBlock_TrqCanc_CogTrqRplComp.EraseBlock
      V_38_SetBlockProtection: start-on-event=SetBlockProtection, operation=PAdmin_Rte_NvmBlock_TrqCanc_CogTrqRplComp.SetBlockProtection
      V_39_GetErrorStatus: start-on-event=GetErrorStatus, operation=PS_Rte_NvmBlock_AstLmt_SteerAsstDefeat.GetErrorStatus
      V_39_SetRamBlockStatus: start-on-event=SetRamBlockStatus, operation=PS_Rte_NvmBlock_AstLmt_SteerAsstDefeat.SetRamBlockStatus
      V_39_ReadBlock: start-on-event=ReadBlock, operation=PS_Rte_NvmBlock_AstLmt_SteerAsstDefeat.ReadBlock
      V_39_WriteBlock: start-on-event=WriteBlock, operation=PS_Rte_NvmBlock_AstLmt_SteerAsstDefeat.WriteBlock
      V_39_InvalidateNvBlock: start-on-event=InvalidateNvBlock, operation=PS_Rte_NvmBlock_AstLmt_SteerAsstDefeat.InvalidateNvBlock
      V_39_EraseBlock: start-on-event=EraseBlock, operation=PS_Rte_NvmBlock_AstLmt_SteerAsstDefeat.EraseBlock
      V_39_SetBlockProtection: start-on-event=SetBlockProtection, operation=PAdmin_Rte_NvmBlock_AstLmt_SteerAsstDefeat.SetBlockProtection
      V_40_GetErrorStatus: start-on-event=GetErrorStatus, operation=PS_Rte_NvmBlock_TrqCmdScl_TorqueCmdSF_Uls_f32.GetErrorStatus
      V_40_SetRamBlockStatus: start-on-event=SetRamBlockStatus, operation=PS_Rte_NvmBlock_TrqCmdScl_TorqueCmdSF_Uls_f32.SetRamBlockStatus
      V_40_ReadBlock: start-on-event=ReadBlock, operation=PS_Rte_NvmBlock_TrqCmdScl_TorqueCmdSF_Uls_f32.ReadBlock
      V_40_WriteBlock: start-on-event=WriteBlock, operation=PS_Rte_NvmBlock_TrqCmdScl_TorqueCmdSF_Uls_f32.WriteBlock
      V_40_InvalidateNvBlock: start-on-event=InvalidateNvBlock, operation=PS_Rte_NvmBlock_TrqCmdScl_TorqueCmdSF_Uls_f32.InvalidateNvBlock
      V_40_EraseBlock: start-on-event=EraseBlock, operation=PS_Rte_NvmBlock_TrqCmdScl_TorqueCmdSF_Uls_f32.EraseBlock
      V_40_SetBlockProtection: start-on-event=SetBlockProtection, operation=PAdmin_Rte_NvmBlock_TrqCmdScl_TorqueCmdSF_Uls_f32.SetBlockProtection
      V_41_GetErrorStatus: start-on-event=GetErrorStatus, operation=PS_Rte_NvmBlock_AbsHwPos_EOLVehCntrOffset.GetErrorStatus
      V_41_SetRamBlockStatus: start-on-event=SetRamBlockStatus, operation=PS_Rte_NvmBlock_AbsHwPos_EOLVehCntrOffset.SetRamBlockStatus
      V_41_ReadBlock: start-on-event=ReadBlock, operation=PS_Rte_NvmBlock_AbsHwPos_EOLVehCntrOffset.ReadBlock
      V_41_WriteBlock: start-on-event=WriteBlock, operation=PS_Rte_NvmBlock_AbsHwPos_EOLVehCntrOffset.WriteBlock
      V_41_InvalidateNvBlock: start-on-event=InvalidateNvBlock, operation=PS_Rte_NvmBlock_AbsHwPos_EOLVehCntrOffset.InvalidateNvBlock
      V_41_EraseBlock: start-on-event=EraseBlock, operation=PS_Rte_NvmBlock_AbsHwPos_EOLVehCntrOffset.EraseBlock
      V_41_SetBlockProtection: start-on-event=SetBlockProtection, operation=PAdmin_Rte_NvmBlock_AbsHwPos_EOLVehCntrOffset.SetBlockProtection
      V_44_GetErrorStatus: start-on-event=GetErrorStatus, operation=PS_Rte_NvmBlock_VehDyn_MotPosReset.GetErrorStatus
      V_44_SetRamBlockStatus: start-on-event=SetRamBlockStatus, operation=PS_Rte_NvmBlock_VehDyn_MotPosReset.SetRamBlockStatus
      V_44_ReadBlock: start-on-event=ReadBlock, operation=PS_Rte_NvmBlock_VehDyn_MotPosReset.ReadBlock
      V_44_WriteBlock: start-on-event=WriteBlock, operation=PS_Rte_NvmBlock_VehDyn_MotPosReset.WriteBlock
      V_44_InvalidateNvBlock: start-on-event=InvalidateNvBlock, operation=PS_Rte_NvmBlock_VehDyn_MotPosReset.InvalidateNvBlock
      V_44_EraseBlock: start-on-event=EraseBlock, operation=PS_Rte_NvmBlock_VehDyn_MotPosReset.EraseBlock
      V_44_SetBlockProtection: start-on-event=SetBlockProtection, operation=PAdmin_Rte_NvmBlock_VehDyn_MotPosReset.SetBlockProtection
      V_45_GetErrorStatus: start-on-event=GetErrorStatus, operation=PS_Rte_NvmBlock_DiagSvc_BootSwFingerPrint.GetErrorStatus
      V_45_SetRamBlockStatus: start-on-event=SetRamBlockStatus, operation=PS_Rte_NvmBlock_DiagSvc_BootSwFingerPrint.SetRamBlockStatus
      V_45_ReadBlock: start-on-event=ReadBlock, operation=PS_Rte_NvmBlock_DiagSvc_BootSwFingerPrint.ReadBlock
      V_45_WriteBlock: start-on-event=WriteBlock, operation=PS_Rte_NvmBlock_DiagSvc_BootSwFingerPrint.WriteBlock
      V_45_InvalidateNvBlock: start-on-event=InvalidateNvBlock, operation=PS_Rte_NvmBlock_DiagSvc_BootSwFingerPrint.InvalidateNvBlock
      V_45_EraseBlock: start-on-event=EraseBlock, operation=PS_Rte_NvmBlock_DiagSvc_BootSwFingerPrint.EraseBlock
      V_45_SetBlockProtection: start-on-event=SetBlockProtection, operation=PAdmin_Rte_NvmBlock_DiagSvc_BootSwFingerPrint.SetBlockProtection
      V_46_GetErrorStatus: start-on-event=GetErrorStatus, operation=PS_Rte_NvmBlock_DiagSvc_AppSwFingerPrint.GetErrorStatus
      V_46_SetRamBlockStatus: start-on-event=SetRamBlockStatus, operation=PS_Rte_NvmBlock_DiagSvc_AppSwFingerPrint.SetRamBlockStatus
      V_46_ReadBlock: start-on-event=ReadBlock, operation=PS_Rte_NvmBlock_DiagSvc_AppSwFingerPrint.ReadBlock
      V_46_WriteBlock: start-on-event=WriteBlock, operation=PS_Rte_NvmBlock_DiagSvc_AppSwFingerPrint.WriteBlock
      V_46_InvalidateNvBlock: start-on-event=InvalidateNvBlock, operation=PS_Rte_NvmBlock_DiagSvc_AppSwFingerPrint.InvalidateNvBlock
      V_46_EraseBlock: start-on-event=EraseBlock, operation=PS_Rte_NvmBlock_DiagSvc_AppSwFingerPrint.EraseBlock
      V_46_SetBlockProtection: start-on-event=SetBlockProtection, operation=PAdmin_Rte_NvmBlock_DiagSvc_AppSwFingerPrint.SetBlockProtection
      V_48_GetErrorStatus: start-on-event=GetErrorStatus, operation=PS_Rte_NvmBlock_DiagSvc_ECUSparePartNo.GetErrorStatus
      V_48_SetRamBlockStatus: start-on-event=SetRamBlockStatus, operation=PS_Rte_NvmBlock_DiagSvc_ECUSparePartNo.SetRamBlockStatus
      V_48_ReadBlock: start-on-event=ReadBlock, operation=PS_Rte_NvmBlock_DiagSvc_ECUSparePartNo.ReadBlock
      V_48_WriteBlock: start-on-event=WriteBlock, operation=PS_Rte_NvmBlock_DiagSvc_ECUSparePartNo.WriteBlock
      V_48_InvalidateNvBlock: start-on-event=InvalidateNvBlock, operation=PS_Rte_NvmBlock_DiagSvc_ECUSparePartNo.InvalidateNvBlock
      V_48_EraseBlock: start-on-event=EraseBlock, operation=PS_Rte_NvmBlock_DiagSvc_ECUSparePartNo.EraseBlock
      V_48_SetBlockProtection: start-on-event=SetBlockProtection, operation=PAdmin_Rte_NvmBlock_DiagSvc_ECUSparePartNo.SetBlockProtection
      V_51_GetErrorStatus: start-on-event=GetErrorStatus, operation=PS_Rte_NvmBlock_DiagSvc_VINCurrent.GetErrorStatus
      V_51_SetRamBlockStatus: start-on-event=SetRamBlockStatus, operation=PS_Rte_NvmBlock_DiagSvc_VINCurrent.SetRamBlockStatus
      V_51_ReadBlock: start-on-event=ReadBlock, operation=PS_Rte_NvmBlock_DiagSvc_VINCurrent.ReadBlock
      V_51_WriteBlock: start-on-event=WriteBlock, operation=PS_Rte_NvmBlock_DiagSvc_VINCurrent.WriteBlock
      V_51_InvalidateNvBlock: start-on-event=InvalidateNvBlock, operation=PS_Rte_NvmBlock_DiagSvc_VINCurrent.InvalidateNvBlock
      V_51_EraseBlock: start-on-event=EraseBlock, operation=PS_Rte_NvmBlock_DiagSvc_VINCurrent.EraseBlock
      V_51_SetBlockProtection: start-on-event=SetBlockProtection, operation=PAdmin_Rte_NvmBlock_DiagSvc_VINCurrent.SetBlockProtection
      V_57_GetErrorStatus: start-on-event=GetErrorStatus, operation=PS_Rte_NvmBlock_DiagSvc_EraseRoutineStatus.GetErrorStatus
      V_57_SetRamBlockStatus: start-on-event=SetRamBlockStatus, operation=PS_Rte_NvmBlock_DiagSvc_EraseRoutineStatus.SetRamBlockStatus
      V_57_ReadBlock: start-on-event=ReadBlock, operation=PS_Rte_NvmBlock_DiagSvc_EraseRoutineStatus.ReadBlock
      V_57_WriteBlock: start-on-event=WriteBlock, operation=PS_Rte_NvmBlock_DiagSvc_EraseRoutineStatus.WriteBlock
      V_57_InvalidateNvBlock: start-on-event=InvalidateNvBlock, operation=PS_Rte_NvmBlock_DiagSvc_EraseRoutineStatus.InvalidateNvBlock
      V_57_EraseBlock: start-on-event=EraseBlock, operation=PS_Rte_NvmBlock_DiagSvc_EraseRoutineStatus.EraseBlock
      V_57_SetBlockProtection: start-on-event=SetBlockProtection, operation=PAdmin_Rte_NvmBlock_DiagSvc_EraseRoutineStatus.SetBlockProtection
      V_58_GetErrorStatus: start-on-event=GetErrorStatus, operation=PS_Rte_NvmBlock_DiagSvc_ProgrammingStatus.GetErrorStatus
      V_58_SetRamBlockStatus: start-on-event=SetRamBlockStatus, operation=PS_Rte_NvmBlock_DiagSvc_ProgrammingStatus.SetRamBlockStatus
      V_58_ReadBlock: start-on-event=ReadBlock, operation=PS_Rte_NvmBlock_DiagSvc_ProgrammingStatus.ReadBlock
      V_58_WriteBlock: start-on-event=WriteBlock, operation=PS_Rte_NvmBlock_DiagSvc_ProgrammingStatus.WriteBlock
      V_58_InvalidateNvBlock: start-on-event=InvalidateNvBlock, operation=PS_Rte_NvmBlock_DiagSvc_ProgrammingStatus.InvalidateNvBlock
      V_58_EraseBlock: start-on-event=EraseBlock, operation=PS_Rte_NvmBlock_DiagSvc_ProgrammingStatus.EraseBlock
      V_58_SetBlockProtection: start-on-event=SetBlockProtection, operation=PAdmin_Rte_NvmBlock_DiagSvc_ProgrammingStatus.SetBlockProtection
      V_67_GetErrorStatus: start-on-event=GetErrorStatus, operation=PS_Rte_NvmBlock_Sa_DigColPs_DigColPsEOL.GetErrorStatus
      V_67_SetRamBlockStatus: start-on-event=SetRamBlockStatus, operation=PS_Rte_NvmBlock_Sa_DigColPs_DigColPsEOL.SetRamBlockStatus
      V_67_ReadBlock: start-on-event=ReadBlock, operation=PS_Rte_NvmBlock_Sa_DigColPs_DigColPsEOL.ReadBlock
      V_67_WriteBlock: start-on-event=WriteBlock, operation=PS_Rte_NvmBlock_Sa_DigColPs_DigColPsEOL.WriteBlock
      V_67_InvalidateNvBlock: start-on-event=InvalidateNvBlock, operation=PS_Rte_NvmBlock_Sa_DigColPs_DigColPsEOL.InvalidateNvBlock
      V_67_EraseBlock: start-on-event=EraseBlock, operation=PS_Rte_NvmBlock_Sa_DigColPs_DigColPsEOL.EraseBlock
      V_67_SetBlockProtection: start-on-event=SetBlockProtection, operation=PAdmin_Rte_NvmBlock_Sa_DigColPs_DigColPsEOL.SetBlockProtection
      V_79_GetErrorStatus: start-on-event=GetErrorStatus, operation=PS_Deprecated_Rte_NvmBlock_DiagSvc_ProxiConfigurationData.GetErrorStatus
      V_79_SetRamBlockStatus: start-on-event=SetRamBlockStatus, operation=PS_Deprecated_Rte_NvmBlock_DiagSvc_ProxiConfigurationData.SetRamBlockStatus
      V_79_ReadBlock: start-on-event=ReadBlock, operation=PS_Deprecated_Rte_NvmBlock_DiagSvc_ProxiConfigurationData.ReadBlock
      V_79_WriteBlock: start-on-event=WriteBlock, operation=PS_Deprecated_Rte_NvmBlock_DiagSvc_ProxiConfigurationData.WriteBlock
      V_79_InvalidateNvBlock: start-on-event=InvalidateNvBlock, operation=PS_Deprecated_Rte_NvmBlock_DiagSvc_ProxiConfigurationData.InvalidateNvBlock
      V_79_EraseBlock: start-on-event=EraseBlock, operation=PS_Deprecated_Rte_NvmBlock_DiagSvc_ProxiConfigurationData.EraseBlock
      V_79_SetBlockProtection: start-on-event=SetBlockProtection, operation=PAdmin_Deprecated_Rte_NvmBlock_DiagSvc_ProxiConfigurationData.SetBlockProtection
      V_92_GetErrorStatus: start-on-event=GetErrorStatus, operation=PS_Rte_NvmBlock_DiagSvc_ProxiConfigurationData.GetErrorStatus
      V_92_SetRamBlockStatus: start-on-event=SetRamBlockStatus, operation=PS_Rte_NvmBlock_DiagSvc_ProxiConfigurationData.SetRamBlockStatus
      V_92_ReadBlock: start-on-event=ReadBlock, operation=PS_Rte_NvmBlock_DiagSvc_ProxiConfigurationData.ReadBlock
      V_92_WriteBlock: start-on-event=WriteBlock, operation=PS_Rte_NvmBlock_DiagSvc_ProxiConfigurationData.WriteBlock
      V_92_InvalidateNvBlock: start-on-event=InvalidateNvBlock, operation=PS_Rte_NvmBlock_DiagSvc_ProxiConfigurationData.InvalidateNvBlock
      V_92_EraseBlock: start-on-event=EraseBlock, operation=PS_Rte_NvmBlock_DiagSvc_ProxiConfigurationData.EraseBlock
      V_92_SetBlockProtection: start-on-event=SetBlockProtection, operation=PAdmin_Rte_NvmBlock_DiagSvc_ProxiConfigurationData.SetBlockProtection
      V_93_GetErrorStatus: start-on-event=GetErrorStatus, operation=PS_Rte_NvmBlock_DiagSvc_ProxiCounter.GetErrorStatus
      V_93_SetRamBlockStatus: start-on-event=SetRamBlockStatus, operation=PS_Rte_NvmBlock_DiagSvc_ProxiCounter.SetRamBlockStatus
      V_93_ReadBlock: start-on-event=ReadBlock, operation=PS_Rte_NvmBlock_DiagSvc_ProxiCounter.ReadBlock
      V_93_WriteBlock: start-on-event=WriteBlock, operation=PS_Rte_NvmBlock_DiagSvc_ProxiCounter.WriteBlock
      V_93_InvalidateNvBlock: start-on-event=InvalidateNvBlock, operation=PS_Rte_NvmBlock_DiagSvc_ProxiCounter.InvalidateNvBlock
      V_93_EraseBlock: start-on-event=EraseBlock, operation=PS_Rte_NvmBlock_DiagSvc_ProxiCounter.EraseBlock
      V_93_SetBlockProtection: start-on-event=SetBlockProtection, operation=PAdmin_Rte_NvmBlock_DiagSvc_ProxiCounter.SetBlockProtection
      V_94_GetErrorStatus: start-on-event=GetErrorStatus, operation=PS_Rte_NvmBlock_DiagSvc_CalSwFingerPrint.GetErrorStatus
      V_94_SetRamBlockStatus: start-on-event=SetRamBlockStatus, operation=PS_Rte_NvmBlock_DiagSvc_CalSwFingerPrint.SetRamBlockStatus
      V_94_ReadBlock: start-on-event=ReadBlock, operation=PS_Rte_NvmBlock_DiagSvc_CalSwFingerPrint.ReadBlock
      V_94_WriteBlock: start-on-event=WriteBlock, operation=PS_Rte_NvmBlock_DiagSvc_CalSwFingerPrint.WriteBlock
      V_94_InvalidateNvBlock: start-on-event=InvalidateNvBlock, operation=PS_Rte_NvmBlock_DiagSvc_CalSwFingerPrint.InvalidateNvBlock
      V_94_EraseBlock: start-on-event=EraseBlock, operation=PS_Rte_NvmBlock_DiagSvc_CalSwFingerPrint.EraseBlock
      V_94_SetBlockProtection: start-on-event=SetBlockProtection, operation=PAdmin_Rte_NvmBlock_DiagSvc_CalSwFingerPrint.SetBlockProtection
      V_95_GetErrorStatus: start-on-event=GetErrorStatus, operation=PS_Rte_NvmBlock_DiagSvc_ECULifeTimeMins.GetErrorStatus
      V_95_SetRamBlockStatus: start-on-event=SetRamBlockStatus, operation=PS_Rte_NvmBlock_DiagSvc_ECULifeTimeMins.SetRamBlockStatus
      V_95_ReadBlock: start-on-event=ReadBlock, operation=PS_Rte_NvmBlock_DiagSvc_ECULifeTimeMins.ReadBlock
      V_95_WriteBlock: start-on-event=WriteBlock, operation=PS_Rte_NvmBlock_DiagSvc_ECULifeTimeMins.WriteBlock
      V_95_InvalidateNvBlock: start-on-event=InvalidateNvBlock, operation=PS_Rte_NvmBlock_DiagSvc_ECULifeTimeMins.InvalidateNvBlock
      V_95_EraseBlock: start-on-event=EraseBlock, operation=PS_Rte_NvmBlock_DiagSvc_ECULifeTimeMins.EraseBlock
      V_95_SetBlockProtection: start-on-event=SetBlockProtection, operation=PAdmin_Rte_NvmBlock_DiagSvc_ECULifeTimeMins.SetBlockProtection
      V_96_GetErrorStatus: start-on-event=GetErrorStatus, operation=PS_Rte_NvmBlock_DiagSvc_FirstDTCDetectMins.GetErrorStatus
      V_96_SetRamBlockStatus: start-on-event=SetRamBlockStatus, operation=PS_Rte_NvmBlock_DiagSvc_FirstDTCDetectMins.SetRamBlockStatus
      V_96_ReadBlock: start-on-event=ReadBlock, operation=PS_Rte_NvmBlock_DiagSvc_FirstDTCDetectMins.ReadBlock
      V_96_WriteBlock: start-on-event=WriteBlock, operation=PS_Rte_NvmBlock_DiagSvc_FirstDTCDetectMins.WriteBlock
      V_96_InvalidateNvBlock: start-on-event=InvalidateNvBlock, operation=PS_Rte_NvmBlock_DiagSvc_FirstDTCDetectMins.InvalidateNvBlock
      V_96_EraseBlock: start-on-event=EraseBlock, operation=PS_Rte_NvmBlock_DiagSvc_FirstDTCDetectMins.EraseBlock
      V_96_SetBlockProtection: start-on-event=SetBlockProtection, operation=PAdmin_Rte_NvmBlock_DiagSvc_FirstDTCDetectMins.SetBlockProtection
      V_97_GetErrorStatus: start-on-event=GetErrorStatus, operation=PS_Rte_NvmBlock_DiagSvc_FirstDTCDetectSecs.GetErrorStatus
      V_97_SetRamBlockStatus: start-on-event=SetRamBlockStatus, operation=PS_Rte_NvmBlock_DiagSvc_FirstDTCDetectSecs.SetRamBlockStatus
      V_97_ReadBlock: start-on-event=ReadBlock, operation=PS_Rte_NvmBlock_DiagSvc_FirstDTCDetectSecs.ReadBlock
      V_97_WriteBlock: start-on-event=WriteBlock, operation=PS_Rte_NvmBlock_DiagSvc_FirstDTCDetectSecs.WriteBlock
      V_97_InvalidateNvBlock: start-on-event=InvalidateNvBlock, operation=PS_Rte_NvmBlock_DiagSvc_FirstDTCDetectSecs.InvalidateNvBlock
      V_97_EraseBlock: start-on-event=EraseBlock, operation=PS_Rte_NvmBlock_DiagSvc_FirstDTCDetectSecs.EraseBlock
      V_97_SetBlockProtection: start-on-event=SetBlockProtection, operation=PAdmin_Rte_NvmBlock_DiagSvc_FirstDTCDetectSecs.SetBlockProtection
      V_98_GetErrorStatus: start-on-event=GetErrorStatus, operation=PS_Rte_NvmBlock_DiagSvc_EOLConfigData.GetErrorStatus
      V_98_SetRamBlockStatus: start-on-event=SetRamBlockStatus, operation=PS_Rte_NvmBlock_DiagSvc_EOLConfigData.SetRamBlockStatus
      V_98_ReadBlock: start-on-event=ReadBlock, operation=PS_Rte_NvmBlock_DiagSvc_EOLConfigData.ReadBlock
      V_98_WriteBlock: start-on-event=WriteBlock, operation=PS_Rte_NvmBlock_DiagSvc_EOLConfigData.WriteBlock
      V_98_InvalidateNvBlock: start-on-event=InvalidateNvBlock, operation=PS_Rte_NvmBlock_DiagSvc_EOLConfigData.InvalidateNvBlock
      V_98_EraseBlock: start-on-event=EraseBlock, operation=PS_Rte_NvmBlock_DiagSvc_EOLConfigData.EraseBlock
      V_98_SetBlockProtection: start-on-event=SetBlockProtection, operation=PAdmin_Rte_NvmBlock_DiagSvc_EOLConfigData.SetBlockProtection
      V_99_GetErrorStatus: start-on-event=GetErrorStatus, operation=PS_Rte_NvmBlock_DiagSvc_ProgAttemptsCounter.GetErrorStatus
      V_99_SetRamBlockStatus: start-on-event=SetRamBlockStatus, operation=PS_Rte_NvmBlock_DiagSvc_ProgAttemptsCounter.SetRamBlockStatus
      V_99_ReadBlock: start-on-event=ReadBlock, operation=PS_Rte_NvmBlock_DiagSvc_ProgAttemptsCounter.ReadBlock
      V_99_WriteBlock: start-on-event=WriteBlock, operation=PS_Rte_NvmBlock_DiagSvc_ProgAttemptsCounter.WriteBlock
      V_99_InvalidateNvBlock: start-on-event=InvalidateNvBlock, operation=PS_Rte_NvmBlock_DiagSvc_ProgAttemptsCounter.InvalidateNvBlock
      V_99_EraseBlock: start-on-event=EraseBlock, operation=PS_Rte_NvmBlock_DiagSvc_ProgAttemptsCounter.EraseBlock
      V_99_SetBlockProtection: start-on-event=SetBlockProtection, operation=PAdmin_Rte_NvmBlock_DiagSvc_ProgAttemptsCounter.SetBlockProtection
      V_100_GetErrorStatus: start-on-event=GetErrorStatus, operation=PS_Rte_NvmBlock_DiagSvc_VINOriginal.GetErrorStatus
      V_100_SetRamBlockStatus: start-on-event=SetRamBlockStatus, operation=PS_Rte_NvmBlock_DiagSvc_VINOriginal.SetRamBlockStatus
      V_100_ReadBlock: start-on-event=ReadBlock, operation=PS_Rte_NvmBlock_DiagSvc_VINOriginal.ReadBlock
      V_100_WriteBlock: start-on-event=WriteBlock, operation=PS_Rte_NvmBlock_DiagSvc_VINOriginal.WriteBlock
      V_100_InvalidateNvBlock: start-on-event=InvalidateNvBlock, operation=PS_Rte_NvmBlock_DiagSvc_VINOriginal.InvalidateNvBlock
      V_100_EraseBlock: start-on-event=EraseBlock, operation=PS_Rte_NvmBlock_DiagSvc_VINOriginal.EraseBlock
      V_100_SetBlockProtection: start-on-event=SetBlockProtection, operation=PAdmin_Rte_NvmBlock_DiagSvc_VINOriginal.SetBlockProtection
      V_101_GetErrorStatus: start-on-event=GetErrorStatus, operation=PS_Rte_NvmBlock_DiagSvc_ECUSerialNumber.GetErrorStatus
      V_101_SetRamBlockStatus: start-on-event=SetRamBlockStatus, operation=PS_Rte_NvmBlock_DiagSvc_ECUSerialNumber.SetRamBlockStatus
      V_101_ReadBlock: start-on-event=ReadBlock, operation=PS_Rte_NvmBlock_DiagSvc_ECUSerialNumber.ReadBlock
      V_101_WriteBlock: start-on-event=WriteBlock, operation=PS_Rte_NvmBlock_DiagSvc_ECUSerialNumber.WriteBlock
      V_101_InvalidateNvBlock: start-on-event=InvalidateNvBlock, operation=PS_Rte_NvmBlock_DiagSvc_ECUSerialNumber.InvalidateNvBlock
      V_101_EraseBlock: start-on-event=EraseBlock, operation=PS_Rte_NvmBlock_DiagSvc_ECUSerialNumber.EraseBlock
      V_101_SetBlockProtection: start-on-event=SetBlockProtection, operation=PAdmin_Rte_NvmBlock_DiagSvc_ECUSerialNumber.SetBlockProtection
      V_102_GetErrorStatus: start-on-event=GetErrorStatus, operation=PS_Rte_NvmBlock_DiagSvc_TotalOdometer.GetErrorStatus
      V_102_SetRamBlockStatus: start-on-event=SetRamBlockStatus, operation=PS_Rte_NvmBlock_DiagSvc_TotalOdometer.SetRamBlockStatus
      V_102_ReadBlock: start-on-event=ReadBlock, operation=PS_Rte_NvmBlock_DiagSvc_TotalOdometer.ReadBlock
      V_102_WriteBlock: start-on-event=WriteBlock, operation=PS_Rte_NvmBlock_DiagSvc_TotalOdometer.WriteBlock
      V_102_InvalidateNvBlock: start-on-event=InvalidateNvBlock, operation=PS_Rte_NvmBlock_DiagSvc_TotalOdometer.InvalidateNvBlock
      V_102_EraseBlock: start-on-event=EraseBlock, operation=PS_Rte_NvmBlock_DiagSvc_TotalOdometer.EraseBlock
      V_102_SetBlockProtection: start-on-event=SetBlockProtection, operation=PAdmin_Rte_NvmBlock_DiagSvc_TotalOdometer.SetBlockProtection
      V_103_GetErrorStatus: start-on-event=GetErrorStatus, operation=PS_Rte_NvmBlock_DiagSvc_OdometerFlashProg.GetErrorStatus
      V_103_SetRamBlockStatus: start-on-event=SetRamBlockStatus, operation=PS_Rte_NvmBlock_DiagSvc_OdometerFlashProg.SetRamBlockStatus
      V_103_ReadBlock: start-on-event=ReadBlock, operation=PS_Rte_NvmBlock_DiagSvc_OdometerFlashProg.ReadBlock
      V_103_WriteBlock: start-on-event=WriteBlock, operation=PS_Rte_NvmBlock_DiagSvc_OdometerFlashProg.WriteBlock
      V_103_InvalidateNvBlock: start-on-event=InvalidateNvBlock, operation=PS_Rte_NvmBlock_DiagSvc_OdometerFlashProg.InvalidateNvBlock
      V_103_EraseBlock: start-on-event=EraseBlock, operation=PS_Rte_NvmBlock_DiagSvc_OdometerFlashProg.EraseBlock
      V_103_SetBlockProtection: start-on-event=SetBlockProtection, operation=PAdmin_Rte_NvmBlock_DiagSvc_OdometerFlashProg.SetBlockProtection
      V_1_GetErrorStatus: start-on-event=GetErrorStatus, operation=PS_ConfigBlock.GetErrorStatus
      V_1_SetRamBlockStatus: start-on-event=SetRamBlockStatus, operation=PS_ConfigBlock.SetRamBlockStatus
      V_1_ReadBlock: start-on-event=ReadBlock, operation=PS_ConfigBlock.ReadBlock
      V_1_WriteBlock: start-on-event=WriteBlock, operation=PS_ConfigBlock.WriteBlock
      V_1_InvalidateNvBlock: start-on-event=InvalidateNvBlock, operation=PS_ConfigBlock.InvalidateNvBlock
      V_1_EraseBlock: start-on-event=EraseBlock, operation=PS_ConfigBlock.EraseBlock
      V_1_SetBlockProtection: start-on-event=SetBlockProtection, operation=PAdmin_ConfigBlock.SetBlockProtection
    port-api-option port=PS_Rte_NvmBlock_Polarity_Polarity_Cnt_Str:
      port-arg-values:
        integer literal NvM_ServiceBlockId_2: type=NvM_BlockIdType, value=2
    port-api-option port=PS_NVM_BLOCK_DIAGMGR_NTCSTRG:
      port-arg-values:
        integer literal NvM_ServiceBlockId_3: type=NvM_BlockIdType, value=3
    port-api-option port=PS_NVM_BLOCK_EPSDEFEATS:
      port-arg-values:
        integer literal NvM_ServiceBlockId_4: type=NvM_BlockIdType, value=4
    port-api-option port=PS_NvM_NVM_BLOCK_DEM:
      port-arg-values:
        integer literal NvM_ServiceBlockId_5: type=NvM_BlockIdType, value=5
    port-api-option port=PS_Rte_NvmBlock_StaMd_TypeHRamBuffer:
      port-arg-values:
        integer literal NvM_ServiceBlockId_6: type=NvM_BlockIdType, value=6
    port-api-option port=PS_Deprecated_NvmBlock_TrqCmdScl_TorqueCmdSF_Uls_f32:
      port-arg-values:
        integer literal NvM_ServiceBlockId_7: type=NvM_BlockIdType, value=7
    port-api-option port=PS_Deprecated_NvmBlock_CmMtrCurr_CurrTempOffset:
      port-arg-values:
        integer literal NvM_ServiceBlockId_8: type=NvM_BlockIdType, value=8
    port-api-option port=PS_Deprecated_NvmBlock_CmMtrCurr_ShCurrCal:
      port-arg-values:
        integer literal NvM_ServiceBlockId_9: type=NvM_BlockIdType, value=9
    port-api-option port=PS_Rte_NvmBlock_CurrParamComp_EOLNomMtrParam:
      port-arg-values:
        integer literal NvM_ServiceBlockId_10: type=NvM_BlockIdType, value=10
    port-api-option port=PS_Deprecated_NvmBlock_LrnEOT_LearnedEOT:
      port-arg-values:
        integer literal NvM_ServiceBlockId_11: type=NvM_BlockIdType, value=11
    port-api-option port=PS_Deprecated_NvmBlock_TrqCanc_CogTrqCal:
      port-arg-values:
        integer literal NvM_ServiceBlockId_12: type=NvM_BlockIdType, value=12
    port-api-option port=PS_NVM_BLOCK_CMS_NXTRMEC:
      port-arg-values:
        integer literal NvM_ServiceBlockId_13: type=NvM_BlockIdType, value=13
    port-api-option port=PS_NVM_BLOCK_CMS_ECUSRLNUM:
      port-arg-values:
        integer literal NvM_ServiceBlockId_14: type=NvM_BlockIdType, value=14
    port-api-option port=PS_NVM_BLOCK_CMS_EPSSRLNUM:
      port-arg-values:
        integer literal NvM_ServiceBlockId_15: type=NvM_BlockIdType, value=15
    port-api-option port=PS_NVM_BLOCK_CMS_ECUHWPN:
      port-arg-values:
        integer literal NvM_ServiceBlockId_16: type=NvM_BlockIdType, value=16
    port-api-option port=PS_NVM_BLOCK_CMS_NXTRMANUFSCRATCHPAD:
      port-arg-values:
        integer literal NvM_ServiceBlockId_17: type=NvM_BlockIdType, value=17
    port-api-option port=PS_NVM_BLOCK_CMS_IGNCNTR:
      port-arg-values:
        integer literal NvM_ServiceBlockId_18: type=NvM_BlockIdType, value=18
    port-api-option port=PS_Rte_NvmBlock_StaMd_CloseCheckData:
      port-arg-values:
        integer literal NvM_ServiceBlockId_19: type=NvM_BlockIdType, value=19
    port-api-option port=PS_NVM_BLOCK_DIAGMGR_BLACKBOX:
      port-arg-values:
        integer literal NvM_ServiceBlockId_20: type=NvM_BlockIdType, value=20
    port-api-option port=PS_Deprecated_NvmBlock_AvgFricLrn_AvgFricLrnData:
      port-arg-values:
        integer literal NvM_ServiceBlockId_21: type=NvM_BlockIdType, value=21
    port-api-option port=PS_Rte_NvmBlock_BatteryVoltage_OvervoltageData:
      port-arg-values:
        integer literal NvM_ServiceBlockId_22: type=NvM_BlockIdType, value=22
    port-api-option port=PS_Rte_NvmBlock_DigMSB_DigMSBEOLData:
      port-arg-values:
        integer literal NvM_ServiceBlockId_23: type=NvM_BlockIdType, value=23
    port-api-option port=PS_Deprecated_NvmBlock_DigHwTrqSENT_DigTrqTrim:
      port-arg-values:
        integer literal NvM_ServiceBlockId_24: type=NvM_BlockIdType, value=24
    port-api-option port=PS_Deprecated_NvmBlock_AbsHwPos_EOLVehCntrOffset:
      port-arg-values:
        integer literal NvM_ServiceBlockId_25: type=NvM_BlockIdType, value=25
    port-api-option port=PS_Rte_NvmBlock_DiagSvc_TuningSetSelectData:
      port-arg-values:
        integer literal NvM_ServiceBlockId_26: type=NvM_BlockIdType, value=26
    port-api-option port=PS_Deprecated_NvmBlock_AbsHwPos_EOLVehCntrOffset1:
      port-arg-values:
        integer literal NvM_ServiceBlockId_27: type=NvM_BlockIdType, value=27
    port-api-option port=PS_Deprecated_NvmBlock_TrqCanc_CogTrqRplComp:
      port-arg-values:
        integer literal NvM_ServiceBlockId_28: type=NvM_BlockIdType, value=28
    port-api-option port=PS_Deprecated_NvmBlock_AstLmt_SteerAsstDefeat:
      port-arg-values:
        integer literal NvM_ServiceBlockId_29: type=NvM_BlockIdType, value=29
    port-api-option port=PS_Rte_NvmBlock_ThrmlDutyCycle_ThrmlDutyCycle_FltStVal:
      port-arg-values:
        integer literal NvM_ServiceBlockId_30: type=NvM_BlockIdType, value=30
    port-api-option port=PS_NVM_BLOCK_DIAGMGR_LATCHCNTRS:
      port-arg-values:
        integer literal NvM_ServiceBlockId_31: type=NvM_BlockIdType, value=31
    port-api-option port=PS_Rte_NvmBlock_LrnEOT_LearnedEOT:
      port-arg-values:
        integer literal NvM_ServiceBlockId_32: type=NvM_BlockIdType, value=32
    port-api-option port=PS_Rte_NvmBlock_AvgFricLrn_AvgFricLrnData:
      port-arg-values:
        integer literal NvM_ServiceBlockId_33: type=NvM_BlockIdType, value=33
    port-api-option port=PS_Rte_NvmBlock_DigHwTrqSENT_DigTrqTrim:
      port-arg-values:
        integer literal NvM_ServiceBlockId_34: type=NvM_BlockIdType, value=34
    port-api-option port=PS_Rte_NvmBlock_CmMtrCurr_CurrTempOffset:
      port-arg-values:
        integer literal NvM_ServiceBlockId_35: type=NvM_BlockIdType, value=35
    port-api-option port=PS_Rte_NvmBlock_CmMtrCurr_ShCurrCal:
      port-arg-values:
        integer literal NvM_ServiceBlockId_36: type=NvM_BlockIdType, value=36
    port-api-option port=PS_Rte_NvmBlock_TrqCanc_CogTrqCal:
      port-arg-values:
        integer literal NvM_ServiceBlockId_37: type=NvM_BlockIdType, value=37
    port-api-option port=PS_Rte_NvmBlock_TrqCanc_CogTrqRplComp:
      port-arg-values:
        integer literal NvM_ServiceBlockId_38: type=NvM_BlockIdType, value=38
    port-api-option port=PS_Rte_NvmBlock_AstLmt_SteerAsstDefeat:
      port-arg-values:
        integer literal NvM_ServiceBlockId_39: type=NvM_BlockIdType, value=39
    port-api-option port=PS_Rte_NvmBlock_TrqCmdScl_TorqueCmdSF_Uls_f32:
      port-arg-values:
        integer literal NvM_ServiceBlockId_40: type=NvM_BlockIdType, value=40
    port-api-option port=PS_Rte_NvmBlock_AbsHwPos_EOLVehCntrOffset:
      port-arg-values:
        integer literal NvM_ServiceBlockId_41: type=NvM_BlockIdType, value=41
    port-api-option port=PS_Rte_NvmBlock_VehDyn_MotPosReset:
      port-arg-values:
        integer literal NvM_ServiceBlockId_44: type=NvM_BlockIdType, value=44
    port-api-option port=PS_Rte_NvmBlock_DiagSvc_BootSwFingerPrint:
      port-arg-values:
        integer literal NvM_ServiceBlockId_45: type=NvM_BlockIdType, value=45
    port-api-option port=PS_Rte_NvmBlock_DiagSvc_AppSwFingerPrint:
      port-arg-values:
        integer literal NvM_ServiceBlockId_46: type=NvM_BlockIdType, value=46
    port-api-option port=PS_Rte_NvmBlock_DiagSvc_ECUSparePartNo:
      port-arg-values:
        integer literal NvM_ServiceBlockId_48: type=NvM_BlockIdType, value=48
    port-api-option port=PS_Rte_NvmBlock_DiagSvc_VINCurrent:
      port-arg-values:
        integer literal NvM_ServiceBlockId_51: type=NvM_BlockIdType, value=51
    port-api-option port=PS_Rte_NvmBlock_DiagSvc_EraseRoutineStatus:
      port-arg-values:
        integer literal NvM_ServiceBlockId_57: type=NvM_BlockIdType, value=57
    port-api-option port=PS_Rte_NvmBlock_DiagSvc_ProgrammingStatus:
      port-arg-values:
        integer literal NvM_ServiceBlockId_58: type=NvM_BlockIdType, value=58
    port-api-option port=PS_Rte_NvmBlock_Sa_DigColPs_DigColPsEOL:
      port-arg-values:
        integer literal NvM_ServiceBlockId_67: type=NvM_BlockIdType, value=67
    port-api-option port=PS_Deprecated_Rte_NvmBlock_DiagSvc_ProxiConfigurationData:
      port-arg-values:
        integer literal NvM_ServiceBlockId_79: type=NvM_BlockIdType, value=79
    port-api-option port=PS_Rte_NvmBlock_DiagSvc_ProxiConfigurationData:
      port-arg-values:
        integer literal NvM_ServiceBlockId_92: type=NvM_BlockIdType, value=92
    port-api-option port=PS_Rte_NvmBlock_DiagSvc_ProxiCounter:
      port-arg-values:
        integer literal NvM_ServiceBlockId_93: type=NvM_BlockIdType, value=93
    port-api-option port=PS_Rte_NvmBlock_DiagSvc_CalSwFingerPrint:
      port-arg-values:
        integer literal NvM_ServiceBlockId_94: type=NvM_BlockIdType, value=94
    port-api-option port=PS_Rte_NvmBlock_DiagSvc_ECULifeTimeMins:
      port-arg-values:
        integer literal NvM_ServiceBlockId_95: type=NvM_BlockIdType, value=95
    port-api-option port=PS_Rte_NvmBlock_DiagSvc_FirstDTCDetectMins:
      port-arg-values:
        integer literal NvM_ServiceBlockId_96: type=NvM_BlockIdType, value=96
    port-api-option port=PS_Rte_NvmBlock_DiagSvc_FirstDTCDetectSecs:
      port-arg-values:
        integer literal NvM_ServiceBlockId_97: type=NvM_BlockIdType, value=97
    port-api-option port=PS_Rte_NvmBlock_DiagSvc_EOLConfigData:
      port-arg-values:
        integer literal NvM_ServiceBlockId_98: type=NvM_BlockIdType, value=98
    port-api-option port=PS_Rte_NvmBlock_DiagSvc_ProgAttemptsCounter:
      port-arg-values:
        integer literal NvM_ServiceBlockId_99: type=NvM_BlockIdType, value=99
    port-api-option port=PS_Rte_NvmBlock_DiagSvc_VINOriginal:
      port-arg-values:
        integer literal NvM_ServiceBlockId_100: type=NvM_BlockIdType, value=100
    port-api-option port=PS_Rte_NvmBlock_DiagSvc_ECUSerialNumber:
      port-arg-values:
        integer literal NvM_ServiceBlockId_101: type=NvM_BlockIdType, value=101
    port-api-option port=PS_Rte_NvmBlock_DiagSvc_TotalOdometer:
      port-arg-values:
        integer literal NvM_ServiceBlockId_102: type=NvM_BlockIdType, value=102
    port-api-option port=PS_Rte_NvmBlock_DiagSvc_OdometerFlashProg:
      port-arg-values:
        integer literal NvM_ServiceBlockId_103: type=NvM_BlockIdType, value=103
    port-api-option port=PS_ConfigBlock:
      port-arg-values:
        integer literal NvM_ServiceBlockId_1: type=NvM_BlockIdType, value=1
    port-api-option port=PAdmin_Rte_NvmBlock_Polarity_Polarity_Cnt_Str:
      port-arg-values:
        integer literal NvM_AdminBlockId_2: type=NvM_BlockIdType, value=2
    port-api-option port=PAdmin_NVM_BLOCK_DIAGMGR_NTCSTRG:
      port-arg-values:
        integer literal NvM_AdminBlockId_3: type=NvM_BlockIdType, value=3
    port-api-option port=PAdmin_NVM_BLOCK_EPSDEFEATS:
      port-arg-values:
        integer literal NvM_AdminBlockId_4: type=NvM_BlockIdType, value=4
    port-api-option port=PAdmin_NvM_NVM_BLOCK_DEM:
      port-arg-values:
        integer literal NvM_AdminBlockId_5: type=NvM_BlockIdType, value=5
    port-api-option port=PAdmin_Rte_NvmBlock_StaMd_TypeHRamBuffer:
      port-arg-values:
        integer literal NvM_AdminBlockId_6: type=NvM_BlockIdType, value=6
    port-api-option port=PAdmin_Deprecated_NvmBlock_TrqCmdScl_TorqueCmdSF_Uls_f32:
      port-arg-values:
        integer literal NvM_AdminBlockId_7: type=NvM_BlockIdType, value=7
    port-api-option port=PAdmin_Deprecated_NvmBlock_CmMtrCurr_CurrTempOffset:
      port-arg-values:
        integer literal NvM_AdminBlockId_8: type=NvM_BlockIdType, value=8
    port-api-option port=PAdmin_Deprecated_NvmBlock_CmMtrCurr_ShCurrCal:
      port-arg-values:
        integer literal NvM_AdminBlockId_9: type=NvM_BlockIdType, value=9
    port-api-option port=PAdmin_Rte_NvmBlock_CurrParamComp_EOLNomMtrParam:
      port-arg-values:
        integer literal NvM_AdminBlockId_10: type=NvM_BlockIdType, value=10
    port-api-option port=PAdmin_Deprecated_NvmBlock_LrnEOT_LearnedEOT:
      port-arg-values:
        integer literal NvM_AdminBlockId_11: type=NvM_BlockIdType, value=11
    port-api-option port=PAdmin_Deprecated_NvmBlock_TrqCanc_CogTrqCal:
      port-arg-values:
        integer literal NvM_AdminBlockId_12: type=NvM_BlockIdType, value=12
    port-api-option port=PAdmin_NVM_BLOCK_CMS_NXTRMEC:
      port-arg-values:
        integer literal NvM_AdminBlockId_13: type=NvM_BlockIdType, value=13
    port-api-option port=PAdmin_NVM_BLOCK_CMS_ECUSRLNUM:
      port-arg-values:
        integer literal NvM_AdminBlockId_14: type=NvM_BlockIdType, value=14
    port-api-option port=PAdmin_NVM_BLOCK_CMS_EPSSRLNUM:
      port-arg-values:
        integer literal NvM_AdminBlockId_15: type=NvM_BlockIdType, value=15
    port-api-option port=PAdmin_NVM_BLOCK_CMS_ECUHWPN:
      port-arg-values:
        integer literal NvM_AdminBlockId_16: type=NvM_BlockIdType, value=16
    port-api-option port=PAdmin_NVM_BLOCK_CMS_NXTRMANUFSCRATCHPAD:
      port-arg-values:
        integer literal NvM_AdminBlockId_17: type=NvM_BlockIdType, value=17
    port-api-option port=PAdmin_NVM_BLOCK_CMS_IGNCNTR:
      port-arg-values:
        integer literal NvM_AdminBlockId_18: type=NvM_BlockIdType, value=18
    port-api-option port=PAdmin_Rte_NvmBlock_StaMd_CloseCheckData:
      port-arg-values:
        integer literal NvM_AdminBlockId_19: type=NvM_BlockIdType, value=19
    port-api-option port=PAdmin_NVM_BLOCK_DIAGMGR_BLACKBOX:
      port-arg-values:
        integer literal NvM_AdminBlockId_20: type=NvM_BlockIdType, value=20
    port-api-option port=PAdmin_Deprecated_NvmBlock_AvgFricLrn_AvgFricLrnData:
      port-arg-values:
        integer literal NvM_AdminBlockId_21: type=NvM_BlockIdType, value=21
    port-api-option port=PAdmin_Rte_NvmBlock_BatteryVoltage_OvervoltageData:
      port-arg-values:
        integer literal NvM_AdminBlockId_22: type=NvM_BlockIdType, value=22
    port-api-option port=PAdmin_Rte_NvmBlock_DigMSB_DigMSBEOLData:
      port-arg-values:
        integer literal NvM_AdminBlockId_23: type=NvM_BlockIdType, value=23
    port-api-option port=PAdmin_Deprecated_NvmBlock_DigHwTrqSENT_DigTrqTrim:
      port-arg-values:
        integer literal NvM_AdminBlockId_24: type=NvM_BlockIdType, value=24
    port-api-option port=PAdmin_Deprecated_NvmBlock_AbsHwPos_EOLVehCntrOffset:
      port-arg-values:
        integer literal NvM_AdminBlockId_25: type=NvM_BlockIdType, value=25
    port-api-option port=PAdmin_Rte_NvmBlock_DiagSvc_TuningSetSelectData:
      port-arg-values:
        integer literal NvM_AdminBlockId_26: type=NvM_BlockIdType, value=26
    port-api-option port=PAdmin_Deprecated_NvmBlock_AbsHwPos_EOLVehCntrOffset1:
      port-arg-values:
        integer literal NvM_AdminBlockId_27: type=NvM_BlockIdType, value=27
    port-api-option port=PAdmin_Deprecated_NvmBlock_TrqCanc_CogTrqRplComp:
      port-arg-values:
        integer literal NvM_AdminBlockId_28: type=NvM_BlockIdType, value=28
    port-api-option port=PAdmin_Deprecated_NvmBlock_AstLmt_SteerAsstDefeat:
      port-arg-values:
        integer literal NvM_AdminBlockId_29: type=NvM_BlockIdType, value=29
    port-api-option port=PAdmin_Rte_NvmBlock_ThrmlDutyCycle_ThrmlDutyCycle_FltStVal:
      port-arg-values:
        integer literal NvM_AdminBlockId_30: type=NvM_BlockIdType, value=30
    port-api-option port=PAdmin_NVM_BLOCK_DIAGMGR_LATCHCNTRS:
      port-arg-values:
        integer literal NvM_AdminBlockId_31: type=NvM_BlockIdType, value=31
    port-api-option port=PAdmin_Rte_NvmBlock_LrnEOT_LearnedEOT:
      port-arg-values:
        integer literal NvM_AdminBlockId_32: type=NvM_BlockIdType, value=32
    port-api-option port=PAdmin_Rte_NvmBlock_AvgFricLrn_AvgFricLrnData:
      port-arg-values:
        integer literal NvM_AdminBlockId_33: type=NvM_BlockIdType, value=33
    port-api-option port=PAdmin_Rte_NvmBlock_DigHwTrqSENT_DigTrqTrim:
      port-arg-values:
        integer literal NvM_AdminBlockId_34: type=NvM_BlockIdType, value=34
    port-api-option port=PAdmin_Rte_NvmBlock_CmMtrCurr_CurrTempOffset:
      port-arg-values:
        integer literal NvM_AdminBlockId_35: type=NvM_BlockIdType, value=35
    port-api-option port=PAdmin_Rte_NvmBlock_CmMtrCurr_ShCurrCal:
      port-arg-values:
        integer literal NvM_AdminBlockId_36: type=NvM_BlockIdType, value=36
    port-api-option port=PAdmin_Rte_NvmBlock_TrqCanc_CogTrqCal:
      port-arg-values:
        integer literal NvM_AdminBlockId_37: type=NvM_BlockIdType, value=37
    port-api-option port=PAdmin_Rte_NvmBlock_TrqCanc_CogTrqRplComp:
      port-arg-values:
        integer literal NvM_AdminBlockId_38: type=NvM_BlockIdType, value=38
    port-api-option port=PAdmin_Rte_NvmBlock_AstLmt_SteerAsstDefeat:
      port-arg-values:
        integer literal NvM_AdminBlockId_39: type=NvM_BlockIdType, value=39
    port-api-option port=PAdmin_Rte_NvmBlock_TrqCmdScl_TorqueCmdSF_Uls_f32:
      port-arg-values:
        integer literal NvM_AdminBlockId_40: type=NvM_BlockIdType, value=40
    port-api-option port=PAdmin_Rte_NvmBlock_AbsHwPos_EOLVehCntrOffset:
      port-arg-values:
        integer literal NvM_AdminBlockId_41: type=NvM_BlockIdType, value=41
    port-api-option port=PAdmin_Rte_NvmBlock_VehDyn_MotPosReset:
      port-arg-values:
        integer literal NvM_AdminBlockId_44: type=NvM_BlockIdType, value=44
    port-api-option port=PAdmin_Rte_NvmBlock_DiagSvc_BootSwFingerPrint:
      port-arg-values:
        integer literal NvM_AdminBlockId_45: type=NvM_BlockIdType, value=45
    port-api-option port=PAdmin_Rte_NvmBlock_DiagSvc_AppSwFingerPrint:
      port-arg-values:
        integer literal NvM_AdminBlockId_46: type=NvM_BlockIdType, value=46
    port-api-option port=PAdmin_Rte_NvmBlock_DiagSvc_ECUSparePartNo:
      port-arg-values:
        integer literal NvM_AdminBlockId_48: type=NvM_BlockIdType, value=48
    port-api-option port=PAdmin_Rte_NvmBlock_DiagSvc_VINCurrent:
      port-arg-values:
        integer literal NvM_AdminBlockId_51: type=NvM_BlockIdType, value=51
    port-api-option port=PAdmin_Rte_NvmBlock_DiagSvc_EraseRoutineStatus:
      port-arg-values:
        integer literal NvM_AdminBlockId_57: type=NvM_BlockIdType, value=57
    port-api-option port=PAdmin_Rte_NvmBlock_DiagSvc_ProgrammingStatus:
      port-arg-values:
        integer literal NvM_AdminBlockId_58: type=NvM_BlockIdType, value=58
    port-api-option port=PAdmin_Rte_NvmBlock_Sa_DigColPs_DigColPsEOL:
      port-arg-values:
        integer literal NvM_AdminBlockId_67: type=NvM_BlockIdType, value=67
    port-api-option port=PAdmin_Deprecated_Rte_NvmBlock_DiagSvc_ProxiConfigurationData:
      port-arg-values:
        integer literal NvM_AdminBlockId_79: type=NvM_BlockIdType, value=79
    port-api-option port=PAdmin_Rte_NvmBlock_DiagSvc_ProxiConfigurationData:
      port-arg-values:
        integer literal NvM_AdminBlockId_92: type=NvM_BlockIdType, value=92
    port-api-option port=PAdmin_Rte_NvmBlock_DiagSvc_ProxiCounter:
      port-arg-values:
        integer literal NvM_AdminBlockId_93: type=NvM_BlockIdType, value=93
    port-api-option port=PAdmin_Rte_NvmBlock_DiagSvc_CalSwFingerPrint:
      port-arg-values:
        integer literal NvM_AdminBlockId_94: type=NvM_BlockIdType, value=94
    port-api-option port=PAdmin_Rte_NvmBlock_DiagSvc_ECULifeTimeMins:
      port-arg-values:
        integer literal NvM_AdminBlockId_95: type=NvM_BlockIdType, value=95
    port-api-option port=PAdmin_Rte_NvmBlock_DiagSvc_FirstDTCDetectMins:
      port-arg-values:
        integer literal NvM_AdminBlockId_96: type=NvM_BlockIdType, value=96
    port-api-option port=PAdmin_Rte_NvmBlock_DiagSvc_FirstDTCDetectSecs:
      port-arg-values:
        integer literal NvM_AdminBlockId_97: type=NvM_BlockIdType, value=97
    port-api-option port=PAdmin_Rte_NvmBlock_DiagSvc_EOLConfigData:
      port-arg-values:
        integer literal NvM_AdminBlockId_98: type=NvM_BlockIdType, value=98
    port-api-option port=PAdmin_Rte_NvmBlock_DiagSvc_ProgAttemptsCounter:
      port-arg-values:
        integer literal NvM_AdminBlockId_99: type=NvM_BlockIdType, value=99
    port-api-option port=PAdmin_Rte_NvmBlock_DiagSvc_VINOriginal:
      port-arg-values:
        integer literal NvM_AdminBlockId_100: type=NvM_BlockIdType, value=100
    port-api-option port=PAdmin_Rte_NvmBlock_DiagSvc_ECUSerialNumber:
      port-arg-values:
        integer literal NvM_AdminBlockId_101: type=NvM_BlockIdType, value=101
    port-api-option port=PAdmin_Rte_NvmBlock_DiagSvc_TotalOdometer:
      port-arg-values:
        integer literal NvM_AdminBlockId_102: type=NvM_BlockIdType, value=102
    port-api-option port=PAdmin_Rte_NvmBlock_DiagSvc_OdometerFlashProg:
      port-arg-values:
        integer literal NvM_AdminBlockId_103: type=NvM_BlockIdType, value=103
    port-api-option port=PAdmin_ConfigBlock:
      port-arg-values:
        integer literal NvM_AdminBlockId_1: type=NvM_BlockIdType, value=1
    8 x runnable, all with can-be-invoked-concurrently=true:
      GetErrorStatus: symbol=NvM_GetErrorStatus
      SetRamBlockStatus: symbol=NvM_SetRamBlockStatus
      ReadBlock: symbol=NvM_ReadBlock
      WriteBlock: symbol=NvM_WriteBlock
      RestoreBlockDefaults: symbol=NvM_RestoreBlockDefaults
      InvalidateNvBlock: symbol=NvM_InvalidateNvBlock
      EraseBlock: symbol=NvM_EraseNvBlock
      SetBlockProtection: symbol=NvM_SetBlockProtection
package /PortInterface
  client server interface NvM_Administration: is-service=true
    operation SetBlockProtection
      arg ProtectionEnabled: type=Boolean, direction=IN
  client server interface NvM_AC3_SRBS_Srv: is-service=true  # NvmService_NvmApiConfigClass3 | Port Interface for NVRAM Blocks of Management Types "NATIVE" or "REDUNDANT" without default values.
    6 x operation:
      GetErrorStatus
        arg ErrorStatus: type=NvM_RequestResultType, direction=OUT
      SetRamBlockStatus
        arg RamBlockStatus: type=Boolean, direction=IN
      ReadBlock: possible-error=NvM_AC3_SRBS_Srv/E_NOT_OK
        arg DstPtr: type=NvM_DestPtr, direction=OUT
      WriteBlock: possible-error=NvM_AC3_SRBS_Srv/E_NOT_OK
        arg DstPtr: type=NvM_DestPtr, direction=IN
      EraseBlock: possible-error=NvM_AC3_SRBS_Srv/E_NOT_OK
      InvalidateNvBlock: possible-error=NvM_AC3_SRBS_Srv/E_NOT_OK
    error E_NOT_OK: error-code=1
  client server interface NvM_AC3_SRBS_Srv_Defs: is-service=true  # NvmService_NvmApiConfigClass3_HasRomDefaults | Port Interface for NVRAM Blocks of Management Types "NATIVE" or "REDUNDANT" with default values.
    7 x operation:
      GetErrorStatus
        arg ErrorStatus: type=NvM_RequestResultType, direction=OUT
      SetRamBlockStatus
        arg RamBlockStatus: type=Boolean, direction=IN
      ReadBlock: possible-error=NvM_AC3_SRBS_Srv_Defs/E_NOT_OK
        arg DstPtr: type=NvM_DestPtr, direction=OUT
      WriteBlock: possible-error=NvM_AC3_SRBS_Srv_Defs/E_NOT_OK
        arg DstPtr: type=NvM_DestPtr, direction=IN
      RestoreBlockDefaults: possible-error=NvM_AC3_SRBS_Srv_Defs/E_NOT_OK
        arg DstPtr: type=NvM_DestPtr, direction=OUT
      EraseBlock: possible-error=NvM_AC3_SRBS_Srv_Defs/E_NOT_OK
      InvalidateNvBlock: possible-error=NvM_AC3_SRBS_Srv_Defs/E_NOT_OK
    error E_NOT_OK: error-code=1
package /DataTypes
  integer type NvM_BlockIdType: lower-limit=1, upper-limit=32767  # It is the type to be used in the "Port Defined Arguments". According to the NVM API it must result in an uint16 data type; thus the upper limit does not correspond to the number of configured blocks. Therefore the this type is common to all NVM SWC Descriptions. The upper limit is the theoretical maximum number of NVRAM blocks, if NVM_DATASET_SELECTION_BITS equals to 1. (It cannot be 0 since block Id 1 is fixed to be a REDUNDANT NVRAM Block - it consists of two NV blocks)
  integer type NvM_RequestResultType: compu {0=NVM_REQ_OK, 1=NVM_REQ_NOT_OK, 2=NVM_REQ_PENDING, 3=NVM_REQ_INTEGRITY_FAILED, 4=NVM_REQ_BLOCK_SKIPPED, 5=NVM_REQ_NV_INVALIDATED}, lower-limit=0, upper-limit=5
  array type NvM_DestPtr  # DataPtr Type to be used by WriteBlock, ReadBlock and RestoreBlockDefaults operations. This type is used for all NVRAM blocks
    element NvM_DestPtr_BaseType: type=UInt8, max-number-of-elements=65535
