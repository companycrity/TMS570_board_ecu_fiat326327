AUTOSAR XML (schema 314)
package /ComponentType
  internal behavior ComM_InternalBehavior: component=ComM
    timing event TMT_ComM_MainFunction_0: start-on-event=ComM_MainFunction_0, period=0.01
    11 x operation invoked event:
      OIT_GetCurrentComMode_UR_ComMUser_CCAN_GetCurrentComMode: start-on-event=GetCurrentComMode, operation=UR_ComMUser_CCAN.GetCurrentComMode
      OIT_GetInhibitionStatus_CL_CCAN_GetInhibitionStatus: start-on-event=GetInhibitionStatus, operation=CL_CCAN.GetInhibitionStatus
      OIT_GetMaxComMode_UR_ComMUser_CCAN_GetMaxComMode: start-on-event=GetMaxComMode, operation=UR_ComMUser_CCAN.GetMaxComMode
      OIT_GetRequestedMode_UR_ComMUser_CCAN_GetRequestedMode: start-on-event=GetRequestedMode, operation=UR_ComMUser_CCAN.GetRequestedMode
      OIT_LimitChannelToNoComMode_CL_CCAN_LimitChannelToNoComMode: start-on-event=LimitChannelToNoComMode, operation=CL_CCAN.LimitChannelToNoComMode
      OIT_LimitECUToNoComMode_modeLimitation_LimitECUToNoComMode: start-on-event=LimitECUToNoComMode, operation=modeLimitation.LimitECUToNoComMode
      OIT_PreventWakeUp_CW_CCAN_PreventWakeUp: start-on-event=PreventWakeUp, operation=CW_CCAN.PreventWakeUp
      OIT_ReadInhibitCounter_modeLimitation_ReadInhibitCounter: start-on-event=ReadInhibitCounter, operation=modeLimitation.ReadInhibitCounter
      OIT_RequestComMode_UR_ComMUser_CCAN_RequestComMode: start-on-event=RequestComMode, operation=UR_ComMUser_CCAN.RequestComMode
      OIT_ResetInhibitCounter_modeLimitation_ResetInhibitCounter: start-on-event=ResetInhibitCounter, operation=modeLimitation.ResetInhibitCounter
      OIT_SetECUGroupClassification_modeLimitation_SetECUGroupClassification: start-on-event=SetECUGroupClassification, operation=modeLimitation.SetECUGroupClassification
    port-api-options port-api-option={enable-take-address=true, indirect-api=false, port=modeLimitation}:
      port-api-option enable-take-address=true, indirect-api=false, port=CL_CCAN:
        port-arg-values:
          integer literal CL_CCAN: type=ComM_NetworkHandleType, value=0
      port-api-option enable-take-address=true, indirect-api=false, port=CW_CCAN:
        port-arg-values:
          integer literal CW_CCAN: type=ComM_NetworkHandleType, value=0
      port-api-option enable-take-address=true, indirect-api=false, port=UR_ComMUser_CCAN:
        port-arg-values:
          integer literal UR_ComMUser_CCAN: type=ComM_UserHandleType, value=0
    12 x runnable, all with can-be-invoked-concurrently=true:
      ComM_MainFunction_0
      GetCurrentComMode: symbol=ComM_GetCurrentComMode
      GetInhibitionStatus: symbol=ComM_GetInhibitionStatus
      GetMaxComMode: symbol=ComM_GetMaxComMode
      GetRequestedMode: symbol=ComM_GetRequestedComMode
      LimitChannelToNoComMode: symbol=ComM_ServiceLimitChannelToNoComMode
      LimitECUToNoComMode: symbol=ComM_LimitECUToNoComMode
      PreventWakeUp: symbol=ComM_ServicePreventWakeUp
      ReadInhibitCounter: symbol=ComM_ReadInhibitCounter
      RequestComMode: symbol=ComM_RequestComMode
      ResetInhibitCounter: symbol=ComM_ResetInhibitCounter
      SetECUGroupClassification: symbol=ComM_SetECUGroupClassification
  service component type ComM: category=ServiceComponent
    4 x provide port:
      CL_CCAN: provided-com-specs=[{operation=GetInhibitionStatus, queue-length=1}, {operation=LimitChannelToNoComMode, queue-length=1}], provided-interface=ComM_ChannelLimitation
      CW_CCAN: server-com-spec{operation=PreventWakeUp, queue-length=1}, provided-interface=ComM_ChannelWakeUp
      modeLimitation: provided-interface=ComM_ECUModeLimitation
        provided-com-specs:
          operation=LimitECUToNoComMode, queue-length=1
          operation=ReadInhibitCounter, queue-length=1
          operation=ResetInhibitCounter, queue-length=1
          operation=SetECUGroupClassification, queue-length=1
      UR_ComMUser_CCAN: provided-interface=ComM_UserRequest
        provided-com-specs:
          operation=GetCurrentComMode, queue-length=1
          operation=GetMaxComMode, queue-length=1
          operation=GetRequestedMode, queue-length=1
          operation=RequestComMode, queue-length=1
  swc implementation ComM_Implementation: behavior=ComM_InternalBehavior
    code-descriptors:
      code Code: type=SRC
