AUTOSAR XML (schema 314)
package /ComponentType
  internal behavior Dem_InternalBehavior: component=Dem
    39 x operation invoked event, all with start-on-event=ClearPrestoredFreezeFrame:
      OIT_ClearPrestoredFreezeFrame_Event_DTC_0x500386_ClearPrestoredFreezeFrame: operation=Event_DTC_0x500386.ClearPrestoredFreezeFrame
      OIT_ClearPrestoredFreezeFrame_Event_DTC_0x500568_ClearPrestoredFreezeFrame: operation=Event_DTC_0x500568.ClearPrestoredFreezeFrame
      OIT_ClearPrestoredFreezeFrame_Event_DTC_0x500909_ClearPrestoredFreezeFrame: operation=Event_DTC_0x500909.ClearPrestoredFreezeFrame
      OIT_ClearPrestoredFreezeFrame_Event_DTC_0x52192f_ClearPrestoredFreezeFrame: operation=Event_DTC_0x52192f.ClearPrestoredFreezeFrame
      OIT_ClearPrestoredFreezeFrame_Event_DTC_0x521a54_ClearPrestoredFreezeFrame: operation=Event_DTC_0x521a54.ClearPrestoredFreezeFrame
      OIT_ClearPrestoredFreezeFrame_Event_DTC_0x559201_ClearPrestoredFreezeFrame: operation=Event_DTC_0x559201.ClearPrestoredFreezeFrame
      OIT_ClearPrestoredFreezeFrame_Event_DTC_0x{559211..559213}_ClearPrestoredFreezeFrame: operation=Event_DTC_0x{559211..559213}.ClearPrestoredFreezeFrame
      OIT_ClearPrestoredFreezeFrame_Event_DTC_0x559219_ClearPrestoredFreezeFrame: operation=Event_DTC_0x559219.ClearPrestoredFreezeFrame
      OIT_ClearPrestoredFreezeFrame_Event_DTC_0x{559311..559313}_ClearPrestoredFreezeFrame: operation=Event_DTC_0x{559311..559313}.ClearPrestoredFreezeFrame
      OIT_ClearPrestoredFreezeFrame_Event_DTC_0x559349_ClearPrestoredFreezeFrame: operation=Event_DTC_0x559349.ClearPrestoredFreezeFrame
      OIT_ClearPrestoredFreezeFrame_Event_DTC_0x620525_ClearPrestoredFreezeFrame: operation=Event_DTC_0x620525.ClearPrestoredFreezeFrame
      OIT_ClearPrestoredFreezeFrame_Event_DTC_0x621068_ClearPrestoredFreezeFrame: operation=Event_DTC_0x621068.ClearPrestoredFreezeFrame
      OIT_ClearPrestoredFreezeFrame_Event_DTC_0x621098_ClearPrestoredFreezeFrame: operation=Event_DTC_0x621098.ClearPrestoredFreezeFrame
      OIT_ClearPrestoredFreezeFrame_Event_DTC_0x621748_ClearPrestoredFreezeFrame: operation=Event_DTC_0x621748.ClearPrestoredFreezeFrame
      OIT_ClearPrestoredFreezeFrame_Event_DTC_0x621749_ClearPrestoredFreezeFrame: operation=Event_DTC_0x621749.ClearPrestoredFreezeFrame
      OIT_ClearPrestoredFreezeFrame_Event_DTC_0xa19916_ClearPrestoredFreezeFrame: operation=Event_DTC_0xa19916.ClearPrestoredFreezeFrame
      OIT_ClearPrestoredFreezeFrame_Event_DTC_0xa19917_ClearPrestoredFreezeFrame: operation=Event_DTC_0xa19917.ClearPrestoredFreezeFrame
      OIT_ClearPrestoredFreezeFrame_Event_DTC_0xa1991c_ClearPrestoredFreezeFrame: operation=Event_DTC_0xa1991c.ClearPrestoredFreezeFrame
      OIT_ClearPrestoredFreezeFrame_Event_DTC_0xa22c51_ClearPrestoredFreezeFrame: operation=Event_DTC_0xa22c51.ClearPrestoredFreezeFrame
      OIT_ClearPrestoredFreezeFrame_Event_DTC_0xa23b05_ClearPrestoredFreezeFrame: operation=Event_DTC_0xa23b05.ClearPrestoredFreezeFrame
      OIT_ClearPrestoredFreezeFrame_Event_DTC_0xc00187_ClearPrestoredFreezeFrame: operation=Event_DTC_0xc00187.ClearPrestoredFreezeFrame
      OIT_ClearPrestoredFreezeFrame_Event_DTC_0xc00188_ClearPrestoredFreezeFrame: operation=Event_DTC_0xc00188.ClearPrestoredFreezeFrame
      OIT_ClearPrestoredFreezeFrame_Event_DTC_0xc10087_ClearPrestoredFreezeFrame: operation=Event_DTC_0xc10087.ClearPrestoredFreezeFrame
      OIT_ClearPrestoredFreezeFrame_Event_DTC_0xc4012f_ClearPrestoredFreezeFrame: operation=Event_DTC_0xc4012f.ClearPrestoredFreezeFrame
      OIT_ClearPrestoredFreezeFrame_Event_DTC_0xc4152f_ClearPrestoredFreezeFrame: operation=Event_DTC_0xc4152f.ClearPrestoredFreezeFrame
      OIT_ClearPrestoredFreezeFrame_Event_DTC_0xc4222f_ClearPrestoredFreezeFrame: operation=Event_DTC_0xc4222f.ClearPrestoredFreezeFrame
      OIT_ClearPrestoredFreezeFrame_Event_DTC_0xc4232f_ClearPrestoredFreezeFrame: operation=Event_DTC_0xc4232f.ClearPrestoredFreezeFrame
      OIT_ClearPrestoredFreezeFrame_Event_DTC_0xd00587_ClearPrestoredFreezeFrame: operation=Event_DTC_0xd00587.ClearPrestoredFreezeFrame
      OIT_ClearPrestoredFreezeFrame_Event_DTC_0xd00687_ClearPrestoredFreezeFrame: operation=Event_DTC_0xd00687.ClearPrestoredFreezeFrame
      OIT_ClearPrestoredFreezeFrame_Event_DTC_0xd00787_ClearPrestoredFreezeFrame: operation=Event_DTC_0xd00787.ClearPrestoredFreezeFrame
      OIT_ClearPrestoredFreezeFrame_Event_DTC_0xd01087_ClearPrestoredFreezeFrame: operation=Event_DTC_0xd01087.ClearPrestoredFreezeFrame
      OIT_ClearPrestoredFreezeFrame_Event_DTC_0xd01187_ClearPrestoredFreezeFrame: operation=Event_DTC_0xd01187.ClearPrestoredFreezeFrame
      OIT_ClearPrestoredFreezeFrame_Event_DTC_0xd01387_ClearPrestoredFreezeFrame: operation=Event_DTC_0xd01387.ClearPrestoredFreezeFrame
      OIT_ClearPrestoredFreezeFrame_Event_DTC_0xd93286_ClearPrestoredFreezeFrame: operation=Event_DTC_0xd93286.ClearPrestoredFreezeFrame
      OIT_ClearPrestoredFreezeFrame_Event_DTC_0xd95283_ClearPrestoredFreezeFrame: operation=Event_DTC_0xd95283.ClearPrestoredFreezeFrame
    timing event TMT_Dem_MainFunction: start-on-event=Dem_MainFunction, period=0.01
    427 x operation invoked event:
      OIT_GetDTCOfEvent_Event_DTC_0x500386_GetDTCOfEvent: start-on-event=GetDTCOfEvent, operation=Event_DTC_0x500386.GetDTCOfEvent
      OIT_GetDTCOfEvent_Event_DTC_0x500568_GetDTCOfEvent: start-on-event=GetDTCOfEvent, operation=Event_DTC_0x500568.GetDTCOfEvent
      OIT_GetDTCOfEvent_Event_DTC_0x500909_GetDTCOfEvent: start-on-event=GetDTCOfEvent, operation=Event_DTC_0x500909.GetDTCOfEvent
      OIT_GetDTCOfEvent_Event_DTC_0x52192f_GetDTCOfEvent: start-on-event=GetDTCOfEvent, operation=Event_DTC_0x52192f.GetDTCOfEvent
      OIT_GetDTCOfEvent_Event_DTC_0x521a54_GetDTCOfEvent: start-on-event=GetDTCOfEvent, operation=Event_DTC_0x521a54.GetDTCOfEvent
      OIT_GetDTCOfEvent_Event_DTC_0x559201_GetDTCOfEvent: start-on-event=GetDTCOfEvent, operation=Event_DTC_0x559201.GetDTCOfEvent
      OIT_GetDTCOfEvent_Event_DTC_0x{559211..559213}_GetDTCOfEvent: start-on-event=GetDTCOfEvent, operation=Event_DTC_0x{559211..559213}.GetDTCOfEvent
      OIT_GetDTCOfEvent_Event_DTC_0x559219_GetDTCOfEvent: start-on-event=GetDTCOfEvent, operation=Event_DTC_0x559219.GetDTCOfEvent
      OIT_GetDTCOfEvent_Event_DTC_0x{559311..559313}_GetDTCOfEvent: start-on-event=GetDTCOfEvent, operation=Event_DTC_0x{559311..559313}.GetDTCOfEvent
      OIT_GetDTCOfEvent_Event_DTC_0x559349_GetDTCOfEvent: start-on-event=GetDTCOfEvent, operation=Event_DTC_0x559349.GetDTCOfEvent
      OIT_GetDTCOfEvent_Event_DTC_0x620525_GetDTCOfEvent: start-on-event=GetDTCOfEvent, operation=Event_DTC_0x620525.GetDTCOfEvent
      OIT_GetDTCOfEvent_Event_DTC_0x621068_GetDTCOfEvent: start-on-event=GetDTCOfEvent, operation=Event_DTC_0x621068.GetDTCOfEvent
      OIT_GetDTCOfEvent_Event_DTC_0x621098_GetDTCOfEvent: start-on-event=GetDTCOfEvent, operation=Event_DTC_0x621098.GetDTCOfEvent
      OIT_GetDTCOfEvent_Event_DTC_0x621748_GetDTCOfEvent: start-on-event=GetDTCOfEvent, operation=Event_DTC_0x621748.GetDTCOfEvent
      OIT_GetDTCOfEvent_Event_DTC_0x621749_GetDTCOfEvent: start-on-event=GetDTCOfEvent, operation=Event_DTC_0x621749.GetDTCOfEvent
      OIT_GetDTCOfEvent_Event_DTC_0xa19916_GetDTCOfEvent: start-on-event=GetDTCOfEvent, operation=Event_DTC_0xa19916.GetDTCOfEvent
      OIT_GetDTCOfEvent_Event_DTC_0xa19917_GetDTCOfEvent: start-on-event=GetDTCOfEvent, operation=Event_DTC_0xa19917.GetDTCOfEvent
      OIT_GetDTCOfEvent_Event_DTC_0xa1991c_GetDTCOfEvent: start-on-event=GetDTCOfEvent, operation=Event_DTC_0xa1991c.GetDTCOfEvent
      OIT_GetDTCOfEvent_Event_DTC_0xa22c51_GetDTCOfEvent: start-on-event=GetDTCOfEvent, operation=Event_DTC_0xa22c51.GetDTCOfEvent
      OIT_GetDTCOfEvent_Event_DTC_0xa23b05_GetDTCOfEvent: start-on-event=GetDTCOfEvent, operation=Event_DTC_0xa23b05.GetDTCOfEvent
      OIT_GetDTCOfEvent_Event_DTC_0xc00187_GetDTCOfEvent: start-on-event=GetDTCOfEvent, operation=Event_DTC_0xc00187.GetDTCOfEvent
      OIT_GetDTCOfEvent_Event_DTC_0xc00188_GetDTCOfEvent: start-on-event=GetDTCOfEvent, operation=Event_DTC_0xc00188.GetDTCOfEvent
      OIT_GetDTCOfEvent_Event_DTC_0xc10087_GetDTCOfEvent: start-on-event=GetDTCOfEvent, operation=Event_DTC_0xc10087.GetDTCOfEvent
      OIT_GetDTCOfEvent_Event_DTC_0xc4012f_GetDTCOfEvent: start-on-event=GetDTCOfEvent, operation=Event_DTC_0xc4012f.GetDTCOfEvent
      OIT_GetDTCOfEvent_Event_DTC_0xc4152f_GetDTCOfEvent: start-on-event=GetDTCOfEvent, operation=Event_DTC_0xc4152f.GetDTCOfEvent
      OIT_GetDTCOfEvent_Event_DTC_0xc4222f_GetDTCOfEvent: start-on-event=GetDTCOfEvent, operation=Event_DTC_0xc4222f.GetDTCOfEvent
      OIT_GetDTCOfEvent_Event_DTC_0xc4232f_GetDTCOfEvent: start-on-event=GetDTCOfEvent, operation=Event_DTC_0xc4232f.GetDTCOfEvent
      OIT_GetDTCOfEvent_Event_DTC_0xd00587_GetDTCOfEvent: start-on-event=GetDTCOfEvent, operation=Event_DTC_0xd00587.GetDTCOfEvent
      OIT_GetDTCOfEvent_Event_DTC_0xd00687_GetDTCOfEvent: start-on-event=GetDTCOfEvent, operation=Event_DTC_0xd00687.GetDTCOfEvent
      OIT_GetDTCOfEvent_Event_DTC_0xd00787_GetDTCOfEvent: start-on-event=GetDTCOfEvent, operation=Event_DTC_0xd00787.GetDTCOfEvent
      OIT_GetDTCOfEvent_Event_DTC_0xd01087_GetDTCOfEvent: start-on-event=GetDTCOfEvent, operation=Event_DTC_0xd01087.GetDTCOfEvent
      OIT_GetDTCOfEvent_Event_DTC_0xd01187_GetDTCOfEvent: start-on-event=GetDTCOfEvent, operation=Event_DTC_0xd01187.GetDTCOfEvent
      OIT_GetDTCOfEvent_Event_DTC_0xd01387_GetDTCOfEvent: start-on-event=GetDTCOfEvent, operation=Event_DTC_0xd01387.GetDTCOfEvent
      OIT_GetDTCOfEvent_Event_DTC_0xd93286_GetDTCOfEvent: start-on-event=GetDTCOfEvent, operation=Event_DTC_0xd93286.GetDTCOfEvent
      OIT_GetDTCOfEvent_Event_DTC_0xd95283_GetDTCOfEvent: start-on-event=GetDTCOfEvent, operation=Event_DTC_0xd95283.GetDTCOfEvent
      OIT_GetDTCOfEvent_EvtInfo_CAN_E_TIMEOUT_GetDTCOfEvent: start-on-event=GetDTCOfEvent, operation=EvtInfo_CAN_E_TIMEOUT.GetDTCOfEvent
      OIT_GetDTCOfEvent_EvtInfo_CANIF_E_FULL_TX_BUFFER_GetDTCOfEvent: start-on-event=GetDTCOfEvent, operation=EvtInfo_CANIF_E_FULL_TX_BUFFER.GetDTCOfEvent
      OIT_GetDTCOfEvent_EvtInfo_CANIF_E_INVALID_DLC_GetDTCOfEvent: start-on-event=GetDTCOfEvent, operation=EvtInfo_CANIF_E_INVALID_DLC.GetDTCOfEvent
      OIT_GetDTCOfEvent_EvtInfo_CANIF_E_SLEEP_REQ_FAILED_GetDTCOfEvent: start-on-event=GetDTCOfEvent, operation=EvtInfo_CANIF_E_SLEEP_REQ_FAILED.GetDTCOfEvent
      OIT_GetDTCOfEvent_EvtInfo_CANIF_E_STOPPED_GetDTCOfEvent: start-on-event=GetDTCOfEvent, operation=EvtInfo_CANIF_E_STOPPED.GetDTCOfEvent
      OIT_GetDTCOfEvent_EvtInfo_CANSM_E_BUSOFF_NETWORK_0_GetDTCOfEvent: start-on-event=GetDTCOfEvent, operation=EvtInfo_CANSM_E_BUSOFF_NETWORK_0.GetDTCOfEvent
      OIT_GetDTCOfEvent_EvtInfo_CANSM_E_MISSING_TRCV_INDICATION_0_GetDTCOfEvent: start-on-event=GetDTCOfEvent, operation=EvtInfo_CANSM_E_MISSING_TRCV_INDICATION_0.GetDTCOfEvent
      OIT_GetDTCOfEvent_EvtInfo_CANSM_E_MODE_CHANGE_NETWORK_0_GetDTCOfEvent: start-on-event=GetDTCOfEvent, operation=EvtInfo_CANSM_E_MODE_CHANGE_NETWORK_0.GetDTCOfEvent
      OIT_GetDTCOfEvent_EvtInfo_CANTP_E_COMM_GetDTCOfEvent: start-on-event=GetDTCOfEvent, operation=EvtInfo_CANTP_E_COMM.GetDTCOfEvent
      OIT_GetDTCOfEvent_EvtInfo_ECUM_E_ALL_RUN_REQUESTS_KILLED_GetDTCOfEvent: start-on-event=GetDTCOfEvent, operation=EvtInfo_ECUM_E_ALL_RUN_REQUESTS_KILLED.GetDTCOfEvent
      OIT_GetDTCOfEvent_EvtInfo_ECUM_E_RAM_CHECK_FAILED_GetDTCOfEvent: start-on-event=GetDTCOfEvent, operation=EvtInfo_ECUM_E_RAM_CHECK_FAILED.GetDTCOfEvent
      OIT_GetDTCOfEvent_EvtInfo_FLS_E_ERASE_FAILED_GetDTCOfEvent: start-on-event=GetDTCOfEvent, operation=EvtInfo_FLS_E_ERASE_FAILED.GetDTCOfEvent
      OIT_GetDTCOfEvent_EvtInfo_FLS_E_READ_FAILED_GetDTCOfEvent: start-on-event=GetDTCOfEvent, operation=EvtInfo_FLS_E_READ_FAILED.GetDTCOfEvent
      OIT_GetDTCOfEvent_EvtInfo_FLS_E_WRITE_FAILED_GetDTCOfEvent: start-on-event=GetDTCOfEvent, operation=EvtInfo_FLS_E_WRITE_FAILED.GetDTCOfEvent
      OIT_GetDTCOfEvent_EvtInfo_MCU_E_CLOCK_FAILURE_GetDTCOfEvent: start-on-event=GetDTCOfEvent, operation=EvtInfo_MCU_E_CLOCK_FAILURE.GetDTCOfEvent
      OIT_GetDTCOfEvent_EvtInfo_NVM_E_INTEGRITY_FAILED_GetDTCOfEvent: start-on-event=GetDTCOfEvent, operation=EvtInfo_NVM_E_INTEGRITY_FAILED.GetDTCOfEvent
      OIT_GetDTCOfEvent_EvtInfo_NVM_E_REQ_FAILED_GetDTCOfEvent: start-on-event=GetDTCOfEvent, operation=EvtInfo_NVM_E_REQ_FAILED.GetDTCOfEvent
      OIT_GetDTCOfEvent_EvtInfo_PDUR_E_INIT_FAILED_GetDTCOfEvent: start-on-event=GetDTCOfEvent, operation=EvtInfo_PDUR_E_INIT_FAILED.GetDTCOfEvent
      OIT_GetDTCOfEvent_EvtInfo_PDUR_E_PDU_INSTANCE_LOST_GetDTCOfEvent: start-on-event=GetDTCOfEvent, operation=EvtInfo_PDUR_E_PDU_INSTANCE_LOST.GetDTCOfEvent
      OIT_GetDTCOfEvent_EvtInfo_SPI_E_SEQ_FAILED_GetDTCOfEvent: start-on-event=GetDTCOfEvent, operation=EvtInfo_SPI_E_SEQ_FAILED.GetDTCOfEvent
      OIT_GetDTCOfEvent_EvtInfo_WDGM_E_ALIVE_SUPERVISION_GetDTCOfEvent: start-on-event=GetDTCOfEvent, operation=EvtInfo_WDGM_E_ALIVE_SUPERVISION.GetDTCOfEvent
      OIT_GetDTCOfEvent_EvtInfo_WDGM_E_SET_MODE_GetDTCOfEvent: start-on-event=GetDTCOfEvent, operation=EvtInfo_WDGM_E_SET_MODE.GetDTCOfEvent
      OIT_GetEventFailed_Event_DTC_0x500386_GetEventFailed: start-on-event=GetEventFailed, operation=Event_DTC_0x500386.GetEventFailed
      OIT_GetEventFailed_Event_DTC_0x500568_GetEventFailed: start-on-event=GetEventFailed, operation=Event_DTC_0x500568.GetEventFailed
      OIT_GetEventFailed_Event_DTC_0x500909_GetEventFailed: start-on-event=GetEventFailed, operation=Event_DTC_0x500909.GetEventFailed
      OIT_GetEventFailed_Event_DTC_0x52192f_GetEventFailed: start-on-event=GetEventFailed, operation=Event_DTC_0x52192f.GetEventFailed
      OIT_GetEventFailed_Event_DTC_0x521a54_GetEventFailed: start-on-event=GetEventFailed, operation=Event_DTC_0x521a54.GetEventFailed
      OIT_GetEventFailed_Event_DTC_0x559201_GetEventFailed: start-on-event=GetEventFailed, operation=Event_DTC_0x559201.GetEventFailed
      OIT_GetEventFailed_Event_DTC_0x{559211..559213}_GetEventFailed: start-on-event=GetEventFailed, operation=Event_DTC_0x{559211..559213}.GetEventFailed
      OIT_GetEventFailed_Event_DTC_0x559219_GetEventFailed: start-on-event=GetEventFailed, operation=Event_DTC_0x559219.GetEventFailed
      OIT_GetEventFailed_Event_DTC_0x{559311..559313}_GetEventFailed: start-on-event=GetEventFailed, operation=Event_DTC_0x{559311..559313}.GetEventFailed
      OIT_GetEventFailed_Event_DTC_0x559349_GetEventFailed: start-on-event=GetEventFailed, operation=Event_DTC_0x559349.GetEventFailed
      OIT_GetEventFailed_Event_DTC_0x620525_GetEventFailed: start-on-event=GetEventFailed, operation=Event_DTC_0x620525.GetEventFailed
      OIT_GetEventFailed_Event_DTC_0x621068_GetEventFailed: start-on-event=GetEventFailed, operation=Event_DTC_0x621068.GetEventFailed
      OIT_GetEventFailed_Event_DTC_0x621098_GetEventFailed: start-on-event=GetEventFailed, operation=Event_DTC_0x621098.GetEventFailed
      OIT_GetEventFailed_Event_DTC_0x621748_GetEventFailed: start-on-event=GetEventFailed, operation=Event_DTC_0x621748.GetEventFailed
      OIT_GetEventFailed_Event_DTC_0x621749_GetEventFailed: start-on-event=GetEventFailed, operation=Event_DTC_0x621749.GetEventFailed
      OIT_GetEventFailed_Event_DTC_0xa19916_GetEventFailed: start-on-event=GetEventFailed, operation=Event_DTC_0xa19916.GetEventFailed
      OIT_GetEventFailed_Event_DTC_0xa19917_GetEventFailed: start-on-event=GetEventFailed, operation=Event_DTC_0xa19917.GetEventFailed
      OIT_GetEventFailed_Event_DTC_0xa1991c_GetEventFailed: start-on-event=GetEventFailed, operation=Event_DTC_0xa1991c.GetEventFailed
      OIT_GetEventFailed_Event_DTC_0xa22c51_GetEventFailed: start-on-event=GetEventFailed, operation=Event_DTC_0xa22c51.GetEventFailed
      OIT_GetEventFailed_Event_DTC_0xa23b05_GetEventFailed: start-on-event=GetEventFailed, operation=Event_DTC_0xa23b05.GetEventFailed
      OIT_GetEventFailed_Event_DTC_0xc00187_GetEventFailed: start-on-event=GetEventFailed, operation=Event_DTC_0xc00187.GetEventFailed
      OIT_GetEventFailed_Event_DTC_0xc00188_GetEventFailed: start-on-event=GetEventFailed, operation=Event_DTC_0xc00188.GetEventFailed
      OIT_GetEventFailed_Event_DTC_0xc10087_GetEventFailed: start-on-event=GetEventFailed, operation=Event_DTC_0xc10087.GetEventFailed
      OIT_GetEventFailed_Event_DTC_0xc4012f_GetEventFailed: start-on-event=GetEventFailed, operation=Event_DTC_0xc4012f.GetEventFailed
      OIT_GetEventFailed_Event_DTC_0xc4152f_GetEventFailed: start-on-event=GetEventFailed, operation=Event_DTC_0xc4152f.GetEventFailed
      OIT_GetEventFailed_Event_DTC_0xc4222f_GetEventFailed: start-on-event=GetEventFailed, operation=Event_DTC_0xc4222f.GetEventFailed
      OIT_GetEventFailed_Event_DTC_0xc4232f_GetEventFailed: start-on-event=GetEventFailed, operation=Event_DTC_0xc4232f.GetEventFailed
      OIT_GetEventFailed_Event_DTC_0xd00587_GetEventFailed: start-on-event=GetEventFailed, operation=Event_DTC_0xd00587.GetEventFailed
      OIT_GetEventFailed_Event_DTC_0xd00687_GetEventFailed: start-on-event=GetEventFailed, operation=Event_DTC_0xd00687.GetEventFailed
      OIT_GetEventFailed_Event_DTC_0xd00787_GetEventFailed: start-on-event=GetEventFailed, operation=Event_DTC_0xd00787.GetEventFailed
      OIT_GetEventFailed_Event_DTC_0xd01087_GetEventFailed: start-on-event=GetEventFailed, operation=Event_DTC_0xd01087.GetEventFailed
      OIT_GetEventFailed_Event_DTC_0xd01187_GetEventFailed: start-on-event=GetEventFailed, operation=Event_DTC_0xd01187.GetEventFailed
      OIT_GetEventFailed_Event_DTC_0xd01387_GetEventFailed: start-on-event=GetEventFailed, operation=Event_DTC_0xd01387.GetEventFailed
      OIT_GetEventFailed_Event_DTC_0xd93286_GetEventFailed: start-on-event=GetEventFailed, operation=Event_DTC_0xd93286.GetEventFailed
      OIT_GetEventFailed_Event_DTC_0xd95283_GetEventFailed: start-on-event=GetEventFailed, operation=Event_DTC_0xd95283.GetEventFailed
      OIT_GetEventFailed_EvtInfo_CAN_E_TIMEOUT_GetEventFailed: start-on-event=GetEventFailed, operation=EvtInfo_CAN_E_TIMEOUT.GetEventFailed
      OIT_GetEventFailed_EvtInfo_CANIF_E_FULL_TX_BUFFER_GetEventFailed: start-on-event=GetEventFailed, operation=EvtInfo_CANIF_E_FULL_TX_BUFFER.GetEventFailed
      OIT_GetEventFailed_EvtInfo_CANIF_E_INVALID_DLC_GetEventFailed: start-on-event=GetEventFailed, operation=EvtInfo_CANIF_E_INVALID_DLC.GetEventFailed
      OIT_GetEventFailed_EvtInfo_CANIF_E_SLEEP_REQ_FAILED_GetEventFailed: start-on-event=GetEventFailed, operation=EvtInfo_CANIF_E_SLEEP_REQ_FAILED.GetEventFailed
      OIT_GetEventFailed_EvtInfo_CANIF_E_STOPPED_GetEventFailed: start-on-event=GetEventFailed, operation=EvtInfo_CANIF_E_STOPPED.GetEventFailed
      OIT_GetEventFailed_EvtInfo_CANSM_E_BUSOFF_NETWORK_0_GetEventFailed: start-on-event=GetEventFailed, operation=EvtInfo_CANSM_E_BUSOFF_NETWORK_0.GetEventFailed
      OIT_GetEventFailed_EvtInfo_CANSM_E_MISSING_TRCV_INDICATION_0_GetEventFailed: start-on-event=GetEventFailed, operation=EvtInfo_CANSM_E_MISSING_TRCV_INDICATION_0.GetEventFailed
      OIT_GetEventFailed_EvtInfo_CANSM_E_MODE_CHANGE_NETWORK_0_GetEventFailed: start-on-event=GetEventFailed, operation=EvtInfo_CANSM_E_MODE_CHANGE_NETWORK_0.GetEventFailed
      OIT_GetEventFailed_EvtInfo_CANTP_E_COMM_GetEventFailed: start-on-event=GetEventFailed, operation=EvtInfo_CANTP_E_COMM.GetEventFailed
      OIT_GetEventFailed_EvtInfo_ECUM_E_ALL_RUN_REQUESTS_KILLED_GetEventFailed: start-on-event=GetEventFailed, operation=EvtInfo_ECUM_E_ALL_RUN_REQUESTS_KILLED.GetEventFailed
      OIT_GetEventFailed_EvtInfo_ECUM_E_RAM_CHECK_FAILED_GetEventFailed: start-on-event=GetEventFailed, operation=EvtInfo_ECUM_E_RAM_CHECK_FAILED.GetEventFailed
      OIT_GetEventFailed_EvtInfo_FLS_E_ERASE_FAILED_GetEventFailed: start-on-event=GetEventFailed, operation=EvtInfo_FLS_E_ERASE_FAILED.GetEventFailed
      OIT_GetEventFailed_EvtInfo_FLS_E_READ_FAILED_GetEventFailed: start-on-event=GetEventFailed, operation=EvtInfo_FLS_E_READ_FAILED.GetEventFailed
      OIT_GetEventFailed_EvtInfo_FLS_E_WRITE_FAILED_GetEventFailed: start-on-event=GetEventFailed, operation=EvtInfo_FLS_E_WRITE_FAILED.GetEventFailed
      OIT_GetEventFailed_EvtInfo_MCU_E_CLOCK_FAILURE_GetEventFailed: start-on-event=GetEventFailed, operation=EvtInfo_MCU_E_CLOCK_FAILURE.GetEventFailed
      OIT_GetEventFailed_EvtInfo_NVM_E_INTEGRITY_FAILED_GetEventFailed: start-on-event=GetEventFailed, operation=EvtInfo_NVM_E_INTEGRITY_FAILED.GetEventFailed
      OIT_GetEventFailed_EvtInfo_NVM_E_REQ_FAILED_GetEventFailed: start-on-event=GetEventFailed, operation=EvtInfo_NVM_E_REQ_FAILED.GetEventFailed
      OIT_GetEventFailed_EvtInfo_PDUR_E_INIT_FAILED_GetEventFailed: start-on-event=GetEventFailed, operation=EvtInfo_PDUR_E_INIT_FAILED.GetEventFailed
      OIT_GetEventFailed_EvtInfo_PDUR_E_PDU_INSTANCE_LOST_GetEventFailed: start-on-event=GetEventFailed, operation=EvtInfo_PDUR_E_PDU_INSTANCE_LOST.GetEventFailed
      OIT_GetEventFailed_EvtInfo_SPI_E_SEQ_FAILED_GetEventFailed: start-on-event=GetEventFailed, operation=EvtInfo_SPI_E_SEQ_FAILED.GetEventFailed
      OIT_GetEventFailed_EvtInfo_WDGM_E_ALIVE_SUPERVISION_GetEventFailed: start-on-event=GetEventFailed, operation=EvtInfo_WDGM_E_ALIVE_SUPERVISION.GetEventFailed
      OIT_GetEventFailed_EvtInfo_WDGM_E_SET_MODE_GetEventFailed: start-on-event=GetEventFailed, operation=EvtInfo_WDGM_E_SET_MODE.GetEventFailed
      OIT_GetEventStatus_Event_DTC_0x500386_GetEventStatus: start-on-event=GetEventStatus, operation=Event_DTC_0x500386.GetEventStatus
      OIT_GetEventStatus_Event_DTC_0x500568_GetEventStatus: start-on-event=GetEventStatus, operation=Event_DTC_0x500568.GetEventStatus
      OIT_GetEventStatus_Event_DTC_0x500909_GetEventStatus: start-on-event=GetEventStatus, operation=Event_DTC_0x500909.GetEventStatus
      OIT_GetEventStatus_Event_DTC_0x52192f_GetEventStatus: start-on-event=GetEventStatus, operation=Event_DTC_0x52192f.GetEventStatus
      OIT_GetEventStatus_Event_DTC_0x521a54_GetEventStatus: start-on-event=GetEventStatus, operation=Event_DTC_0x521a54.GetEventStatus
      OIT_GetEventStatus_Event_DTC_0x559201_GetEventStatus: start-on-event=GetEventStatus, operation=Event_DTC_0x559201.GetEventStatus
      OIT_GetEventStatus_Event_DTC_0x{559211..559213}_GetEventStatus: start-on-event=GetEventStatus, operation=Event_DTC_0x{559211..559213}.GetEventStatus
      OIT_GetEventStatus_Event_DTC_0x559219_GetEventStatus: start-on-event=GetEventStatus, operation=Event_DTC_0x559219.GetEventStatus
      OIT_GetEventStatus_Event_DTC_0x{559311..559313}_GetEventStatus: start-on-event=GetEventStatus, operation=Event_DTC_0x{559311..559313}.GetEventStatus
      OIT_GetEventStatus_Event_DTC_0x559349_GetEventStatus: start-on-event=GetEventStatus, operation=Event_DTC_0x559349.GetEventStatus
      OIT_GetEventStatus_Event_DTC_0x620525_GetEventStatus: start-on-event=GetEventStatus, operation=Event_DTC_0x620525.GetEventStatus
      OIT_GetEventStatus_Event_DTC_0x621068_GetEventStatus: start-on-event=GetEventStatus, operation=Event_DTC_0x621068.GetEventStatus
      OIT_GetEventStatus_Event_DTC_0x621098_GetEventStatus: start-on-event=GetEventStatus, operation=Event_DTC_0x621098.GetEventStatus
      OIT_GetEventStatus_Event_DTC_0x621748_GetEventStatus: start-on-event=GetEventStatus, operation=Event_DTC_0x621748.GetEventStatus
      OIT_GetEventStatus_Event_DTC_0x621749_GetEventStatus: start-on-event=GetEventStatus, operation=Event_DTC_0x621749.GetEventStatus
      OIT_GetEventStatus_Event_DTC_0xa19916_GetEventStatus: start-on-event=GetEventStatus, operation=Event_DTC_0xa19916.GetEventStatus
      OIT_GetEventStatus_Event_DTC_0xa19917_GetEventStatus: start-on-event=GetEventStatus, operation=Event_DTC_0xa19917.GetEventStatus
      OIT_GetEventStatus_Event_DTC_0xa1991c_GetEventStatus: start-on-event=GetEventStatus, operation=Event_DTC_0xa1991c.GetEventStatus
      OIT_GetEventStatus_Event_DTC_0xa22c51_GetEventStatus: start-on-event=GetEventStatus, operation=Event_DTC_0xa22c51.GetEventStatus
      OIT_GetEventStatus_Event_DTC_0xa23b05_GetEventStatus: start-on-event=GetEventStatus, operation=Event_DTC_0xa23b05.GetEventStatus
      OIT_GetEventStatus_Event_DTC_0xc00187_GetEventStatus: start-on-event=GetEventStatus, operation=Event_DTC_0xc00187.GetEventStatus
      OIT_GetEventStatus_Event_DTC_0xc00188_GetEventStatus: start-on-event=GetEventStatus, operation=Event_DTC_0xc00188.GetEventStatus
      OIT_GetEventStatus_Event_DTC_0xc10087_GetEventStatus: start-on-event=GetEventStatus, operation=Event_DTC_0xc10087.GetEventStatus
      OIT_GetEventStatus_Event_DTC_0xc4012f_GetEventStatus: start-on-event=GetEventStatus, operation=Event_DTC_0xc4012f.GetEventStatus
      OIT_GetEventStatus_Event_DTC_0xc4152f_GetEventStatus: start-on-event=GetEventStatus, operation=Event_DTC_0xc4152f.GetEventStatus
      OIT_GetEventStatus_Event_DTC_0xc4222f_GetEventStatus: start-on-event=GetEventStatus, operation=Event_DTC_0xc4222f.GetEventStatus
      OIT_GetEventStatus_Event_DTC_0xc4232f_GetEventStatus: start-on-event=GetEventStatus, operation=Event_DTC_0xc4232f.GetEventStatus
      OIT_GetEventStatus_Event_DTC_0xd00587_GetEventStatus: start-on-event=GetEventStatus, operation=Event_DTC_0xd00587.GetEventStatus
      OIT_GetEventStatus_Event_DTC_0xd00687_GetEventStatus: start-on-event=GetEventStatus, operation=Event_DTC_0xd00687.GetEventStatus
      OIT_GetEventStatus_Event_DTC_0xd00787_GetEventStatus: start-on-event=GetEventStatus, operation=Event_DTC_0xd00787.GetEventStatus
      OIT_GetEventStatus_Event_DTC_0xd01087_GetEventStatus: start-on-event=GetEventStatus, operation=Event_DTC_0xd01087.GetEventStatus
      OIT_GetEventStatus_Event_DTC_0xd01187_GetEventStatus: start-on-event=GetEventStatus, operation=Event_DTC_0xd01187.GetEventStatus
      OIT_GetEventStatus_Event_DTC_0xd01387_GetEventStatus: start-on-event=GetEventStatus, operation=Event_DTC_0xd01387.GetEventStatus
      OIT_GetEventStatus_Event_DTC_0xd93286_GetEventStatus: start-on-event=GetEventStatus, operation=Event_DTC_0xd93286.GetEventStatus
      OIT_GetEventStatus_Event_DTC_0xd95283_GetEventStatus: start-on-event=GetEventStatus, operation=Event_DTC_0xd95283.GetEventStatus
      OIT_GetEventStatus_EvtInfo_CAN_E_TIMEOUT_GetEventStatus: start-on-event=GetEventStatus, operation=EvtInfo_CAN_E_TIMEOUT.GetEventStatus
      OIT_GetEventStatus_EvtInfo_CANIF_E_FULL_TX_BUFFER_GetEventStatus: start-on-event=GetEventStatus, operation=EvtInfo_CANIF_E_FULL_TX_BUFFER.GetEventStatus
      OIT_GetEventStatus_EvtInfo_CANIF_E_INVALID_DLC_GetEventStatus: start-on-event=GetEventStatus, operation=EvtInfo_CANIF_E_INVALID_DLC.GetEventStatus
      OIT_GetEventStatus_EvtInfo_CANIF_E_SLEEP_REQ_FAILED_GetEventStatus: start-on-event=GetEventStatus, operation=EvtInfo_CANIF_E_SLEEP_REQ_FAILED.GetEventStatus
      OIT_GetEventStatus_EvtInfo_CANIF_E_STOPPED_GetEventStatus: start-on-event=GetEventStatus, operation=EvtInfo_CANIF_E_STOPPED.GetEventStatus
      OIT_GetEventStatus_EvtInfo_CANSM_E_BUSOFF_NETWORK_0_GetEventStatus: start-on-event=GetEventStatus, operation=EvtInfo_CANSM_E_BUSOFF_NETWORK_0.GetEventStatus
      OIT_GetEventStatus_EvtInfo_CANSM_E_MISSING_TRCV_INDICATION_0_GetEventStatus: start-on-event=GetEventStatus, operation=EvtInfo_CANSM_E_MISSING_TRCV_INDICATION_0.GetEventStatus
      OIT_GetEventStatus_EvtInfo_CANSM_E_MODE_CHANGE_NETWORK_0_GetEventStatus: start-on-event=GetEventStatus, operation=EvtInfo_CANSM_E_MODE_CHANGE_NETWORK_0.GetEventStatus
      OIT_GetEventStatus_EvtInfo_CANTP_E_COMM_GetEventStatus: start-on-event=GetEventStatus, operation=EvtInfo_CANTP_E_COMM.GetEventStatus
      OIT_GetEventStatus_EvtInfo_ECUM_E_ALL_RUN_REQUESTS_KILLED_GetEventStatus: start-on-event=GetEventStatus, operation=EvtInfo_ECUM_E_ALL_RUN_REQUESTS_KILLED.GetEventStatus
      OIT_GetEventStatus_EvtInfo_ECUM_E_RAM_CHECK_FAILED_GetEventStatus: start-on-event=GetEventStatus, operation=EvtInfo_ECUM_E_RAM_CHECK_FAILED.GetEventStatus
      OIT_GetEventStatus_EvtInfo_FLS_E_ERASE_FAILED_GetEventStatus: start-on-event=GetEventStatus, operation=EvtInfo_FLS_E_ERASE_FAILED.GetEventStatus
      OIT_GetEventStatus_EvtInfo_FLS_E_READ_FAILED_GetEventStatus: start-on-event=GetEventStatus, operation=EvtInfo_FLS_E_READ_FAILED.GetEventStatus
      OIT_GetEventStatus_EvtInfo_FLS_E_WRITE_FAILED_GetEventStatus: start-on-event=GetEventStatus, operation=EvtInfo_FLS_E_WRITE_FAILED.GetEventStatus
      OIT_GetEventStatus_EvtInfo_MCU_E_CLOCK_FAILURE_GetEventStatus: start-on-event=GetEventStatus, operation=EvtInfo_MCU_E_CLOCK_FAILURE.GetEventStatus
      OIT_GetEventStatus_EvtInfo_NVM_E_INTEGRITY_FAILED_GetEventStatus: start-on-event=GetEventStatus, operation=EvtInfo_NVM_E_INTEGRITY_FAILED.GetEventStatus
      OIT_GetEventStatus_EvtInfo_NVM_E_REQ_FAILED_GetEventStatus: start-on-event=GetEventStatus, operation=EvtInfo_NVM_E_REQ_FAILED.GetEventStatus
      OIT_GetEventStatus_EvtInfo_PDUR_E_INIT_FAILED_GetEventStatus: start-on-event=GetEventStatus, operation=EvtInfo_PDUR_E_INIT_FAILED.GetEventStatus
      OIT_GetEventStatus_EvtInfo_PDUR_E_PDU_INSTANCE_LOST_GetEventStatus: start-on-event=GetEventStatus, operation=EvtInfo_PDUR_E_PDU_INSTANCE_LOST.GetEventStatus
      OIT_GetEventStatus_EvtInfo_SPI_E_SEQ_FAILED_GetEventStatus: start-on-event=GetEventStatus, operation=EvtInfo_SPI_E_SEQ_FAILED.GetEventStatus
      OIT_GetEventStatus_EvtInfo_WDGM_E_ALIVE_SUPERVISION_GetEventStatus: start-on-event=GetEventStatus, operation=EvtInfo_WDGM_E_ALIVE_SUPERVISION.GetEventStatus
      OIT_GetEventStatus_EvtInfo_WDGM_E_SET_MODE_GetEventStatus: start-on-event=GetEventStatus, operation=EvtInfo_WDGM_E_SET_MODE.GetEventStatus
      OIT_GetEventTested_Event_DTC_0x500386_GetEventTested: start-on-event=GetEventTested, operation=Event_DTC_0x500386.GetEventTested
      OIT_GetEventTested_Event_DTC_0x500568_GetEventTested: start-on-event=GetEventTested, operation=Event_DTC_0x500568.GetEventTested
      OIT_GetEventTested_Event_DTC_0x500909_GetEventTested: start-on-event=GetEventTested, operation=Event_DTC_0x500909.GetEventTested
      OIT_GetEventTested_Event_DTC_0x52192f_GetEventTested: start-on-event=GetEventTested, operation=Event_DTC_0x52192f.GetEventTested
      OIT_GetEventTested_Event_DTC_0x521a54_GetEventTested: start-on-event=GetEventTested, operation=Event_DTC_0x521a54.GetEventTested
      OIT_GetEventTested_Event_DTC_0x559201_GetEventTested: start-on-event=GetEventTested, operation=Event_DTC_0x559201.GetEventTested
      OIT_GetEventTested_Event_DTC_0x{559211..559213}_GetEventTested: start-on-event=GetEventTested, operation=Event_DTC_0x{559211..559213}.GetEventTested
      OIT_GetEventTested_Event_DTC_0x559219_GetEventTested: start-on-event=GetEventTested, operation=Event_DTC_0x559219.GetEventTested
      OIT_GetEventTested_Event_DTC_0x{559311..559313}_GetEventTested: start-on-event=GetEventTested, operation=Event_DTC_0x{559311..559313}.GetEventTested
      OIT_GetEventTested_Event_DTC_0x559349_GetEventTested: start-on-event=GetEventTested, operation=Event_DTC_0x559349.GetEventTested
      OIT_GetEventTested_Event_DTC_0x620525_GetEventTested: start-on-event=GetEventTested, operation=Event_DTC_0x620525.GetEventTested
      OIT_GetEventTested_Event_DTC_0x621068_GetEventTested: start-on-event=GetEventTested, operation=Event_DTC_0x621068.GetEventTested
      OIT_GetEventTested_Event_DTC_0x621098_GetEventTested: start-on-event=GetEventTested, operation=Event_DTC_0x621098.GetEventTested
      OIT_GetEventTested_Event_DTC_0x621748_GetEventTested: start-on-event=GetEventTested, operation=Event_DTC_0x621748.GetEventTested
      OIT_GetEventTested_Event_DTC_0x621749_GetEventTested: start-on-event=GetEventTested, operation=Event_DTC_0x621749.GetEventTested
      OIT_GetEventTested_Event_DTC_0xa19916_GetEventTested: start-on-event=GetEventTested, operation=Event_DTC_0xa19916.GetEventTested
      OIT_GetEventTested_Event_DTC_0xa19917_GetEventTested: start-on-event=GetEventTested, operation=Event_DTC_0xa19917.GetEventTested
      OIT_GetEventTested_Event_DTC_0xa1991c_GetEventTested: start-on-event=GetEventTested, operation=Event_DTC_0xa1991c.GetEventTested
      OIT_GetEventTested_Event_DTC_0xa22c51_GetEventTested: start-on-event=GetEventTested, operation=Event_DTC_0xa22c51.GetEventTested
      OIT_GetEventTested_Event_DTC_0xa23b05_GetEventTested: start-on-event=GetEventTested, operation=Event_DTC_0xa23b05.GetEventTested
      OIT_GetEventTested_Event_DTC_0xc00187_GetEventTested: start-on-event=GetEventTested, operation=Event_DTC_0xc00187.GetEventTested
      OIT_GetEventTested_Event_DTC_0xc00188_GetEventTested: start-on-event=GetEventTested, operation=Event_DTC_0xc00188.GetEventTested
      OIT_GetEventTested_Event_DTC_0xc10087_GetEventTested: start-on-event=GetEventTested, operation=Event_DTC_0xc10087.GetEventTested
      OIT_GetEventTested_Event_DTC_0xc4012f_GetEventTested: start-on-event=GetEventTested, operation=Event_DTC_0xc4012f.GetEventTested
      OIT_GetEventTested_Event_DTC_0xc4152f_GetEventTested: start-on-event=GetEventTested, operation=Event_DTC_0xc4152f.GetEventTested
      OIT_GetEventTested_Event_DTC_0xc4222f_GetEventTested: start-on-event=GetEventTested, operation=Event_DTC_0xc4222f.GetEventTested
      OIT_GetEventTested_Event_DTC_0xc4232f_GetEventTested: start-on-event=GetEventTested, operation=Event_DTC_0xc4232f.GetEventTested
      OIT_GetEventTested_Event_DTC_0xd00587_GetEventTested: start-on-event=GetEventTested, operation=Event_DTC_0xd00587.GetEventTested
      OIT_GetEventTested_Event_DTC_0xd00687_GetEventTested: start-on-event=GetEventTested, operation=Event_DTC_0xd00687.GetEventTested
      OIT_GetEventTested_Event_DTC_0xd00787_GetEventTested: start-on-event=GetEventTested, operation=Event_DTC_0xd00787.GetEventTested
      OIT_GetEventTested_Event_DTC_0xd01087_GetEventTested: start-on-event=GetEventTested, operation=Event_DTC_0xd01087.GetEventTested
      OIT_GetEventTested_Event_DTC_0xd01187_GetEventTested: start-on-event=GetEventTested, operation=Event_DTC_0xd01187.GetEventTested
      OIT_GetEventTested_Event_DTC_0xd01387_GetEventTested: start-on-event=GetEventTested, operation=Event_DTC_0xd01387.GetEventTested
      OIT_GetEventTested_Event_DTC_0xd93286_GetEventTested: start-on-event=GetEventTested, operation=Event_DTC_0xd93286.GetEventTested
      OIT_GetEventTested_Event_DTC_0xd95283_GetEventTested: start-on-event=GetEventTested, operation=Event_DTC_0xd95283.GetEventTested
      OIT_GetEventTested_EvtInfo_CAN_E_TIMEOUT_GetEventTested: start-on-event=GetEventTested, operation=EvtInfo_CAN_E_TIMEOUT.GetEventTested
      OIT_GetEventTested_EvtInfo_CANIF_E_FULL_TX_BUFFER_GetEventTested: start-on-event=GetEventTested, operation=EvtInfo_CANIF_E_FULL_TX_BUFFER.GetEventTested
      OIT_GetEventTested_EvtInfo_CANIF_E_INVALID_DLC_GetEventTested: start-on-event=GetEventTested, operation=EvtInfo_CANIF_E_INVALID_DLC.GetEventTested
      OIT_GetEventTested_EvtInfo_CANIF_E_SLEEP_REQ_FAILED_GetEventTested: start-on-event=GetEventTested, operation=EvtInfo_CANIF_E_SLEEP_REQ_FAILED.GetEventTested
      OIT_GetEventTested_EvtInfo_CANIF_E_STOPPED_GetEventTested: start-on-event=GetEventTested, operation=EvtInfo_CANIF_E_STOPPED.GetEventTested
      OIT_GetEventTested_EvtInfo_CANSM_E_BUSOFF_NETWORK_0_GetEventTested: start-on-event=GetEventTested, operation=EvtInfo_CANSM_E_BUSOFF_NETWORK_0.GetEventTested
      OIT_GetEventTested_EvtInfo_CANSM_E_MISSING_TRCV_INDICATION_0_GetEventTested: start-on-event=GetEventTested, operation=EvtInfo_CANSM_E_MISSING_TRCV_INDICATION_0.GetEventTested
      OIT_GetEventTested_EvtInfo_CANSM_E_MODE_CHANGE_NETWORK_0_GetEventTested: start-on-event=GetEventTested, operation=EvtInfo_CANSM_E_MODE_CHANGE_NETWORK_0.GetEventTested
      OIT_GetEventTested_EvtInfo_CANTP_E_COMM_GetEventTested: start-on-event=GetEventTested, operation=EvtInfo_CANTP_E_COMM.GetEventTested
      OIT_GetEventTested_EvtInfo_ECUM_E_ALL_RUN_REQUESTS_KILLED_GetEventTested: start-on-event=GetEventTested, operation=EvtInfo_ECUM_E_ALL_RUN_REQUESTS_KILLED.GetEventTested
      OIT_GetEventTested_EvtInfo_ECUM_E_RAM_CHECK_FAILED_GetEventTested: start-on-event=GetEventTested, operation=EvtInfo_ECUM_E_RAM_CHECK_FAILED.GetEventTested
      OIT_GetEventTested_EvtInfo_FLS_E_ERASE_FAILED_GetEventTested: start-on-event=GetEventTested, operation=EvtInfo_FLS_E_ERASE_FAILED.GetEventTested
      OIT_GetEventTested_EvtInfo_FLS_E_READ_FAILED_GetEventTested: start-on-event=GetEventTested, operation=EvtInfo_FLS_E_READ_FAILED.GetEventTested
      OIT_GetEventTested_EvtInfo_FLS_E_WRITE_FAILED_GetEventTested: start-on-event=GetEventTested, operation=EvtInfo_FLS_E_WRITE_FAILED.GetEventTested
      OIT_GetEventTested_EvtInfo_MCU_E_CLOCK_FAILURE_GetEventTested: start-on-event=GetEventTested, operation=EvtInfo_MCU_E_CLOCK_FAILURE.GetEventTested
      OIT_GetEventTested_EvtInfo_NVM_E_INTEGRITY_FAILED_GetEventTested: start-on-event=GetEventTested, operation=EvtInfo_NVM_E_INTEGRITY_FAILED.GetEventTested
      OIT_GetEventTested_EvtInfo_NVM_E_REQ_FAILED_GetEventTested: start-on-event=GetEventTested, operation=EvtInfo_NVM_E_REQ_FAILED.GetEventTested
      OIT_GetEventTested_EvtInfo_PDUR_E_INIT_FAILED_GetEventTested: start-on-event=GetEventTested, operation=EvtInfo_PDUR_E_INIT_FAILED.GetEventTested
      OIT_GetEventTested_EvtInfo_PDUR_E_PDU_INSTANCE_LOST_GetEventTested: start-on-event=GetEventTested, operation=EvtInfo_PDUR_E_PDU_INSTANCE_LOST.GetEventTested
      OIT_GetEventTested_EvtInfo_SPI_E_SEQ_FAILED_GetEventTested: start-on-event=GetEventTested, operation=EvtInfo_SPI_E_SEQ_FAILED.GetEventTested
      OIT_GetEventTested_EvtInfo_WDGM_E_ALIVE_SUPERVISION_GetEventTested: start-on-event=GetEventTested, operation=EvtInfo_WDGM_E_ALIVE_SUPERVISION.GetEventTested
      OIT_GetEventTested_EvtInfo_WDGM_E_SET_MODE_GetEventTested: start-on-event=GetEventTested, operation=EvtInfo_WDGM_E_SET_MODE.GetEventTested
      OIT_GetFaultDetectionCounter_Event_DTC_0x500386_GetFaultDetectionCounter: start-on-event=GetFaultDetectionCounter, operation=Event_DTC_0x500386.GetFaultDetectionCounter
      OIT_GetFaultDetectionCounter_Event_DTC_0x500568_GetFaultDetectionCounter: start-on-event=GetFaultDetectionCounter, operation=Event_DTC_0x500568.GetFaultDetectionCounter
      OIT_GetFaultDetectionCounter_Event_DTC_0x500909_GetFaultDetectionCounter: start-on-event=GetFaultDetectionCounter, operation=Event_DTC_0x500909.GetFaultDetectionCounter
      OIT_GetFaultDetectionCounter_Event_DTC_0x52192f_GetFaultDetectionCounter: start-on-event=GetFaultDetectionCounter, operation=Event_DTC_0x52192f.GetFaultDetectionCounter
      OIT_GetFaultDetectionCounter_Event_DTC_0x521a54_GetFaultDetectionCounter: start-on-event=GetFaultDetectionCounter, operation=Event_DTC_0x521a54.GetFaultDetectionCounter
      OIT_GetFaultDetectionCounter_Event_DTC_0x559201_GetFaultDetectionCounter: start-on-event=GetFaultDetectionCounter, operation=Event_DTC_0x559201.GetFaultDetectionCounter
      OIT_GetFaultDetectionCounter_Event_DTC_0x{559211..559213}_GetFaultDetectionCounter: start-on-event=GetFaultDetectionCounter, operation=Event_DTC_0x{559211..559213}.GetFaultDetectionCounter
      OIT_GetFaultDetectionCounter_Event_DTC_0x559219_GetFaultDetectionCounter: start-on-event=GetFaultDetectionCounter, operation=Event_DTC_0x559219.GetFaultDetectionCounter
      OIT_GetFaultDetectionCounter_Event_DTC_0x{559311..559313}_GetFaultDetectionCounter: start-on-event=GetFaultDetectionCounter, operation=Event_DTC_0x{559311..559313}.GetFaultDetectionCounter
      OIT_GetFaultDetectionCounter_Event_DTC_0x559349_GetFaultDetectionCounter: start-on-event=GetFaultDetectionCounter, operation=Event_DTC_0x559349.GetFaultDetectionCounter
      OIT_GetFaultDetectionCounter_Event_DTC_0x620525_GetFaultDetectionCounter: start-on-event=GetFaultDetectionCounter, operation=Event_DTC_0x620525.GetFaultDetectionCounter
      OIT_GetFaultDetectionCounter_Event_DTC_0x621068_GetFaultDetectionCounter: start-on-event=GetFaultDetectionCounter, operation=Event_DTC_0x621068.GetFaultDetectionCounter
      OIT_GetFaultDetectionCounter_Event_DTC_0x621098_GetFaultDetectionCounter: start-on-event=GetFaultDetectionCounter, operation=Event_DTC_0x621098.GetFaultDetectionCounter
      OIT_GetFaultDetectionCounter_Event_DTC_0x621748_GetFaultDetectionCounter: start-on-event=GetFaultDetectionCounter, operation=Event_DTC_0x621748.GetFaultDetectionCounter
      OIT_GetFaultDetectionCounter_Event_DTC_0x621749_GetFaultDetectionCounter: start-on-event=GetFaultDetectionCounter, operation=Event_DTC_0x621749.GetFaultDetectionCounter
      OIT_GetFaultDetectionCounter_Event_DTC_0xa19916_GetFaultDetectionCounter: start-on-event=GetFaultDetectionCounter, operation=Event_DTC_0xa19916.GetFaultDetectionCounter
      OIT_GetFaultDetectionCounter_Event_DTC_0xa19917_GetFaultDetectionCounter: start-on-event=GetFaultDetectionCounter, operation=Event_DTC_0xa19917.GetFaultDetectionCounter
      OIT_GetFaultDetectionCounter_Event_DTC_0xa1991c_GetFaultDetectionCounter: start-on-event=GetFaultDetectionCounter, operation=Event_DTC_0xa1991c.GetFaultDetectionCounter
      OIT_GetFaultDetectionCounter_Event_DTC_0xa22c51_GetFaultDetectionCounter: start-on-event=GetFaultDetectionCounter, operation=Event_DTC_0xa22c51.GetFaultDetectionCounter
      OIT_GetFaultDetectionCounter_Event_DTC_0xa23b05_GetFaultDetectionCounter: start-on-event=GetFaultDetectionCounter, operation=Event_DTC_0xa23b05.GetFaultDetectionCounter
      OIT_GetFaultDetectionCounter_Event_DTC_0xc00187_GetFaultDetectionCounter: start-on-event=GetFaultDetectionCounter, operation=Event_DTC_0xc00187.GetFaultDetectionCounter
      OIT_GetFaultDetectionCounter_Event_DTC_0xc00188_GetFaultDetectionCounter: start-on-event=GetFaultDetectionCounter, operation=Event_DTC_0xc00188.GetFaultDetectionCounter
      OIT_GetFaultDetectionCounter_Event_DTC_0xc10087_GetFaultDetectionCounter: start-on-event=GetFaultDetectionCounter, operation=Event_DTC_0xc10087.GetFaultDetectionCounter
      OIT_GetFaultDetectionCounter_Event_DTC_0xc4012f_GetFaultDetectionCounter: start-on-event=GetFaultDetectionCounter, operation=Event_DTC_0xc4012f.GetFaultDetectionCounter
      OIT_GetFaultDetectionCounter_Event_DTC_0xc4152f_GetFaultDetectionCounter: start-on-event=GetFaultDetectionCounter, operation=Event_DTC_0xc4152f.GetFaultDetectionCounter
      OIT_GetFaultDetectionCounter_Event_DTC_0xc4222f_GetFaultDetectionCounter: start-on-event=GetFaultDetectionCounter, operation=Event_DTC_0xc4222f.GetFaultDetectionCounter
      OIT_GetFaultDetectionCounter_Event_DTC_0xc4232f_GetFaultDetectionCounter: start-on-event=GetFaultDetectionCounter, operation=Event_DTC_0xc4232f.GetFaultDetectionCounter
      OIT_GetFaultDetectionCounter_Event_DTC_0xd00587_GetFaultDetectionCounter: start-on-event=GetFaultDetectionCounter, operation=Event_DTC_0xd00587.GetFaultDetectionCounter
      OIT_GetFaultDetectionCounter_Event_DTC_0xd00687_GetFaultDetectionCounter: start-on-event=GetFaultDetectionCounter, operation=Event_DTC_0xd00687.GetFaultDetectionCounter
      OIT_GetFaultDetectionCounter_Event_DTC_0xd00787_GetFaultDetectionCounter: start-on-event=GetFaultDetectionCounter, operation=Event_DTC_0xd00787.GetFaultDetectionCounter
      OIT_GetFaultDetectionCounter_Event_DTC_0xd01087_GetFaultDetectionCounter: start-on-event=GetFaultDetectionCounter, operation=Event_DTC_0xd01087.GetFaultDetectionCounter
      OIT_GetFaultDetectionCounter_Event_DTC_0xd01187_GetFaultDetectionCounter: start-on-event=GetFaultDetectionCounter, operation=Event_DTC_0xd01187.GetFaultDetectionCounter
      OIT_GetFaultDetectionCounter_Event_DTC_0xd01387_GetFaultDetectionCounter: start-on-event=GetFaultDetectionCounter, operation=Event_DTC_0xd01387.GetFaultDetectionCounter
      OIT_GetFaultDetectionCounter_Event_DTC_0xd93286_GetFaultDetectionCounter: start-on-event=GetFaultDetectionCounter, operation=Event_DTC_0xd93286.GetFaultDetectionCounter
      OIT_GetFaultDetectionCounter_Event_DTC_0xd95283_GetFaultDetectionCounter: start-on-event=GetFaultDetectionCounter, operation=Event_DTC_0xd95283.GetFaultDetectionCounter
      OIT_GetFaultDetectionCounter_EvtInfo_CAN_E_TIMEOUT_GetFaultDetectionCounter: start-on-event=GetFaultDetectionCounter, operation=EvtInfo_CAN_E_TIMEOUT.GetFaultDetectionCounter
      OIT_GetFaultDetectionCounter_EvtInfo_CANIF_E_FULL_TX_BUFFER_GetFaultDetectionCounter: start-on-event=GetFaultDetectionCounter, operation=EvtInfo_CANIF_E_FULL_TX_BUFFER.GetFaultDetectionCounter
      OIT_GetFaultDetectionCounter_EvtInfo_CANIF_E_INVALID_DLC_GetFaultDetectionCounter: start-on-event=GetFaultDetectionCounter, operation=EvtInfo_CANIF_E_INVALID_DLC.GetFaultDetectionCounter
      OIT_GetFaultDetectionCounter_EvtInfo_CANIF_E_SLEEP_REQ_FAILED_GetFaultDetectionCounter: start-on-event=GetFaultDetectionCounter, operation=EvtInfo_CANIF_E_SLEEP_REQ_FAILED.GetFaultDetectionCounter
      OIT_GetFaultDetectionCounter_EvtInfo_CANIF_E_STOPPED_GetFaultDetectionCounter: start-on-event=GetFaultDetectionCounter, operation=EvtInfo_CANIF_E_STOPPED.GetFaultDetectionCounter
      OIT_GetFaultDetectionCounter_EvtInfo_CANSM_E_BUSOFF_NETWORK_0_GetFaultDetectionCounter: start-on-event=GetFaultDetectionCounter, operation=EvtInfo_CANSM_E_BUSOFF_NETWORK_0.GetFaultDetectionCounter
      OIT_GetFaultDetectionCounter_EvtInfo_CANSM_E_MISSING_TRCV_INDICATION_0_GetFaultDetectionCounter: start-on-event=GetFaultDetectionCounter, operation=EvtInfo_CANSM_E_MISSING_TRCV_INDICATION_0.GetFaultDetectionCounter
      OIT_GetFaultDetectionCounter_EvtInfo_CANSM_E_MODE_CHANGE_NETWORK_0_GetFaultDetectionCounter: start-on-event=GetFaultDetectionCounter, operation=EvtInfo_CANSM_E_MODE_CHANGE_NETWORK_0.GetFaultDetectionCounter
      OIT_GetFaultDetectionCounter_EvtInfo_CANTP_E_COMM_GetFaultDetectionCounter: start-on-event=GetFaultDetectionCounter, operation=EvtInfo_CANTP_E_COMM.GetFaultDetectionCounter
      OIT_GetFaultDetectionCounter_EvtInfo_ECUM_E_ALL_RUN_REQUESTS_KILLED_GetFaultDetectionCounter: start-on-event=GetFaultDetectionCounter, operation=EvtInfo_ECUM_E_ALL_RUN_REQUESTS_KILLED.GetFaultDetectionCounter
      OIT_GetFaultDetectionCounter_EvtInfo_ECUM_E_RAM_CHECK_FAILED_GetFaultDetectionCounter: start-on-event=GetFaultDetectionCounter, operation=EvtInfo_ECUM_E_RAM_CHECK_FAILED.GetFaultDetectionCounter
      OIT_GetFaultDetectionCounter_EvtInfo_FLS_E_ERASE_FAILED_GetFaultDetectionCounter: start-on-event=GetFaultDetectionCounter, operation=EvtInfo_FLS_E_ERASE_FAILED.GetFaultDetectionCounter
      OIT_GetFaultDetectionCounter_EvtInfo_FLS_E_READ_FAILED_GetFaultDetectionCounter: start-on-event=GetFaultDetectionCounter, operation=EvtInfo_FLS_E_READ_FAILED.GetFaultDetectionCounter
      OIT_GetFaultDetectionCounter_EvtInfo_FLS_E_WRITE_FAILED_GetFaultDetectionCounter: start-on-event=GetFaultDetectionCounter, operation=EvtInfo_FLS_E_WRITE_FAILED.GetFaultDetectionCounter
      OIT_GetFaultDetectionCounter_EvtInfo_MCU_E_CLOCK_FAILURE_GetFaultDetectionCounter: start-on-event=GetFaultDetectionCounter, operation=EvtInfo_MCU_E_CLOCK_FAILURE.GetFaultDetectionCounter
      OIT_GetFaultDetectionCounter_EvtInfo_NVM_E_INTEGRITY_FAILED_GetFaultDetectionCounter: start-on-event=GetFaultDetectionCounter, operation=EvtInfo_NVM_E_INTEGRITY_FAILED.GetFaultDetectionCounter
      OIT_GetFaultDetectionCounter_EvtInfo_NVM_E_REQ_FAILED_GetFaultDetectionCounter: start-on-event=GetFaultDetectionCounter, operation=EvtInfo_NVM_E_REQ_FAILED.GetFaultDetectionCounter
      OIT_GetFaultDetectionCounter_EvtInfo_PDUR_E_INIT_FAILED_GetFaultDetectionCounter: start-on-event=GetFaultDetectionCounter, operation=EvtInfo_PDUR_E_INIT_FAILED.GetFaultDetectionCounter
      OIT_GetFaultDetectionCounter_EvtInfo_PDUR_E_PDU_INSTANCE_LOST_GetFaultDetectionCounter: start-on-event=GetFaultDetectionCounter, operation=EvtInfo_PDUR_E_PDU_INSTANCE_LOST.GetFaultDetectionCounter
      OIT_GetFaultDetectionCounter_EvtInfo_SPI_E_SEQ_FAILED_GetFaultDetectionCounter: start-on-event=GetFaultDetectionCounter, operation=EvtInfo_SPI_E_SEQ_FAILED.GetFaultDetectionCounter
      OIT_GetFaultDetectionCounter_EvtInfo_WDGM_E_ALIVE_SUPERVISION_GetFaultDetectionCounter: start-on-event=GetFaultDetectionCounter, operation=EvtInfo_WDGM_E_ALIVE_SUPERVISION.GetFaultDetectionCounter
      OIT_GetFaultDetectionCounter_EvtInfo_WDGM_E_SET_MODE_GetFaultDetectionCounter: start-on-event=GetFaultDetectionCounter, operation=EvtInfo_WDGM_E_SET_MODE.GetFaultDetectionCounter
      OIT_PostRunRequested_PostRunRequest_PostRunRequested: start-on-event=PostRunRequested, operation=PostRunRequest.PostRunRequested
      OIT_PrestoreFreezeFrame_Event_DTC_0x500386_PrestoreFreezeFrame: start-on-event=PrestoreFreezeFrame, operation=Event_DTC_0x500386.PrestoreFreezeFrame
      OIT_PrestoreFreezeFrame_Event_DTC_0x500568_PrestoreFreezeFrame: start-on-event=PrestoreFreezeFrame, operation=Event_DTC_0x500568.PrestoreFreezeFrame
      OIT_PrestoreFreezeFrame_Event_DTC_0x500909_PrestoreFreezeFrame: start-on-event=PrestoreFreezeFrame, operation=Event_DTC_0x500909.PrestoreFreezeFrame
      OIT_PrestoreFreezeFrame_Event_DTC_0x52192f_PrestoreFreezeFrame: start-on-event=PrestoreFreezeFrame, operation=Event_DTC_0x52192f.PrestoreFreezeFrame
      OIT_PrestoreFreezeFrame_Event_DTC_0x521a54_PrestoreFreezeFrame: start-on-event=PrestoreFreezeFrame, operation=Event_DTC_0x521a54.PrestoreFreezeFrame
      OIT_PrestoreFreezeFrame_Event_DTC_0x559201_PrestoreFreezeFrame: start-on-event=PrestoreFreezeFrame, operation=Event_DTC_0x559201.PrestoreFreezeFrame
      OIT_PrestoreFreezeFrame_Event_DTC_0x{559211..559213}_PrestoreFreezeFrame: start-on-event=PrestoreFreezeFrame, operation=Event_DTC_0x{559211..559213}.PrestoreFreezeFrame
      OIT_PrestoreFreezeFrame_Event_DTC_0x559219_PrestoreFreezeFrame: start-on-event=PrestoreFreezeFrame, operation=Event_DTC_0x559219.PrestoreFreezeFrame
      OIT_PrestoreFreezeFrame_Event_DTC_0x{559311..559313}_PrestoreFreezeFrame: start-on-event=PrestoreFreezeFrame, operation=Event_DTC_0x{559311..559313}.PrestoreFreezeFrame
      OIT_PrestoreFreezeFrame_Event_DTC_0x559349_PrestoreFreezeFrame: start-on-event=PrestoreFreezeFrame, operation=Event_DTC_0x559349.PrestoreFreezeFrame
      OIT_PrestoreFreezeFrame_Event_DTC_0x620525_PrestoreFreezeFrame: start-on-event=PrestoreFreezeFrame, operation=Event_DTC_0x620525.PrestoreFreezeFrame
      OIT_PrestoreFreezeFrame_Event_DTC_0x621068_PrestoreFreezeFrame: start-on-event=PrestoreFreezeFrame, operation=Event_DTC_0x621068.PrestoreFreezeFrame
      OIT_PrestoreFreezeFrame_Event_DTC_0x621098_PrestoreFreezeFrame: start-on-event=PrestoreFreezeFrame, operation=Event_DTC_0x621098.PrestoreFreezeFrame
      OIT_PrestoreFreezeFrame_Event_DTC_0x621748_PrestoreFreezeFrame: start-on-event=PrestoreFreezeFrame, operation=Event_DTC_0x621748.PrestoreFreezeFrame
      OIT_PrestoreFreezeFrame_Event_DTC_0x621749_PrestoreFreezeFrame: start-on-event=PrestoreFreezeFrame, operation=Event_DTC_0x621749.PrestoreFreezeFrame
      OIT_PrestoreFreezeFrame_Event_DTC_0xa19916_PrestoreFreezeFrame: start-on-event=PrestoreFreezeFrame, operation=Event_DTC_0xa19916.PrestoreFreezeFrame
      OIT_PrestoreFreezeFrame_Event_DTC_0xa19917_PrestoreFreezeFrame: start-on-event=PrestoreFreezeFrame, operation=Event_DTC_0xa19917.PrestoreFreezeFrame
      OIT_PrestoreFreezeFrame_Event_DTC_0xa1991c_PrestoreFreezeFrame: start-on-event=PrestoreFreezeFrame, operation=Event_DTC_0xa1991c.PrestoreFreezeFrame
      OIT_PrestoreFreezeFrame_Event_DTC_0xa22c51_PrestoreFreezeFrame: start-on-event=PrestoreFreezeFrame, operation=Event_DTC_0xa22c51.PrestoreFreezeFrame
      OIT_PrestoreFreezeFrame_Event_DTC_0xa23b05_PrestoreFreezeFrame: start-on-event=PrestoreFreezeFrame, operation=Event_DTC_0xa23b05.PrestoreFreezeFrame
      OIT_PrestoreFreezeFrame_Event_DTC_0xc00187_PrestoreFreezeFrame: start-on-event=PrestoreFreezeFrame, operation=Event_DTC_0xc00187.PrestoreFreezeFrame
      OIT_PrestoreFreezeFrame_Event_DTC_0xc00188_PrestoreFreezeFrame: start-on-event=PrestoreFreezeFrame, operation=Event_DTC_0xc00188.PrestoreFreezeFrame
      OIT_PrestoreFreezeFrame_Event_DTC_0xc10087_PrestoreFreezeFrame: start-on-event=PrestoreFreezeFrame, operation=Event_DTC_0xc10087.PrestoreFreezeFrame
      OIT_PrestoreFreezeFrame_Event_DTC_0xc4012f_PrestoreFreezeFrame: start-on-event=PrestoreFreezeFrame, operation=Event_DTC_0xc4012f.PrestoreFreezeFrame
      OIT_PrestoreFreezeFrame_Event_DTC_0xc4152f_PrestoreFreezeFrame: start-on-event=PrestoreFreezeFrame, operation=Event_DTC_0xc4152f.PrestoreFreezeFrame
      OIT_PrestoreFreezeFrame_Event_DTC_0xc4222f_PrestoreFreezeFrame: start-on-event=PrestoreFreezeFrame, operation=Event_DTC_0xc4222f.PrestoreFreezeFrame
      OIT_PrestoreFreezeFrame_Event_DTC_0xc4232f_PrestoreFreezeFrame: start-on-event=PrestoreFreezeFrame, operation=Event_DTC_0xc4232f.PrestoreFreezeFrame
      OIT_PrestoreFreezeFrame_Event_DTC_0xd00587_PrestoreFreezeFrame: start-on-event=PrestoreFreezeFrame, operation=Event_DTC_0xd00587.PrestoreFreezeFrame
      OIT_PrestoreFreezeFrame_Event_DTC_0xd00687_PrestoreFreezeFrame: start-on-event=PrestoreFreezeFrame, operation=Event_DTC_0xd00687.PrestoreFreezeFrame
      OIT_PrestoreFreezeFrame_Event_DTC_0xd00787_PrestoreFreezeFrame: start-on-event=PrestoreFreezeFrame, operation=Event_DTC_0xd00787.PrestoreFreezeFrame
      OIT_PrestoreFreezeFrame_Event_DTC_0xd01087_PrestoreFreezeFrame: start-on-event=PrestoreFreezeFrame, operation=Event_DTC_0xd01087.PrestoreFreezeFrame
      OIT_PrestoreFreezeFrame_Event_DTC_0xd01187_PrestoreFreezeFrame: start-on-event=PrestoreFreezeFrame, operation=Event_DTC_0xd01187.PrestoreFreezeFrame
      OIT_PrestoreFreezeFrame_Event_DTC_0xd01387_PrestoreFreezeFrame: start-on-event=PrestoreFreezeFrame, operation=Event_DTC_0xd01387.PrestoreFreezeFrame
      OIT_PrestoreFreezeFrame_Event_DTC_0xd93286_PrestoreFreezeFrame: start-on-event=PrestoreFreezeFrame, operation=Event_DTC_0xd93286.PrestoreFreezeFrame
      OIT_PrestoreFreezeFrame_Event_DTC_0xd95283_PrestoreFreezeFrame: start-on-event=PrestoreFreezeFrame, operation=Event_DTC_0xd95283.PrestoreFreezeFrame
      OIT_ResetEventStatus_Event_DTC_0x500386_ResetEventStatus: start-on-event=ResetEventStatus, operation=Event_DTC_0x500386.ResetEventStatus
      OIT_ResetEventStatus_Event_DTC_0x500568_ResetEventStatus: start-on-event=ResetEventStatus, operation=Event_DTC_0x500568.ResetEventStatus
      OIT_ResetEventStatus_Event_DTC_0x500909_ResetEventStatus: start-on-event=ResetEventStatus, operation=Event_DTC_0x500909.ResetEventStatus
      OIT_ResetEventStatus_Event_DTC_0x52192f_ResetEventStatus: start-on-event=ResetEventStatus, operation=Event_DTC_0x52192f.ResetEventStatus
      OIT_ResetEventStatus_Event_DTC_0x521a54_ResetEventStatus: start-on-event=ResetEventStatus, operation=Event_DTC_0x521a54.ResetEventStatus
      OIT_ResetEventStatus_Event_DTC_0x559201_ResetEventStatus: start-on-event=ResetEventStatus, operation=Event_DTC_0x559201.ResetEventStatus
      OIT_ResetEventStatus_Event_DTC_0x{559211..559213}_ResetEventStatus: start-on-event=ResetEventStatus, operation=Event_DTC_0x{559211..559213}.ResetEventStatus
      OIT_ResetEventStatus_Event_DTC_0x559219_ResetEventStatus: start-on-event=ResetEventStatus, operation=Event_DTC_0x559219.ResetEventStatus
      OIT_ResetEventStatus_Event_DTC_0x{559311..559313}_ResetEventStatus: start-on-event=ResetEventStatus, operation=Event_DTC_0x{559311..559313}.ResetEventStatus
      OIT_ResetEventStatus_Event_DTC_0x559349_ResetEventStatus: start-on-event=ResetEventStatus, operation=Event_DTC_0x559349.ResetEventStatus
      OIT_ResetEventStatus_Event_DTC_0x620525_ResetEventStatus: start-on-event=ResetEventStatus, operation=Event_DTC_0x620525.ResetEventStatus
      OIT_ResetEventStatus_Event_DTC_0x621068_ResetEventStatus: start-on-event=ResetEventStatus, operation=Event_DTC_0x621068.ResetEventStatus
      OIT_ResetEventStatus_Event_DTC_0x621098_ResetEventStatus: start-on-event=ResetEventStatus, operation=Event_DTC_0x621098.ResetEventStatus
      OIT_ResetEventStatus_Event_DTC_0x621748_ResetEventStatus: start-on-event=ResetEventStatus, operation=Event_DTC_0x621748.ResetEventStatus
      OIT_ResetEventStatus_Event_DTC_0x621749_ResetEventStatus: start-on-event=ResetEventStatus, operation=Event_DTC_0x621749.ResetEventStatus
      OIT_ResetEventStatus_Event_DTC_0xa19916_ResetEventStatus: start-on-event=ResetEventStatus, operation=Event_DTC_0xa19916.ResetEventStatus
      OIT_ResetEventStatus_Event_DTC_0xa19917_ResetEventStatus: start-on-event=ResetEventStatus, operation=Event_DTC_0xa19917.ResetEventStatus
      OIT_ResetEventStatus_Event_DTC_0xa1991c_ResetEventStatus: start-on-event=ResetEventStatus, operation=Event_DTC_0xa1991c.ResetEventStatus
      OIT_ResetEventStatus_Event_DTC_0xa22c51_ResetEventStatus: start-on-event=ResetEventStatus, operation=Event_DTC_0xa22c51.ResetEventStatus
      OIT_ResetEventStatus_Event_DTC_0xa23b05_ResetEventStatus: start-on-event=ResetEventStatus, operation=Event_DTC_0xa23b05.ResetEventStatus
      OIT_ResetEventStatus_Event_DTC_0xc00187_ResetEventStatus: start-on-event=ResetEventStatus, operation=Event_DTC_0xc00187.ResetEventStatus
      OIT_ResetEventStatus_Event_DTC_0xc00188_ResetEventStatus: start-on-event=ResetEventStatus, operation=Event_DTC_0xc00188.ResetEventStatus
      OIT_ResetEventStatus_Event_DTC_0xc10087_ResetEventStatus: start-on-event=ResetEventStatus, operation=Event_DTC_0xc10087.ResetEventStatus
      OIT_ResetEventStatus_Event_DTC_0xc4012f_ResetEventStatus: start-on-event=ResetEventStatus, operation=Event_DTC_0xc4012f.ResetEventStatus
      OIT_ResetEventStatus_Event_DTC_0xc4152f_ResetEventStatus: start-on-event=ResetEventStatus, operation=Event_DTC_0xc4152f.ResetEventStatus
      OIT_ResetEventStatus_Event_DTC_0xc4222f_ResetEventStatus: start-on-event=ResetEventStatus, operation=Event_DTC_0xc4222f.ResetEventStatus
      OIT_ResetEventStatus_Event_DTC_0xc4232f_ResetEventStatus: start-on-event=ResetEventStatus, operation=Event_DTC_0xc4232f.ResetEventStatus
      OIT_ResetEventStatus_Event_DTC_0xd00587_ResetEventStatus: start-on-event=ResetEventStatus, operation=Event_DTC_0xd00587.ResetEventStatus
      OIT_ResetEventStatus_Event_DTC_0xd00687_ResetEventStatus: start-on-event=ResetEventStatus, operation=Event_DTC_0xd00687.ResetEventStatus
      OIT_ResetEventStatus_Event_DTC_0xd00787_ResetEventStatus: start-on-event=ResetEventStatus, operation=Event_DTC_0xd00787.ResetEventStatus
      OIT_ResetEventStatus_Event_DTC_0xd01087_ResetEventStatus: start-on-event=ResetEventStatus, operation=Event_DTC_0xd01087.ResetEventStatus
      OIT_ResetEventStatus_Event_DTC_0xd01187_ResetEventStatus: start-on-event=ResetEventStatus, operation=Event_DTC_0xd01187.ResetEventStatus
      OIT_ResetEventStatus_Event_DTC_0xd01387_ResetEventStatus: start-on-event=ResetEventStatus, operation=Event_DTC_0xd01387.ResetEventStatus
      OIT_ResetEventStatus_Event_DTC_0xd93286_ResetEventStatus: start-on-event=ResetEventStatus, operation=Event_DTC_0xd93286.ResetEventStatus
      OIT_ResetEventStatus_Event_DTC_0xd95283_ResetEventStatus: start-on-event=ResetEventStatus, operation=Event_DTC_0xd95283.ResetEventStatus
      OIT_SetEventStatus_Event_DTC_0x500386_SetEventStatus: start-on-event=SetEventStatus, operation=Event_DTC_0x500386.SetEventStatus
      OIT_SetEventStatus_Event_DTC_0x500568_SetEventStatus: start-on-event=SetEventStatus, operation=Event_DTC_0x500568.SetEventStatus
      OIT_SetEventStatus_Event_DTC_0x500909_SetEventStatus: start-on-event=SetEventStatus, operation=Event_DTC_0x500909.SetEventStatus
      OIT_SetEventStatus_Event_DTC_0x52192f_SetEventStatus: start-on-event=SetEventStatus, operation=Event_DTC_0x52192f.SetEventStatus
      OIT_SetEventStatus_Event_DTC_0x521a54_SetEventStatus: start-on-event=SetEventStatus, operation=Event_DTC_0x521a54.SetEventStatus
      OIT_SetEventStatus_Event_DTC_0x559201_SetEventStatus: start-on-event=SetEventStatus, operation=Event_DTC_0x559201.SetEventStatus
      OIT_SetEventStatus_Event_DTC_0x{559211..559213}_SetEventStatus: start-on-event=SetEventStatus, operation=Event_DTC_0x{559211..559213}.SetEventStatus
      OIT_SetEventStatus_Event_DTC_0x559219_SetEventStatus: start-on-event=SetEventStatus, operation=Event_DTC_0x559219.SetEventStatus
      OIT_SetEventStatus_Event_DTC_0x{559311..559313}_SetEventStatus: start-on-event=SetEventStatus, operation=Event_DTC_0x{559311..559313}.SetEventStatus
      OIT_SetEventStatus_Event_DTC_0x559349_SetEventStatus: start-on-event=SetEventStatus, operation=Event_DTC_0x559349.SetEventStatus
      OIT_SetEventStatus_Event_DTC_0x620525_SetEventStatus: start-on-event=SetEventStatus, operation=Event_DTC_0x620525.SetEventStatus
      OIT_SetEventStatus_Event_DTC_0x621068_SetEventStatus: start-on-event=SetEventStatus, operation=Event_DTC_0x621068.SetEventStatus
      OIT_SetEventStatus_Event_DTC_0x621098_SetEventStatus: start-on-event=SetEventStatus, operation=Event_DTC_0x621098.SetEventStatus
      OIT_SetEventStatus_Event_DTC_0x621748_SetEventStatus: start-on-event=SetEventStatus, operation=Event_DTC_0x621748.SetEventStatus
      OIT_SetEventStatus_Event_DTC_0x621749_SetEventStatus: start-on-event=SetEventStatus, operation=Event_DTC_0x621749.SetEventStatus
      OIT_SetEventStatus_Event_DTC_0xa19916_SetEventStatus: start-on-event=SetEventStatus, operation=Event_DTC_0xa19916.SetEventStatus
      OIT_SetEventStatus_Event_DTC_0xa19917_SetEventStatus: start-on-event=SetEventStatus, operation=Event_DTC_0xa19917.SetEventStatus
      OIT_SetEventStatus_Event_DTC_0xa1991c_SetEventStatus: start-on-event=SetEventStatus, operation=Event_DTC_0xa1991c.SetEventStatus
      OIT_SetEventStatus_Event_DTC_0xa22c51_SetEventStatus: start-on-event=SetEventStatus, operation=Event_DTC_0xa22c51.SetEventStatus
      OIT_SetEventStatus_Event_DTC_0xa23b05_SetEventStatus: start-on-event=SetEventStatus, operation=Event_DTC_0xa23b05.SetEventStatus
      OIT_SetEventStatus_Event_DTC_0xc00187_SetEventStatus: start-on-event=SetEventStatus, operation=Event_DTC_0xc00187.SetEventStatus
      OIT_SetEventStatus_Event_DTC_0xc00188_SetEventStatus: start-on-event=SetEventStatus, operation=Event_DTC_0xc00188.SetEventStatus
      OIT_SetEventStatus_Event_DTC_0xc10087_SetEventStatus: start-on-event=SetEventStatus, operation=Event_DTC_0xc10087.SetEventStatus
      OIT_SetEventStatus_Event_DTC_0xc4012f_SetEventStatus: start-on-event=SetEventStatus, operation=Event_DTC_0xc4012f.SetEventStatus
      OIT_SetEventStatus_Event_DTC_0xc4152f_SetEventStatus: start-on-event=SetEventStatus, operation=Event_DTC_0xc4152f.SetEventStatus
      OIT_SetEventStatus_Event_DTC_0xc4222f_SetEventStatus: start-on-event=SetEventStatus, operation=Event_DTC_0xc4222f.SetEventStatus
      OIT_SetEventStatus_Event_DTC_0xc4232f_SetEventStatus: start-on-event=SetEventStatus, operation=Event_DTC_0xc4232f.SetEventStatus
      OIT_SetEventStatus_Event_DTC_0xd00587_SetEventStatus: start-on-event=SetEventStatus, operation=Event_DTC_0xd00587.SetEventStatus
      OIT_SetEventStatus_Event_DTC_0xd00687_SetEventStatus: start-on-event=SetEventStatus, operation=Event_DTC_0xd00687.SetEventStatus
      OIT_SetEventStatus_Event_DTC_0xd00787_SetEventStatus: start-on-event=SetEventStatus, operation=Event_DTC_0xd00787.SetEventStatus
      OIT_SetEventStatus_Event_DTC_0xd01087_SetEventStatus: start-on-event=SetEventStatus, operation=Event_DTC_0xd01087.SetEventStatus
      OIT_SetEventStatus_Event_DTC_0xd01187_SetEventStatus: start-on-event=SetEventStatus, operation=Event_DTC_0xd01187.SetEventStatus
      OIT_SetEventStatus_Event_DTC_0xd01387_SetEventStatus: start-on-event=SetEventStatus, operation=Event_DTC_0xd01387.SetEventStatus
      OIT_SetEventStatus_Event_DTC_0xd93286_SetEventStatus: start-on-event=SetEventStatus, operation=Event_DTC_0xd93286.SetEventStatus
      OIT_SetEventStatus_Event_DTC_0xd95283_SetEventStatus: start-on-event=SetEventStatus, operation=Event_DTC_0xd95283.SetEventStatus
      OIT_SetOperationCycleState_OpCycle_DEM_IGNITION_SetOperationCycleState: start-on-event=SetOperationCycleState, operation=OpCycle_DEM_IGNITION.SetOperationCycleState
      OIT_SetOperationCycleState_OpCycle_DEM_OBD_DCY_SetOperationCycleState: start-on-event=SetOperationCycleState, operation=OpCycle_DEM_OBD_DCY.SetOperationCycleState
      OIT_SetOperationCycleState_OpCycle_DEM_POWER_SetOperationCycleState: start-on-event=SetOperationCycleState, operation=OpCycle_DEM_POWER.SetOperationCycleState
      OIT_SetOperationCycleState_OpCycle_DEM_WARMUP_SetOperationCycleState: start-on-event=SetOperationCycleState, operation=OpCycle_DEM_WARMUP.SetOperationCycleState
    port-api-options port-api-option={enable-take-address=true, indirect-api=false, port=CBExtDataRec_0x01}, port-api-option={enable-take-address=true, indirect-api=false, port=CBValByDID_0x0885}, port-api-option={enable-take-address=true, indirect-api=false, port=CBValByDID_0x0ad8}, port-api-option={enable-take-address=true, indirect-api=false, port=CBValByDID_0x1002}, port-api-option={enable-take-address=true, indirect-api=false, port=CBValByDID_0x1004}, port-api-option={enable-take-address=true, indirect-api=false, port=CBValByDID_0x1008}, port-api-option={enable-take-address=true, indirect-api=false, port=CBValByDID_0x1009}, port-api-option={enable-take-address=true, indirect-api=false, port=CBValByDID_0x2001}, port-api-option={enable-take-address=true, indirect-api=false, port=CBValByDID_0x200a}, port-api-option={enable-take-address=true, indirect-api=false, port=PostRunRequest}:
      port-api-option enable-take-address=true, indirect-api=false, port=Event_DTC_0x500386:
        port-arg-values:
          integer literal Event_DTC_0x500386: type=Dem_EventIdType, value=39
      port-api-option enable-take-address=true, indirect-api=false, port=Event_DTC_0x500568:
        port-arg-values:
          integer literal Event_DTC_0x500568: type=Dem_EventIdType, value=38
      port-api-option enable-take-address=true, indirect-api=false, port=Event_DTC_0x500909:
        port-arg-values:
          integer literal Event_DTC_0x500909: type=Dem_EventIdType, value=37
      port-api-option enable-take-address=true, indirect-api=false, port=Event_DTC_0x52192f:
        port-arg-values:
          integer literal Event_DTC_0x52192f: type=Dem_EventIdType, value=36
      port-api-option enable-take-address=true, indirect-api=false, port=Event_DTC_0x521a54:
        port-arg-values:
          integer literal Event_DTC_0x521a54: type=Dem_EventIdType, value=35
      port-api-option enable-take-address=true, indirect-api=false, port=Event_DTC_0x559201:
        port-arg-values:
          integer literal Event_DTC_0x559201: type=Dem_EventIdType, value=34
      port-api-option enable-take-address=true, indirect-api=false, port=Event_DTC_0x559211:
        port-arg-values:
          integer literal Event_DTC_0x559211: type=Dem_EventIdType, value=33
      port-api-option enable-take-address=true, indirect-api=false, port=Event_DTC_0x559212:
        port-arg-values:
          integer literal Event_DTC_0x559212: type=Dem_EventIdType, value=32
      port-api-option enable-take-address=true, indirect-api=false, port=Event_DTC_0x559213:
        port-arg-values:
          integer literal Event_DTC_0x559213: type=Dem_EventIdType, value=31
      port-api-option enable-take-address=true, indirect-api=false, port=Event_DTC_0x559219:
        port-arg-values:
          integer literal Event_DTC_0x559219: type=Dem_EventIdType, value=30
      port-api-option enable-take-address=true, indirect-api=false, port=Event_DTC_0x559311:
        port-arg-values:
          integer literal Event_DTC_0x559311: type=Dem_EventIdType, value=29
      port-api-option enable-take-address=true, indirect-api=false, port=Event_DTC_0x559312:
        port-arg-values:
          integer literal Event_DTC_0x559312: type=Dem_EventIdType, value=28
      port-api-option enable-take-address=true, indirect-api=false, port=Event_DTC_0x559313:
        port-arg-values:
          integer literal Event_DTC_0x559313: type=Dem_EventIdType, value=27
      port-api-option enable-take-address=true, indirect-api=false, port=Event_DTC_0x559349:
        port-arg-values:
          integer literal Event_DTC_0x559349: type=Dem_EventIdType, value=26
      port-api-option enable-take-address=true, indirect-api=false, port=Event_DTC_0x620525:
        port-arg-values:
          integer literal Event_DTC_0x620525: type=Dem_EventIdType, value=25
      port-api-option enable-take-address=true, indirect-api=false, port=Event_DTC_0x621068:
        port-arg-values:
          integer literal Event_DTC_0x621068: type=Dem_EventIdType, value=24
      port-api-option enable-take-address=true, indirect-api=false, port=Event_DTC_0x621098:
        port-arg-values:
          integer literal Event_DTC_0x621098: type=Dem_EventIdType, value=23
      port-api-option enable-take-address=true, indirect-api=false, port=Event_DTC_0x621748:
        port-arg-values:
          integer literal Event_DTC_0x621748: type=Dem_EventIdType, value=22
      port-api-option enable-take-address=true, indirect-api=false, port=Event_DTC_0x621749:
        port-arg-values:
          integer literal Event_DTC_0x621749: type=Dem_EventIdType, value=21
      port-api-option enable-take-address=true, indirect-api=false, port=Event_DTC_0xa19916:
        port-arg-values:
          integer literal Event_DTC_0xa19916: type=Dem_EventIdType, value=20
      port-api-option enable-take-address=true, indirect-api=false, port=Event_DTC_0xa19917:
        port-arg-values:
          integer literal Event_DTC_0xa19917: type=Dem_EventIdType, value=19
      port-api-option enable-take-address=true, indirect-api=false, port=Event_DTC_0xa1991c:
        port-arg-values:
          integer literal Event_DTC_0xa1991c: type=Dem_EventIdType, value=18
      port-api-option enable-take-address=true, indirect-api=false, port=Event_DTC_0xa22c51:
        port-arg-values:
          integer literal Event_DTC_0xa22c51: type=Dem_EventIdType, value=17
      port-api-option enable-take-address=true, indirect-api=false, port=Event_DTC_0xa23b05:
        port-arg-values:
          integer literal Event_DTC_0xa23b05: type=Dem_EventIdType, value=16
      port-api-option enable-take-address=true, indirect-api=false, port=Event_DTC_0xc00187:
        port-arg-values:
          integer literal Event_DTC_0xc00187: type=Dem_EventIdType, value=15
      port-api-option enable-take-address=true, indirect-api=false, port=Event_DTC_0xc00188:
        port-arg-values:
          integer literal Event_DTC_0xc00188: type=Dem_EventIdType, value=14
      port-api-option enable-take-address=true, indirect-api=false, port=Event_DTC_0xc10087:
        port-arg-values:
          integer literal Event_DTC_0xc10087: type=Dem_EventIdType, value=13
      port-api-option enable-take-address=true, indirect-api=false, port=Event_DTC_0xc4012f:
        port-arg-values:
          integer literal Event_DTC_0xc4012f: type=Dem_EventIdType, value=12
      port-api-option enable-take-address=true, indirect-api=false, port=Event_DTC_0xc4152f:
        port-arg-values:
          integer literal Event_DTC_0xc4152f: type=Dem_EventIdType, value=11
      port-api-option enable-take-address=true, indirect-api=false, port=Event_DTC_0xc4222f:
        port-arg-values:
          integer literal Event_DTC_0xc4222f: type=Dem_EventIdType, value=10
      port-api-option enable-take-address=true, indirect-api=false, port=Event_DTC_0xc4232f:
        port-arg-values:
          integer literal Event_DTC_0xc4232f: type=Dem_EventIdType, value=9
      port-api-option enable-take-address=true, indirect-api=false, port=Event_DTC_0xd00587:
        port-arg-values:
          integer literal Event_DTC_0xd00587: type=Dem_EventIdType, value=8
      port-api-option enable-take-address=true, indirect-api=false, port=Event_DTC_0xd00687:
        port-arg-values:
          integer literal Event_DTC_0xd00687: type=Dem_EventIdType, value=7
      port-api-option enable-take-address=true, indirect-api=false, port=Event_DTC_0xd00787:
        port-arg-values:
          integer literal Event_DTC_0xd00787: type=Dem_EventIdType, value=6
      port-api-option enable-take-address=true, indirect-api=false, port=Event_DTC_0xd01087:
        port-arg-values:
          integer literal Event_DTC_0xd01087: type=Dem_EventIdType, value=5
      port-api-option enable-take-address=true, indirect-api=false, port=Event_DTC_0xd01187:
        port-arg-values:
          integer literal Event_DTC_0xd01187: type=Dem_EventIdType, value=4
      port-api-option enable-take-address=true, indirect-api=false, port=Event_DTC_0xd01387:
        port-arg-values:
          integer literal Event_DTC_0xd01387: type=Dem_EventIdType, value=3
      port-api-option enable-take-address=true, indirect-api=false, port=Event_DTC_0xd93286:
        port-arg-values:
          integer literal Event_DTC_0xd93286: type=Dem_EventIdType, value=2
      port-api-option enable-take-address=true, indirect-api=false, port=Event_DTC_0xd95283:
        port-arg-values:
          integer literal Event_DTC_0xd95283: type=Dem_EventIdType, value=1
      port-api-option enable-take-address=true, indirect-api=false, port=EvtInfo_CAN_E_TIMEOUT:
        port-arg-values:
          integer literal EvtInfo_CAN_E_TIMEOUT: type=Dem_EventIdType, value=51
      port-api-option enable-take-address=true, indirect-api=false, port=EvtInfo_CANIF_E_FULL_TX_BUFFER:
        port-arg-values:
          integer literal EvtInfo_CANIF_E_FULL_TX_BUFFER: type=Dem_EventIdType, value=53
      port-api-option enable-take-address=true, indirect-api=false, port=EvtInfo_CANIF_E_INVALID_DLC:
        port-arg-values:
          integer literal EvtInfo_CANIF_E_INVALID_DLC: type=Dem_EventIdType, value=54
      port-api-option enable-take-address=true, indirect-api=false, port=EvtInfo_CANIF_E_SLEEP_REQ_FAILED:
        port-arg-values:
          integer literal EvtInfo_CANIF_E_SLEEP_REQ_FAILED: type=Dem_EventIdType, value=52
      port-api-option enable-take-address=true, indirect-api=false, port=EvtInfo_CANIF_E_STOPPED:
        port-arg-values:
          integer literal EvtInfo_CANIF_E_STOPPED: type=Dem_EventIdType, value=55
      port-api-option enable-take-address=true, indirect-api=false, port=EvtInfo_CANSM_E_BUSOFF_NETWORK_0:
        port-arg-values:
          integer literal EvtInfo_CANSM_E_BUSOFF_NETWORK_0: type=Dem_EventIdType, value=60
      port-api-option enable-take-address=true, indirect-api=false, port=EvtInfo_CANSM_E_MISSING_TRCV_INDICATION_0:
        port-arg-values:
          integer literal EvtInfo_CANSM_E_MISSING_TRCV_INDICATION_0: type=Dem_EventIdType, value=59
      port-api-option enable-take-address=true, indirect-api=false, port=EvtInfo_CANSM_E_MODE_CHANGE_NETWORK_0:
        port-arg-values:
          integer literal EvtInfo_CANSM_E_MODE_CHANGE_NETWORK_0: type=Dem_EventIdType, value=58
      port-api-option enable-take-address=true, indirect-api=false, port=EvtInfo_CANTP_E_COMM:
        port-arg-values:
          integer literal EvtInfo_CANTP_E_COMM: type=Dem_EventIdType, value=61
      port-api-option enable-take-address=true, indirect-api=false, port=EvtInfo_ECUM_E_ALL_RUN_REQUESTS_KILLED:
        port-arg-values:
          integer literal EvtInfo_ECUM_E_ALL_RUN_REQUESTS_KILLED: type=Dem_EventIdType, value=40
      port-api-option enable-take-address=true, indirect-api=false, port=EvtInfo_ECUM_E_RAM_CHECK_FAILED:
        port-arg-values:
          integer literal EvtInfo_ECUM_E_RAM_CHECK_FAILED: type=Dem_EventIdType, value=41
      port-api-option enable-take-address=true, indirect-api=false, port=EvtInfo_FLS_E_ERASE_FAILED:
        port-arg-values:
          integer literal EvtInfo_FLS_E_ERASE_FAILED: type=Dem_EventIdType, value=44
      port-api-option enable-take-address=true, indirect-api=false, port=EvtInfo_FLS_E_READ_FAILED:
        port-arg-values:
          integer literal EvtInfo_FLS_E_READ_FAILED: type=Dem_EventIdType, value=42
      port-api-option enable-take-address=true, indirect-api=false, port=EvtInfo_FLS_E_WRITE_FAILED:
        port-arg-values:
          integer literal EvtInfo_FLS_E_WRITE_FAILED: type=Dem_EventIdType, value=43
      port-api-option enable-take-address=true, indirect-api=false, port=EvtInfo_MCU_E_CLOCK_FAILURE:
        port-arg-values:
          integer literal EvtInfo_MCU_E_CLOCK_FAILURE: type=Dem_EventIdType, value=45
      port-api-option enable-take-address=true, indirect-api=false, port=EvtInfo_NVM_E_INTEGRITY_FAILED:
        port-arg-values:
          integer literal EvtInfo_NVM_E_INTEGRITY_FAILED: type=Dem_EventIdType, value=47
      port-api-option enable-take-address=true, indirect-api=false, port=EvtInfo_NVM_E_REQ_FAILED:
        port-arg-values:
          integer literal EvtInfo_NVM_E_REQ_FAILED: type=Dem_EventIdType, value=46
      port-api-option enable-take-address=true, indirect-api=false, port=EvtInfo_PDUR_E_INIT_FAILED:
        port-arg-values:
          integer literal EvtInfo_PDUR_E_INIT_FAILED: type=Dem_EventIdType, value=56
      port-api-option enable-take-address=true, indirect-api=false, port=EvtInfo_PDUR_E_PDU_INSTANCE_LOST:
        port-arg-values:
          integer literal EvtInfo_PDUR_E_PDU_INSTANCE_LOST: type=Dem_EventIdType, value=57
      port-api-option enable-take-address=true, indirect-api=false, port=EvtInfo_SPI_E_SEQ_FAILED:
        port-arg-values:
          integer literal EvtInfo_SPI_E_SEQ_FAILED: type=Dem_EventIdType, value=48
      port-api-option enable-take-address=true, indirect-api=false, port=EvtInfo_WDGM_E_ALIVE_SUPERVISION:
        port-arg-values:
          integer literal EvtInfo_WDGM_E_ALIVE_SUPERVISION: type=Dem_EventIdType, value=50
      port-api-option enable-take-address=true, indirect-api=false, port=EvtInfo_WDGM_E_SET_MODE:
        port-arg-values:
          integer literal EvtInfo_WDGM_E_SET_MODE: type=Dem_EventIdType, value=49
      port-api-option enable-take-address=true, indirect-api=false, port=OpCycle_DEM_IGNITION:
        port-arg-values:
          integer literal OpCycle_DEM_IGNITION: type=Dem_OperationCycleIdType, value=0
      port-api-option enable-take-address=true, indirect-api=false, port=OpCycle_DEM_OBD_DCY:
        port-arg-values:
          integer literal OpCycle_DEM_OBD_DCY: type=Dem_OperationCycleIdType, value=1
      port-api-option enable-take-address=true, indirect-api=false, port=OpCycle_DEM_POWER:
        port-arg-values:
          integer literal OpCycle_DEM_POWER: type=Dem_OperationCycleIdType, value=3
      port-api-option enable-take-address=true, indirect-api=false, port=OpCycle_DEM_WARMUP:
        port-arg-values:
          integer literal OpCycle_DEM_WARMUP: type=Dem_OperationCycleIdType, value=2
    12 x runnable:
      ClearPrestoredFreezeFrame: can-be-invoked-concurrently=true, symbol=Dem_ClearPrestoredFreezeFrame
      Dem_MainFunction
        9 x sync call, all with timeout=0:
          SC_CBExtDataRec_0x01_GetExtendedDataRecord: operation=CBExtDataRec_0x01.GetExtendedDataRecord
          SC_CBValByDID_0x0885_GetDataValueByDataIdentifier: operation=CBValByDID_0x0885.GetDataValueByDataIdentifier
          SC_CBValByDID_0x0ad8_GetDataValueByDataIdentifier: operation=CBValByDID_0x0ad8.GetDataValueByDataIdentifier
          SC_CBValByDID_0x1002_GetDataValueByDataIdentifier: operation=CBValByDID_0x1002.GetDataValueByDataIdentifier
          SC_CBValByDID_0x1004_GetDataValueByDataIdentifier: operation=CBValByDID_0x1004.GetDataValueByDataIdentifier
          SC_CBValByDID_0x1008_GetDataValueByDataIdentifier: operation=CBValByDID_0x1008.GetDataValueByDataIdentifier
          SC_CBValByDID_0x1009_GetDataValueByDataIdentifier: operation=CBValByDID_0x1009.GetDataValueByDataIdentifier
          SC_CBValByDID_0x2001_GetDataValueByDataIdentifier: operation=CBValByDID_0x2001.GetDataValueByDataIdentifier
          SC_CBValByDID_0x200a_GetDataValueByDataIdentifier: operation=CBValByDID_0x200a.GetDataValueByDataIdentifier
      GetDTCOfEvent: can-be-invoked-concurrently=true, symbol=Dem_GetDTCOfEvent
      GetEventFailed: can-be-invoked-concurrently=true, symbol=Dem_GetEventFailed
      GetEventStatus: can-be-invoked-concurrently=true, symbol=Dem_GetEventStatus
      GetEventTested: can-be-invoked-concurrently=true, symbol=Dem_GetEventTested
      GetFaultDetectionCounter: can-be-invoked-concurrently=true, symbol=Dem_GetFaultDetectionCounter
      PostRunRequested: can-be-invoked-concurrently=true, symbol=Dem_PostRunRequested
      PrestoreFreezeFrame: can-be-invoked-concurrently=true, symbol=Dem_PrestoreFreezeFrame
      ResetEventStatus: can-be-invoked-concurrently=true, symbol=Dem_ResetEventStatus
      SetEventStatus: can-be-invoked-concurrently=true, symbol=Dem_SetEventStatus
      SetOperationCycleState: can-be-invoked-concurrently=true, symbol=Dem_SetOperationCycleState
  service component type Dem: category=ServiceComponent
    66 x provide port:
      Event_DTC_0x500386: provided-interface=DiagnosticMonitor
        provided-com-specs:
          operation=ClearPrestoredFreezeFrame, queue-length=1
          operation=GetDTCOfEvent, queue-length=1
          operation=GetEventFailed, queue-length=1
          operation=GetEventStatus, queue-length=1
          operation=GetEventTested, queue-length=1
          operation=GetFaultDetectionCounter, queue-length=1
          operation=PrestoreFreezeFrame, queue-length=1
          operation=ResetEventStatus, queue-length=1
          operation=SetEventStatus, queue-length=1
      Event_DTC_0x500568: provided-interface=DiagnosticMonitor
        provided-com-specs:
          operation=ClearPrestoredFreezeFrame, queue-length=1
          operation=GetDTCOfEvent, queue-length=1
          operation=GetEventFailed, queue-length=1
          operation=GetEventStatus, queue-length=1
          operation=GetEventTested, queue-length=1
          operation=GetFaultDetectionCounter, queue-length=1
          operation=PrestoreFreezeFrame, queue-length=1
          operation=ResetEventStatus, queue-length=1
          operation=SetEventStatus, queue-length=1
      Event_DTC_0x500909: provided-interface=DiagnosticMonitor
        provided-com-specs:
          operation=ClearPrestoredFreezeFrame, queue-length=1
          operation=GetDTCOfEvent, queue-length=1
          operation=GetEventFailed, queue-length=1
          operation=GetEventStatus, queue-length=1
          operation=GetEventTested, queue-length=1
          operation=GetFaultDetectionCounter, queue-length=1
          operation=PrestoreFreezeFrame, queue-length=1
          operation=ResetEventStatus, queue-length=1
          operation=SetEventStatus, queue-length=1
      Event_DTC_0x52192f: provided-interface=DiagnosticMonitor
        provided-com-specs:
          operation=ClearPrestoredFreezeFrame, queue-length=1
          operation=GetDTCOfEvent, queue-length=1
          operation=GetEventFailed, queue-length=1
          operation=GetEventStatus, queue-length=1
          operation=GetEventTested, queue-length=1
          operation=GetFaultDetectionCounter, queue-length=1
          operation=PrestoreFreezeFrame, queue-length=1
          operation=ResetEventStatus, queue-length=1
          operation=SetEventStatus, queue-length=1
      Event_DTC_0x521a54: provided-interface=DiagnosticMonitor
        provided-com-specs:
          operation=ClearPrestoredFreezeFrame, queue-length=1
          operation=GetDTCOfEvent, queue-length=1
          operation=GetEventFailed, queue-length=1
          operation=GetEventStatus, queue-length=1
          operation=GetEventTested, queue-length=1
          operation=GetFaultDetectionCounter, queue-length=1
          operation=PrestoreFreezeFrame, queue-length=1
          operation=ResetEventStatus, queue-length=1
          operation=SetEventStatus, queue-length=1
      Event_DTC_0x559201: provided-interface=DiagnosticMonitor
        provided-com-specs:
          operation=ClearPrestoredFreezeFrame, queue-length=1
          operation=GetDTCOfEvent, queue-length=1
          operation=GetEventFailed, queue-length=1
          operation=GetEventStatus, queue-length=1
          operation=GetEventTested, queue-length=1
          operation=GetFaultDetectionCounter, queue-length=1
          operation=PrestoreFreezeFrame, queue-length=1
          operation=ResetEventStatus, queue-length=1
          operation=SetEventStatus, queue-length=1
      Event_DTC_0x559211: provided-interface=DiagnosticMonitor
        provided-com-specs:
          operation=ClearPrestoredFreezeFrame, queue-length=1
          operation=GetDTCOfEvent, queue-length=1
          operation=GetEventFailed, queue-length=1
          operation=GetEventStatus, queue-length=1
          operation=GetEventTested, queue-length=1
          operation=GetFaultDetectionCounter, queue-length=1
          operation=PrestoreFreezeFrame, queue-length=1
          operation=ResetEventStatus, queue-length=1
          operation=SetEventStatus, queue-length=1
      Event_DTC_0x559212: provided-interface=DiagnosticMonitor
        provided-com-specs:
          operation=ClearPrestoredFreezeFrame, queue-length=1
          operation=GetDTCOfEvent, queue-length=1
          operation=GetEventFailed, queue-length=1
          operation=GetEventStatus, queue-length=1
          operation=GetEventTested, queue-length=1
          operation=GetFaultDetectionCounter, queue-length=1
          operation=PrestoreFreezeFrame, queue-length=1
          operation=ResetEventStatus, queue-length=1
          operation=SetEventStatus, queue-length=1
      Event_DTC_0x559213: provided-interface=DiagnosticMonitor
        provided-com-specs:
          operation=ClearPrestoredFreezeFrame, queue-length=1
          operation=GetDTCOfEvent, queue-length=1
          operation=GetEventFailed, queue-length=1
          operation=GetEventStatus, queue-length=1
          operation=GetEventTested, queue-length=1
          operation=GetFaultDetectionCounter, queue-length=1
          operation=PrestoreFreezeFrame, queue-length=1
          operation=ResetEventStatus, queue-length=1
          operation=SetEventStatus, queue-length=1
      Event_DTC_0x559219: provided-interface=DiagnosticMonitor
        provided-com-specs:
          operation=ClearPrestoredFreezeFrame, queue-length=1
          operation=GetDTCOfEvent, queue-length=1
          operation=GetEventFailed, queue-length=1
          operation=GetEventStatus, queue-length=1
          operation=GetEventTested, queue-length=1
          operation=GetFaultDetectionCounter, queue-length=1
          operation=PrestoreFreezeFrame, queue-length=1
          operation=ResetEventStatus, queue-length=1
          operation=SetEventStatus, queue-length=1
      Event_DTC_0x559311: provided-interface=DiagnosticMonitor
        provided-com-specs:
          operation=ClearPrestoredFreezeFrame, queue-length=1
          operation=GetDTCOfEvent, queue-length=1
          operation=GetEventFailed, queue-length=1
          operation=GetEventStatus, queue-length=1
          operation=GetEventTested, queue-length=1
          operation=GetFaultDetectionCounter, queue-length=1
          operation=PrestoreFreezeFrame, queue-length=1
          operation=ResetEventStatus, queue-length=1
          operation=SetEventStatus, queue-length=1
      Event_DTC_0x559312: provided-interface=DiagnosticMonitor
        provided-com-specs:
          operation=ClearPrestoredFreezeFrame, queue-length=1
          operation=GetDTCOfEvent, queue-length=1
          operation=GetEventFailed, queue-length=1
          operation=GetEventStatus, queue-length=1
          operation=GetEventTested, queue-length=1
          operation=GetFaultDetectionCounter, queue-length=1
          operation=PrestoreFreezeFrame, queue-length=1
          operation=ResetEventStatus, queue-length=1
          operation=SetEventStatus, queue-length=1
      Event_DTC_0x559313: provided-interface=DiagnosticMonitor
        provided-com-specs:
          operation=ClearPrestoredFreezeFrame, queue-length=1
          operation=GetDTCOfEvent, queue-length=1
          operation=GetEventFailed, queue-length=1
          operation=GetEventStatus, queue-length=1
          operation=GetEventTested, queue-length=1
          operation=GetFaultDetectionCounter, queue-length=1
          operation=PrestoreFreezeFrame, queue-length=1
          operation=ResetEventStatus, queue-length=1
          operation=SetEventStatus, queue-length=1
      Event_DTC_0x559349: provided-interface=DiagnosticMonitor
        provided-com-specs:
          operation=ClearPrestoredFreezeFrame, queue-length=1
          operation=GetDTCOfEvent, queue-length=1
          operation=GetEventFailed, queue-length=1
          operation=GetEventStatus, queue-length=1
          operation=GetEventTested, queue-length=1
          operation=GetFaultDetectionCounter, queue-length=1
          operation=PrestoreFreezeFrame, queue-length=1
          operation=ResetEventStatus, queue-length=1
          operation=SetEventStatus, queue-length=1
      Event_DTC_0x620525: provided-interface=DiagnosticMonitor
        provided-com-specs:
          operation=ClearPrestoredFreezeFrame, queue-length=1
          operation=GetDTCOfEvent, queue-length=1
          operation=GetEventFailed, queue-length=1
          operation=GetEventStatus, queue-length=1
          operation=GetEventTested, queue-length=1
          operation=GetFaultDetectionCounter, queue-length=1
          operation=PrestoreFreezeFrame, queue-length=1
          operation=ResetEventStatus, queue-length=1
          operation=SetEventStatus, queue-length=1
      Event_DTC_0x621068: provided-interface=DiagnosticMonitor
        provided-com-specs:
          operation=ClearPrestoredFreezeFrame, queue-length=1
          operation=GetDTCOfEvent, queue-length=1
          operation=GetEventFailed, queue-length=1
          operation=GetEventStatus, queue-length=1
          operation=GetEventTested, queue-length=1
          operation=GetFaultDetectionCounter, queue-length=1
          operation=PrestoreFreezeFrame, queue-length=1
          operation=ResetEventStatus, queue-length=1
          operation=SetEventStatus, queue-length=1
      Event_DTC_0x621098: provided-interface=DiagnosticMonitor
        provided-com-specs:
          operation=ClearPrestoredFreezeFrame, queue-length=1
          operation=GetDTCOfEvent, queue-length=1
          operation=GetEventFailed, queue-length=1
          operation=GetEventStatus, queue-length=1
          operation=GetEventTested, queue-length=1
          operation=GetFaultDetectionCounter, queue-length=1
          operation=PrestoreFreezeFrame, queue-length=1
          operation=ResetEventStatus, queue-length=1
          operation=SetEventStatus, queue-length=1
      Event_DTC_0x621748: provided-interface=DiagnosticMonitor
        provided-com-specs:
          operation=ClearPrestoredFreezeFrame, queue-length=1
          operation=GetDTCOfEvent, queue-length=1
          operation=GetEventFailed, queue-length=1
          operation=GetEventStatus, queue-length=1
          operation=GetEventTested, queue-length=1
          operation=GetFaultDetectionCounter, queue-length=1
          operation=PrestoreFreezeFrame, queue-length=1
          operation=ResetEventStatus, queue-length=1
          operation=SetEventStatus, queue-length=1
      Event_DTC_0x621749: provided-interface=DiagnosticMonitor
        provided-com-specs:
          operation=ClearPrestoredFreezeFrame, queue-length=1
          operation=GetDTCOfEvent, queue-length=1
          operation=GetEventFailed, queue-length=1
          operation=GetEventStatus, queue-length=1
          operation=GetEventTested, queue-length=1
          operation=GetFaultDetectionCounter, queue-length=1
          operation=PrestoreFreezeFrame, queue-length=1
          operation=ResetEventStatus, queue-length=1
          operation=SetEventStatus, queue-length=1
      Event_DTC_0xa19916: provided-interface=DiagnosticMonitor
        provided-com-specs:
          operation=ClearPrestoredFreezeFrame, queue-length=1
          operation=GetDTCOfEvent, queue-length=1
          operation=GetEventFailed, queue-length=1
          operation=GetEventStatus, queue-length=1
          operation=GetEventTested, queue-length=1
          operation=GetFaultDetectionCounter, queue-length=1
          operation=PrestoreFreezeFrame, queue-length=1
          operation=ResetEventStatus, queue-length=1
          operation=SetEventStatus, queue-length=1
      Event_DTC_0xa19917: provided-interface=DiagnosticMonitor
        provided-com-specs:
          operation=ClearPrestoredFreezeFrame, queue-length=1
          operation=GetDTCOfEvent, queue-length=1
          operation=GetEventFailed, queue-length=1
          operation=GetEventStatus, queue-length=1
          operation=GetEventTested, queue-length=1
          operation=GetFaultDetectionCounter, queue-length=1
          operation=PrestoreFreezeFrame, queue-length=1
          operation=ResetEventStatus, queue-length=1
          operation=SetEventStatus, queue-length=1
      Event_DTC_0xa1991c: provided-interface=DiagnosticMonitor
        provided-com-specs:
          operation=ClearPrestoredFreezeFrame, queue-length=1
          operation=GetDTCOfEvent, queue-length=1
          operation=GetEventFailed, queue-length=1
          operation=GetEventStatus, queue-length=1
          operation=GetEventTested, queue-length=1
          operation=GetFaultDetectionCounter, queue-length=1
          operation=PrestoreFreezeFrame, queue-length=1
          operation=ResetEventStatus, queue-length=1
          operation=SetEventStatus, queue-length=1
      Event_DTC_0xa22c51: provided-interface=DiagnosticMonitor
        provided-com-specs:
          operation=ClearPrestoredFreezeFrame, queue-length=1
          operation=GetDTCOfEvent, queue-length=1
          operation=GetEventFailed, queue-length=1
          operation=GetEventStatus, queue-length=1
          operation=GetEventTested, queue-length=1
          operation=GetFaultDetectionCounter, queue-length=1
          operation=PrestoreFreezeFrame, queue-length=1
          operation=ResetEventStatus, queue-length=1
          operation=SetEventStatus, queue-length=1
      Event_DTC_0xa23b05: provided-interface=DiagnosticMonitor
        provided-com-specs:
          operation=ClearPrestoredFreezeFrame, queue-length=1
          operation=GetDTCOfEvent, queue-length=1
          operation=GetEventFailed, queue-length=1
          operation=GetEventStatus, queue-length=1
          operation=GetEventTested, queue-length=1
          operation=GetFaultDetectionCounter, queue-length=1
          operation=PrestoreFreezeFrame, queue-length=1
          operation=ResetEventStatus, queue-length=1
          operation=SetEventStatus, queue-length=1
      Event_DTC_0xc00187: provided-interface=DiagnosticMonitor
        provided-com-specs:
          operation=ClearPrestoredFreezeFrame, queue-length=1
          operation=GetDTCOfEvent, queue-length=1
          operation=GetEventFailed, queue-length=1
          operation=GetEventStatus, queue-length=1
          operation=GetEventTested, queue-length=1
          operation=GetFaultDetectionCounter, queue-length=1
          operation=PrestoreFreezeFrame, queue-length=1
          operation=ResetEventStatus, queue-length=1
          operation=SetEventStatus, queue-length=1
      Event_DTC_0xc00188: provided-interface=DiagnosticMonitor
        provided-com-specs:
          operation=ClearPrestoredFreezeFrame, queue-length=1
          operation=GetDTCOfEvent, queue-length=1
          operation=GetEventFailed, queue-length=1
          operation=GetEventStatus, queue-length=1
          operation=GetEventTested, queue-length=1
          operation=GetFaultDetectionCounter, queue-length=1
          operation=PrestoreFreezeFrame, queue-length=1
          operation=ResetEventStatus, queue-length=1
          operation=SetEventStatus, queue-length=1
      Event_DTC_0xc10087: provided-interface=DiagnosticMonitor
        provided-com-specs:
          operation=ClearPrestoredFreezeFrame, queue-length=1
          operation=GetDTCOfEvent, queue-length=1
          operation=GetEventFailed, queue-length=1
          operation=GetEventStatus, queue-length=1
          operation=GetEventTested, queue-length=1
          operation=GetFaultDetectionCounter, queue-length=1
          operation=PrestoreFreezeFrame, queue-length=1
          operation=ResetEventStatus, queue-length=1
          operation=SetEventStatus, queue-length=1
      Event_DTC_0xc4012f: provided-interface=DiagnosticMonitor
        provided-com-specs:
          operation=ClearPrestoredFreezeFrame, queue-length=1
          operation=GetDTCOfEvent, queue-length=1
          operation=GetEventFailed, queue-length=1
          operation=GetEventStatus, queue-length=1
          operation=GetEventTested, queue-length=1
          operation=GetFaultDetectionCounter, queue-length=1
          operation=PrestoreFreezeFrame, queue-length=1
          operation=ResetEventStatus, queue-length=1
          operation=SetEventStatus, queue-length=1
      Event_DTC_0xc4152f: provided-interface=DiagnosticMonitor
        provided-com-specs:
          operation=ClearPrestoredFreezeFrame, queue-length=1
          operation=GetDTCOfEvent, queue-length=1
          operation=GetEventFailed, queue-length=1
          operation=GetEventStatus, queue-length=1
          operation=GetEventTested, queue-length=1
          operation=GetFaultDetectionCounter, queue-length=1
          operation=PrestoreFreezeFrame, queue-length=1
          operation=ResetEventStatus, queue-length=1
          operation=SetEventStatus, queue-length=1
      Event_DTC_0xc4222f: provided-interface=DiagnosticMonitor
        provided-com-specs:
          operation=ClearPrestoredFreezeFrame, queue-length=1
          operation=GetDTCOfEvent, queue-length=1
          operation=GetEventFailed, queue-length=1
          operation=GetEventStatus, queue-length=1
          operation=GetEventTested, queue-length=1
          operation=GetFaultDetectionCounter, queue-length=1
          operation=PrestoreFreezeFrame, queue-length=1
          operation=ResetEventStatus, queue-length=1
          operation=SetEventStatus, queue-length=1
      Event_DTC_0xc4232f: provided-interface=DiagnosticMonitor
        provided-com-specs:
          operation=ClearPrestoredFreezeFrame, queue-length=1
          operation=GetDTCOfEvent, queue-length=1
          operation=GetEventFailed, queue-length=1
          operation=GetEventStatus, queue-length=1
          operation=GetEventTested, queue-length=1
          operation=GetFaultDetectionCounter, queue-length=1
          operation=PrestoreFreezeFrame, queue-length=1
          operation=ResetEventStatus, queue-length=1
          operation=SetEventStatus, queue-length=1
      Event_DTC_0xd00587: provided-interface=DiagnosticMonitor
        provided-com-specs:
          operation=ClearPrestoredFreezeFrame, queue-length=1
          operation=GetDTCOfEvent, queue-length=1
          operation=GetEventFailed, queue-length=1
          operation=GetEventStatus, queue-length=1
          operation=GetEventTested, queue-length=1
          operation=GetFaultDetectionCounter, queue-length=1
          operation=PrestoreFreezeFrame, queue-length=1
          operation=ResetEventStatus, queue-length=1
          operation=SetEventStatus, queue-length=1
      Event_DTC_0xd00687: provided-interface=DiagnosticMonitor
        provided-com-specs:
          operation=ClearPrestoredFreezeFrame, queue-length=1
          operation=GetDTCOfEvent, queue-length=1
          operation=GetEventFailed, queue-length=1
          operation=GetEventStatus, queue-length=1
          operation=GetEventTested, queue-length=1
          operation=GetFaultDetectionCounter, queue-length=1
          operation=PrestoreFreezeFrame, queue-length=1
          operation=ResetEventStatus, queue-length=1
          operation=SetEventStatus, queue-length=1
      Event_DTC_0xd00787: provided-interface=DiagnosticMonitor
        provided-com-specs:
          operation=ClearPrestoredFreezeFrame, queue-length=1
          operation=GetDTCOfEvent, queue-length=1
          operation=GetEventFailed, queue-length=1
          operation=GetEventStatus, queue-length=1
          operation=GetEventTested, queue-length=1
          operation=GetFaultDetectionCounter, queue-length=1
          operation=PrestoreFreezeFrame, queue-length=1
          operation=ResetEventStatus, queue-length=1
          operation=SetEventStatus, queue-length=1
      Event_DTC_0xd01087: provided-interface=DiagnosticMonitor
        provided-com-specs:
          operation=ClearPrestoredFreezeFrame, queue-length=1
          operation=GetDTCOfEvent, queue-length=1
          operation=GetEventFailed, queue-length=1
          operation=GetEventStatus, queue-length=1
          operation=GetEventTested, queue-length=1
          operation=GetFaultDetectionCounter, queue-length=1
          operation=PrestoreFreezeFrame, queue-length=1
          operation=ResetEventStatus, queue-length=1
          operation=SetEventStatus, queue-length=1
      Event_DTC_0xd01187: provided-interface=DiagnosticMonitor
        provided-com-specs:
          operation=ClearPrestoredFreezeFrame, queue-length=1
          operation=GetDTCOfEvent, queue-length=1
          operation=GetEventFailed, queue-length=1
          operation=GetEventStatus, queue-length=1
          operation=GetEventTested, queue-length=1
          operation=GetFaultDetectionCounter, queue-length=1
          operation=PrestoreFreezeFrame, queue-length=1
          operation=ResetEventStatus, queue-length=1
          operation=SetEventStatus, queue-length=1
      Event_DTC_0xd01387: provided-interface=DiagnosticMonitor
        provided-com-specs:
          operation=ClearPrestoredFreezeFrame, queue-length=1
          operation=GetDTCOfEvent, queue-length=1
          operation=GetEventFailed, queue-length=1
          operation=GetEventStatus, queue-length=1
          operation=GetEventTested, queue-length=1
          operation=GetFaultDetectionCounter, queue-length=1
          operation=PrestoreFreezeFrame, queue-length=1
          operation=ResetEventStatus, queue-length=1
          operation=SetEventStatus, queue-length=1
      Event_DTC_0xd93286: provided-interface=DiagnosticMonitor
        provided-com-specs:
          operation=ClearPrestoredFreezeFrame, queue-length=1
          operation=GetDTCOfEvent, queue-length=1
          operation=GetEventFailed, queue-length=1
          operation=GetEventStatus, queue-length=1
          operation=GetEventTested, queue-length=1
          operation=GetFaultDetectionCounter, queue-length=1
          operation=PrestoreFreezeFrame, queue-length=1
          operation=ResetEventStatus, queue-length=1
          operation=SetEventStatus, queue-length=1
      Event_DTC_0xd95283: provided-interface=DiagnosticMonitor
        provided-com-specs:
          operation=ClearPrestoredFreezeFrame, queue-length=1
          operation=GetDTCOfEvent, queue-length=1
          operation=GetEventFailed, queue-length=1
          operation=GetEventStatus, queue-length=1
          operation=GetEventTested, queue-length=1
          operation=GetFaultDetectionCounter, queue-length=1
          operation=PrestoreFreezeFrame, queue-length=1
          operation=ResetEventStatus, queue-length=1
          operation=SetEventStatus, queue-length=1
      EvtInfo_CAN_E_TIMEOUT: provided-interface=DiagnosticInfo
        provided-com-specs:
          operation=GetDTCOfEvent, queue-length=1
          operation=GetEventFailed, queue-length=1
          operation=GetEventStatus, queue-length=1
          operation=GetEventTested, queue-length=1
          operation=GetFaultDetectionCounter, queue-length=1
      EvtInfo_CANIF_E_FULL_TX_BUFFER: provided-interface=DiagnosticInfo
        provided-com-specs:
          operation=GetDTCOfEvent, queue-length=1
          operation=GetEventFailed, queue-length=1
          operation=GetEventStatus, queue-length=1
          operation=GetEventTested, queue-length=1
          operation=GetFaultDetectionCounter, queue-length=1
      EvtInfo_CANIF_E_INVALID_DLC: provided-interface=DiagnosticInfo
        provided-com-specs:
          operation=GetDTCOfEvent, queue-length=1
          operation=GetEventFailed, queue-length=1
          operation=GetEventStatus, queue-length=1
          operation=GetEventTested, queue-length=1
          operation=GetFaultDetectionCounter, queue-length=1
      EvtInfo_CANIF_E_SLEEP_REQ_FAILED: provided-interface=DiagnosticInfo
        provided-com-specs:
          operation=GetDTCOfEvent, queue-length=1
          operation=GetEventFailed, queue-length=1
          operation=GetEventStatus, queue-length=1
          operation=GetEventTested, queue-length=1
          operation=GetFaultDetectionCounter, queue-length=1
      EvtInfo_CANIF_E_STOPPED: provided-interface=DiagnosticInfo
        provided-com-specs:
          operation=GetDTCOfEvent, queue-length=1
          operation=GetEventFailed, queue-length=1
          operation=GetEventStatus, queue-length=1
          operation=GetEventTested, queue-length=1
          operation=GetFaultDetectionCounter, queue-length=1
      EvtInfo_CANSM_E_BUSOFF_NETWORK_0: provided-interface=DiagnosticInfo
        provided-com-specs:
          operation=GetDTCOfEvent, queue-length=1
          operation=GetEventFailed, queue-length=1
          operation=GetEventStatus, queue-length=1
          operation=GetEventTested, queue-length=1
          operation=GetFaultDetectionCounter, queue-length=1
      EvtInfo_CANSM_E_MISSING_TRCV_INDICATION_0: provided-interface=DiagnosticInfo
        provided-com-specs:
          operation=GetDTCOfEvent, queue-length=1
          operation=GetEventFailed, queue-length=1
          operation=GetEventStatus, queue-length=1
          operation=GetEventTested, queue-length=1
          operation=GetFaultDetectionCounter, queue-length=1
      EvtInfo_CANSM_E_MODE_CHANGE_NETWORK_0: provided-interface=DiagnosticInfo
        provided-com-specs:
          operation=GetDTCOfEvent, queue-length=1
          operation=GetEventFailed, queue-length=1
          operation=GetEventStatus, queue-length=1
          operation=GetEventTested, queue-length=1
          operation=GetFaultDetectionCounter, queue-length=1
      EvtInfo_CANTP_E_COMM: provided-interface=DiagnosticInfo
        provided-com-specs:
          operation=GetDTCOfEvent, queue-length=1
          operation=GetEventFailed, queue-length=1
          operation=GetEventStatus, queue-length=1
          operation=GetEventTested, queue-length=1
          operation=GetFaultDetectionCounter, queue-length=1
      EvtInfo_ECUM_E_ALL_RUN_REQUESTS_KILLED: provided-interface=DiagnosticInfo
        provided-com-specs:
          operation=GetDTCOfEvent, queue-length=1
          operation=GetEventFailed, queue-length=1
          operation=GetEventStatus, queue-length=1
          operation=GetEventTested, queue-length=1
          operation=GetFaultDetectionCounter, queue-length=1
      EvtInfo_ECUM_E_RAM_CHECK_FAILED: provided-interface=DiagnosticInfo
        provided-com-specs:
          operation=GetDTCOfEvent, queue-length=1
          operation=GetEventFailed, queue-length=1
          operation=GetEventStatus, queue-length=1
          operation=GetEventTested, queue-length=1
          operation=GetFaultDetectionCounter, queue-length=1
      EvtInfo_FLS_E_ERASE_FAILED: provided-interface=DiagnosticInfo
        provided-com-specs:
          operation=GetDTCOfEvent, queue-length=1
          operation=GetEventFailed, queue-length=1
          operation=GetEventStatus, queue-length=1
          operation=GetEventTested, queue-length=1
          operation=GetFaultDetectionCounter, queue-length=1
      EvtInfo_FLS_E_READ_FAILED: provided-interface=DiagnosticInfo
        provided-com-specs:
          operation=GetDTCOfEvent, queue-length=1
          operation=GetEventFailed, queue-length=1
          operation=GetEventStatus, queue-length=1
          operation=GetEventTested, queue-length=1
          operation=GetFaultDetectionCounter, queue-length=1
      EvtInfo_FLS_E_WRITE_FAILED: provided-interface=DiagnosticInfo
        provided-com-specs:
          operation=GetDTCOfEvent, queue-length=1
          operation=GetEventFailed, queue-length=1
          operation=GetEventStatus, queue-length=1
          operation=GetEventTested, queue-length=1
          operation=GetFaultDetectionCounter, queue-length=1
      EvtInfo_MCU_E_CLOCK_FAILURE: provided-interface=DiagnosticInfo
        provided-com-specs:
          operation=GetDTCOfEvent, queue-length=1
          operation=GetEventFailed, queue-length=1
          operation=GetEventStatus, queue-length=1
          operation=GetEventTested, queue-length=1
          operation=GetFaultDetectionCounter, queue-length=1
      EvtInfo_NVM_E_INTEGRITY_FAILED: provided-interface=DiagnosticInfo
        provided-com-specs:
          operation=GetDTCOfEvent, queue-length=1
          operation=GetEventFailed, queue-length=1
          operation=GetEventStatus, queue-length=1
          operation=GetEventTested, queue-length=1
          operation=GetFaultDetectionCounter, queue-length=1
      EvtInfo_NVM_E_REQ_FAILED: provided-interface=DiagnosticInfo
        provided-com-specs:
          operation=GetDTCOfEvent, queue-length=1
          operation=GetEventFailed, queue-length=1
          operation=GetEventStatus, queue-length=1
          operation=GetEventTested, queue-length=1
          operation=GetFaultDetectionCounter, queue-length=1
      EvtInfo_PDUR_E_INIT_FAILED: provided-interface=DiagnosticInfo
        provided-com-specs:
          operation=GetDTCOfEvent, queue-length=1
          operation=GetEventFailed, queue-length=1
          operation=GetEventStatus, queue-length=1
          operation=GetEventTested, queue-length=1
          operation=GetFaultDetectionCounter, queue-length=1
      EvtInfo_PDUR_E_PDU_INSTANCE_LOST: provided-interface=DiagnosticInfo
        provided-com-specs:
          operation=GetDTCOfEvent, queue-length=1
          operation=GetEventFailed, queue-length=1
          operation=GetEventStatus, queue-length=1
          operation=GetEventTested, queue-length=1
          operation=GetFaultDetectionCounter, queue-length=1
      EvtInfo_SPI_E_SEQ_FAILED: provided-interface=DiagnosticInfo
        provided-com-specs:
          operation=GetDTCOfEvent, queue-length=1
          operation=GetEventFailed, queue-length=1
          operation=GetEventStatus, queue-length=1
          operation=GetEventTested, queue-length=1
          operation=GetFaultDetectionCounter, queue-length=1
      EvtInfo_WDGM_E_ALIVE_SUPERVISION: provided-interface=DiagnosticInfo
        provided-com-specs:
          operation=GetDTCOfEvent, queue-length=1
          operation=GetEventFailed, queue-length=1
          operation=GetEventStatus, queue-length=1
          operation=GetEventTested, queue-length=1
          operation=GetFaultDetectionCounter, queue-length=1
      EvtInfo_WDGM_E_SET_MODE: provided-interface=DiagnosticInfo
        provided-com-specs:
          operation=GetDTCOfEvent, queue-length=1
          operation=GetEventFailed, queue-length=1
          operation=GetEventStatus, queue-length=1
          operation=GetEventTested, queue-length=1
          operation=GetFaultDetectionCounter, queue-length=1
      OpCycle_DEM_IGNITION: server-com-spec{operation=SetOperationCycleState, queue-length=1}, provided-interface=OperationCycle
      OpCycle_DEM_OBD_DCY: server-com-spec{operation=SetOperationCycleState, queue-length=1}, provided-interface=OperationCycle
      OpCycle_DEM_POWER: server-com-spec{operation=SetOperationCycleState, queue-length=1}, provided-interface=OperationCycle
      OpCycle_DEM_WARMUP: server-com-spec{operation=SetOperationCycleState, queue-length=1}, provided-interface=OperationCycle
      PostRunRequest: server-com-spec{operation=PostRunRequested, queue-length=1}, provided-interface=PostRunRequest
    9 x require port:
      CBExtDataRec_0x01: client-com-spec=GetExtendedDataRecord, required-interface=CallbackGetExtendedDataRecord
      CBValByDID_0x0885: client-com-spec=GetDataValueByDataIdentifier, required-interface=CallbackGetDataValueByDataId
      CBValByDID_0x0ad8: client-com-spec=GetDataValueByDataIdentifier, required-interface=CallbackGetDataValueByDataId
      CBValByDID_0x1002: client-com-spec=GetDataValueByDataIdentifier, required-interface=CallbackGetDataValueByDataId
      CBValByDID_0x1004: client-com-spec=GetDataValueByDataIdentifier, required-interface=CallbackGetDataValueByDataId
      CBValByDID_0x1008: client-com-spec=GetDataValueByDataIdentifier, required-interface=CallbackGetDataValueByDataId
      CBValByDID_0x1009: client-com-spec=GetDataValueByDataIdentifier, required-interface=CallbackGetDataValueByDataId
      CBValByDID_0x2001: client-com-spec=GetDataValueByDataIdentifier, required-interface=CallbackGetDataValueByDataId
      CBValByDID_0x200a: client-com-spec=GetDataValueByDataIdentifier, required-interface=CallbackGetDataValueByDataId
  swc implementation Dem_Implementation: behavior=Dem_InternalBehavior
    code-descriptors:
      code Code: type=SRC
