AUTOSAR XML (schema 314)
package /ComponentType
  internal behavior EcuM_InternalBehavior: component=EcuM
    timing event TMT_EcuM_MainFunction: start-on-event=EcuM_MainFunction, period=0.01
    runnable EcuM_MainFunction
  service component type EcuM: category=ServiceComponent
  swc implementation EcuM_Implementation: behavior=EcuM_InternalBehavior
    code-descriptors:
      code Code: type=SRC
