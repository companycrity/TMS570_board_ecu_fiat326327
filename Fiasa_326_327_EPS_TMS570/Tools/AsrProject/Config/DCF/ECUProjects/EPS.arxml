AUTOSAR XML (schema 314)
package /DaVinci
  ecu configuration EPS: ecu-extract=EPS, ecu-sw-composition=EcuSwComposition
package /DaVinci/PKG_ECU
  ecu instance EPS: com-processing-period=0.001, diagnostic-address=0, sleep-mode-supported=false, wake-up-over-bus-supported=false
package /ECUComposition
  ecu sw composition EcuSwComposition: ecu-extract=EPS
    7 x service component prototype:
      CDD: service-component=CDD
      ComM: service-component=ComM
      Dcm: service-component=Dcm
      NexteerLibs: service-component=NexteerLibs
      NvM: service-component=NvM
      NvMProxy: service-component=NvMProxy
      WdgM: service-component=WdgM
    service connector prototype NvMProxy_PS_NvMP_NvmBlock_EOLVehCntrOffset_AbsHwPos_EOLVehCntrOffset: application-port=ECU_Composition.AbsHwPos.EOLVehCntrOffset, service-port=NvMProxy.PS_NvMP_NvmBlock_EOLVehCntrOffset
    service connector prototype NexteerLibs_SystemTime_ActivePull_SystemTime: application-port=ECU_Composition.ActivePull.SystemTime, service-port=NexteerLibs.SystemTime
    service connector prototype NvMProxy_PS_NvMP_NvmBlock_SteerAsstDefeat_AstLmt_SteeringAsstDefeat: application-port=ECU_Composition.AstLmt.SteeringAsstDefeat, service-port=NvMProxy.PS_NvMP_NvmBlock_SteerAsstDefeat
    service connector prototype NvM_PS_Rte_NvmBlock_AvgFricLrn_AvgFricLrnData_AvgFricLrn_AvgFricLrnData: application-port=ECU_Composition.AvgFricLrn.AvgFricLrnData, service-port=NvM.PS_Rte_NvmBlock_AvgFricLrn_AvgFricLrnData
    service connector prototype NexteerLibs_SystemTime_AvgFricLrn_SystemTime: application-port=ECU_Composition.AvgFricLrn.SystemTime, service-port=NexteerLibs.SystemTime
    service connector prototype NvMProxy_PS_NvMP_NvmBlock_BatteryOvervoltageData_BatteryVoltage_OvervoltageData: application-port=ECU_Composition.BatteryVoltage.OvervoltageData, service-port=NvMProxy.PS_NvMP_NvmBlock_BatteryOvervoltageData
    service connector prototype NexteerLibs_SystemTime_BatteryVoltage_SystemTime: application-port=ECU_Composition.BatteryVoltage.SystemTime, service-port=NexteerLibs.SystemTime
    service connector prototype NexteerLibs_SystemTime_BkCpPc_SystemTime: application-port=ECU_Composition.BkCpPc.SystemTime, service-port=NexteerLibs.SystemTime
    service connector prototype NexteerLibs_SystemTime_BVDiag_SystemTime: application-port=ECU_Composition.BVDiag.SystemTime, service-port=NexteerLibs.SystemTime
    service connector prototype CDD_CDDPorts_CDDInterface_CDDPorts: application-port=ECU_Composition.CDDInterface.CDDPorts, service-port=CDD.CDDPorts
    service connector prototype WdgM_SE000_SE_100ms_10_CP001_ChkPtAp10_100msEnd_CP_ChkPtAp10_ChkPtAp10_100msEnd_CP: application-port=ECU_Composition.ChkPtAp10.ChkPtAp10_100msEnd_CP, service-port=WdgM.SE000_SE_100ms_10_CP001_ChkPtAp10_100msEnd_CP
    service connector prototype WdgM_SE000_SE_100ms_10_CP000_ChkPtAp10_100msStart_CP_ChkPtAp10_ChkPtAp10_100msStart_CP: application-port=ECU_Composition.ChkPtAp10.ChkPtAp10_100msStart_CP, service-port=WdgM.SE000_SE_100ms_10_CP000_ChkPtAp10_100msStart_CP
    service connector prototype WdgM_SE003_SE_10ms_10_CP001_ChkPtAp10_10msEnd_CP_ChkPtAp10_ChkPtAp10_10msEnd_CP: application-port=ECU_Composition.ChkPtAp10.ChkPtAp10_10msEnd_CP, service-port=WdgM.SE003_SE_10ms_10_CP001_ChkPtAp10_10msEnd_CP
    service connector prototype WdgM_SE003_SE_10ms_10_CP000_ChkPtAp10_10msStart_CP_ChkPtAp10_ChkPtAp10_10msStart_CP: application-port=ECU_Composition.ChkPtAp10.ChkPtAp10_10msStart_CP, service-port=WdgM.SE003_SE_10ms_10_CP000_ChkPtAp10_10msStart_CP
    service connector prototype WdgM_SE007_SE_2ms_10_CP001_ChkPtAp10_2msEnd_CP_ChkPtAp10_ChkPtAp10_2msEnd_CP: application-port=ECU_Composition.ChkPtAp10.ChkPtAp10_2msEnd_CP, service-port=WdgM.SE007_SE_2ms_10_CP001_ChkPtAp10_2msEnd_CP
    service connector prototype WdgM_SE007_SE_2ms_10_CP000_ChkPtAp10_2msStart_CP_ChkPtAp10_ChkPtAp10_2msStart_CP: application-port=ECU_Composition.ChkPtAp10.ChkPtAp10_2msStart_CP, service-port=WdgM.SE007_SE_2ms_10_CP000_ChkPtAp10_2msStart_CP
    service connector prototype WdgM_SE005_SE_4ms_10_CP001_ChkPtAp10_4msEnd_CP_ChkPtAp10_ChkPtAp10_4msEnd_CP: application-port=ECU_Composition.ChkPtAp10.ChkPtAp10_4msEnd_CP, service-port=WdgM.SE005_SE_4ms_10_CP001_ChkPtAp10_4msEnd_CP
    service connector prototype WdgM_SE005_SE_4ms_10_CP000_ChkPtAp10_4msStart_CP_ChkPtAp10_ChkPtAp10_4msStart_CP: application-port=ECU_Composition.ChkPtAp10.ChkPtAp10_4msStart_CP, service-port=WdgM.SE005_SE_4ms_10_CP000_ChkPtAp10_4msStart_CP
    service connector prototype WdgM_SE001_SE_100ms_8_CP001_ChkPtAp8_100msEnd_CP_ChkPtAp8_ChkPtAp8_100msEnd_CP: application-port=ECU_Composition.ChkPtAp8.ChkPtAp8_100msEnd_CP, service-port=WdgM.SE001_SE_100ms_8_CP001_ChkPtAp8_100msEnd_CP
    service connector prototype WdgM_SE001_SE_100ms_8_CP000_ChkPtAp8_100msStart_CP_ChkPtAp8_ChkPtAp8_100msStart_CP: application-port=ECU_Composition.ChkPtAp8.ChkPtAp8_100msStart_CP, service-port=WdgM.SE001_SE_100ms_8_CP000_ChkPtAp8_100msStart_CP
    service connector prototype WdgM_SE008_SE_2ms_8_CP001_ChkPtAp8_2msEnd_CP_ChkPtAp8_ChkPtAp8_2msEnd_CP: application-port=ECU_Composition.ChkPtAp8.ChkPtAp8_2msEnd_CP, service-port=WdgM.SE008_SE_2ms_8_CP001_ChkPtAp8_2msEnd_CP
    service connector prototype WdgM_SE008_SE_2ms_8_CP000_ChkPtAp8_2msStart_CP_ChkPtAp8_ChkPtAp8_2msStart_CP: application-port=ECU_Composition.ChkPtAp8.ChkPtAp8_2msStart_CP, service-port=WdgM.SE008_SE_2ms_8_CP000_ChkPtAp8_2msStart_CP
    service connector prototype WdgM_SE002_SE_100ms_9_CP001_ChkPtAp9_100msEnd_CP_ChkPtAp9_ChkPtAp9_100msEnd_CP: application-port=ECU_Composition.ChkPtAp9.ChkPtAp9_100msEnd_CP, service-port=WdgM.SE002_SE_100ms_9_CP001_ChkPtAp9_100msEnd_CP
    service connector prototype WdgM_SE002_SE_100ms_9_CP000_ChkPtAp9_100msStart_CP_ChkPtAp9_ChkPtAp9_100msStart_CP: application-port=ECU_Composition.ChkPtAp9.ChkPtAp9_100msStart_CP, service-port=WdgM.SE002_SE_100ms_9_CP000_ChkPtAp9_100msStart_CP
    service connector prototype WdgM_SE004_SE_10ms_9_CP001_ChkPtAp9_10msEnd_CP_ChkPtAp9_ChkPtAp9_10msEnd_CP: application-port=ECU_Composition.ChkPtAp9.ChkPtAp9_10msEnd_CP, service-port=WdgM.SE004_SE_10ms_9_CP001_ChkPtAp9_10msEnd_CP
    service connector prototype WdgM_SE004_SE_10ms_9_CP000_ChkPtAp9_10msStart_CP_ChkPtAp9_ChkPtAp9_10msStart_CP: application-port=ECU_Composition.ChkPtAp9.ChkPtAp9_10msStart_CP, service-port=WdgM.SE004_SE_10ms_9_CP000_ChkPtAp9_10msStart_CP
    service connector prototype WdgM_SE009_SE_2ms_9_CP001_ChkPtAp9_2msEnd_CP_ChkPtAp9_ChkPtAp9_2msEnd_CP: application-port=ECU_Composition.ChkPtAp9.ChkPtAp9_2msEnd_CP, service-port=WdgM.SE009_SE_2ms_9_CP001_ChkPtAp9_2msEnd_CP
    service connector prototype WdgM_SE009_SE_2ms_9_CP000_ChkPtAp9_2msStart_CP_ChkPtAp9_ChkPtAp9_2msStart_CP: application-port=ECU_Composition.ChkPtAp9.ChkPtAp9_2msStart_CP, service-port=WdgM.SE009_SE_2ms_9_CP000_ChkPtAp9_2msStart_CP
    service connector prototype WdgM_SE006_SE_4ms_9_CP001_ChkPtAp9_4msEnd_CP_ChkPtAp9_ChkPtAp9_4msEnd_CP: application-port=ECU_Composition.ChkPtAp9.ChkPtAp9_4msEnd_CP, service-port=WdgM.SE006_SE_4ms_9_CP001_ChkPtAp9_4msEnd_CP
    service connector prototype WdgM_SE006_SE_4ms_9_CP000_ChkPtAp9_4msStart_CP_ChkPtAp9_ChkPtAp9_4msStart_CP: application-port=ECU_Composition.ChkPtAp9.ChkPtAp9_4msStart_CP, service-port=WdgM.SE006_SE_4ms_9_CP000_ChkPtAp9_4msStart_CP
    service connector prototype NvMProxy_PS_NvMP_NvmBlock_CurrTempOffset_CmMtrCurr_EOLCurrTempOffset: application-port=ECU_Composition.CmMtrCurr.EOLCurrTempOffset, service-port=NvMProxy.PS_NvMP_NvmBlock_CurrTempOffset
    service connector prototype NvMProxy_PS_NvMP_NvmBlock_ShCurrCal_CmMtrCurr_EOLShCurrCal: application-port=ECU_Composition.CmMtrCurr.EOLShCurrCal, service-port=NvMProxy.PS_NvMP_NvmBlock_ShCurrCal
    service connector prototype NexteerLibs_SystemTime_ComplErr_SystemTime: application-port=ECU_Composition.ComplErr.SystemTime, service-port=NexteerLibs.SystemTime
    service connector prototype NexteerLibs_SystemTime_CtrldDisShtdn_SystemTime: application-port=ECU_Composition.CtrldDisShtdn.SystemTime, service-port=NexteerLibs.SystemTime
    service connector prototype NvMProxy_PS_NvMP_NvmBlock_EOLNomMtrParam_CurrParamComp_EOLNomMtrParamBlk: application-port=ECU_Composition.CurrParamComp.EOLNomMtrParamBlk, service-port=NvMProxy.PS_NvMP_NvmBlock_EOLNomMtrParam
    service connector prototype NvM_PS_Rte_NvmBlock_DiagSvc_AppSwFingerPrint_DiagSvc_AppSwFingerPrint: application-port=ECU_Composition.DiagSvc.AppSwFingerPrint, service-port=NvM.PS_Rte_NvmBlock_DiagSvc_AppSwFingerPrint
    service connector prototype NvM_PS_Rte_NvmBlock_DiagSvc_BootSwFingerPrint_DiagSvc_BootSwFingerPrint: application-port=ECU_Composition.DiagSvc.BootSwFingerPrint, service-port=NvM.PS_Rte_NvmBlock_DiagSvc_BootSwFingerPrint
    service connector prototype NvM_PS_Rte_NvmBlock_DiagSvc_CalSwFingerPrint_DiagSvc_CalSwFingerPrint: application-port=ECU_Composition.DiagSvc.CalSwFingerPrint, service-port=NvM.PS_Rte_NvmBlock_DiagSvc_CalSwFingerPrint
    service connector prototype Dcm_ComControlService_DiagSvc_ComControlService: application-port=ECU_Composition.DiagSvc.ComControlService, service-port=Dcm.ComControlService
    service connector prototype Dcm_DCMServices_DiagSvc_DCMServices: application-port=ECU_Composition.DiagSvc.DCMServices, service-port=Dcm.DCMServices
    service connector prototype Dcm_DidServices_0x0100_DiagSvc_DidServices_0x0100: application-port=ECU_Composition.DiagSvc.DidServices_0x0100, service-port=Dcm.DidServices_0x0100
    service connector prototype Dcm_DidServices_0x0885_DiagSvc_DidServices_0x0885: application-port=ECU_Composition.DiagSvc.DidServices_0x0885, service-port=Dcm.DidServices_0x0885
    service connector prototype Dcm_DidServices_0x0ad9_DiagSvc_DidServices_0x0ad9: application-port=ECU_Composition.DiagSvc.DidServices_0x0ad9, service-port=Dcm.DidServices_0x0ad9
    service connector prototype Dcm_DidServices_0x0ada_DiagSvc_DidServices_0x0ada: application-port=ECU_Composition.DiagSvc.DidServices_0x0ada, service-port=Dcm.DidServices_0x0ada
    service connector prototype Dcm_DidServices_0x0adb_DiagSvc_DidServices_0x0adb: application-port=ECU_Composition.DiagSvc.DidServices_0x0adb, service-port=Dcm.DidServices_0x0adb
    service connector prototype Dcm_DidServices_0x0adc_DiagSvc_DidServices_0x0adc: application-port=ECU_Composition.DiagSvc.DidServices_0x0adc, service-port=Dcm.DidServices_0x0adc
    service connector prototype Dcm_DidServices_0x0ade_DiagSvc_DidServices_0x0ade: application-port=ECU_Composition.DiagSvc.DidServices_0x0ade, service-port=Dcm.DidServices_0x0ade
    service connector prototype Dcm_DidServices_0x1002_DiagSvc_DidServices_0x1002: application-port=ECU_Composition.DiagSvc.DidServices_0x1002, service-port=Dcm.DidServices_0x1002
    service connector prototype Dcm_DidServices_0x1004_DiagSvc_DidServices_0x1004: application-port=ECU_Composition.DiagSvc.DidServices_0x1004, service-port=Dcm.DidServices_0x1004
    service connector prototype Dcm_DidServices_0x1006_DiagSvc_DidServices_0x1006: application-port=ECU_Composition.DiagSvc.DidServices_0x1006, service-port=Dcm.DidServices_0x1006
    service connector prototype Dcm_DidServices_0x1008_DiagSvc_DidServices_0x1008: application-port=ECU_Composition.DiagSvc.DidServices_0x1008, service-port=Dcm.DidServices_0x1008
    service connector prototype Dcm_DidServices_0x1009_DiagSvc_DidServices_0x1009: application-port=ECU_Composition.DiagSvc.DidServices_0x1009, service-port=Dcm.DidServices_0x1009
    service connector prototype Dcm_DidServices_0x102a_DiagSvc_DidServices_0x102a: application-port=ECU_Composition.DiagSvc.DidServices_0x102a, service-port=Dcm.DidServices_0x102a
    service connector prototype Dcm_DidServices_0x191d_DiagSvc_DidServices_0x191d: application-port=ECU_Composition.DiagSvc.DidServices_0x191d, service-port=Dcm.DidServices_0x191d
    service connector prototype Dcm_DidServices_0x1921_DiagSvc_DidServices_0x1921: application-port=ECU_Composition.DiagSvc.DidServices_0x1921, service-port=Dcm.DidServices_0x1921
    service connector prototype Dcm_DidServices_0x{2001..2003}_DiagSvc_DidServices_0x{2001..2003}: application-port=ECU_Composition.DiagSvc.DidServices_0x{2001..2003}, service-port=Dcm.DidServices_0x{2001..2003}
    service connector prototype Dcm_DidServices_0x2008_DiagSvc_DidServices_0x2008: application-port=ECU_Composition.DiagSvc.DidServices_0x2008, service-port=Dcm.DidServices_0x2008
    service connector prototype Dcm_DidServices_0x200a_DiagSvc_DidServices_0x200a: application-port=ECU_Composition.DiagSvc.DidServices_0x200a, service-port=Dcm.DidServices_0x200a
    service connector prototype Dcm_DidServices_0x200b_DiagSvc_DidServices_0x200b: application-port=ECU_Composition.DiagSvc.DidServices_0x200b, service-port=Dcm.DidServices_0x200b
    service connector prototype Dcm_DidServices_0x200c_DiagSvc_DidServices_0x200c: application-port=ECU_Composition.DiagSvc.DidServices_0x200c, service-port=Dcm.DidServices_0x200c
    service connector prototype Dcm_DidServices_0x2010_DiagSvc_DidServices_0x2010: application-port=ECU_Composition.DiagSvc.DidServices_0x2010, service-port=Dcm.DidServices_0x2010
    service connector prototype Dcm_DidServices_0x2014_DiagSvc_DidServices_0x2014: application-port=ECU_Composition.DiagSvc.DidServices_0x2014, service-port=Dcm.DidServices_0x2014
    service connector prototype Dcm_DidServices_0x2023_DiagSvc_DidServices_0x2023: application-port=ECU_Composition.DiagSvc.DidServices_0x2023, service-port=Dcm.DidServices_0x2023
    service connector prototype Dcm_DidServices_0x2024_DiagSvc_DidServices_0x2024: application-port=ECU_Composition.DiagSvc.DidServices_0x2024, service-port=Dcm.DidServices_0x2024
    service connector prototype Dcm_DidServices_0x292e_DiagSvc_DidServices_0x292e: application-port=ECU_Composition.DiagSvc.DidServices_0x292e, service-port=Dcm.DidServices_0x292e
    service connector prototype Dcm_DidServices_0x5051_DiagSvc_DidServices_0x5051: application-port=ECU_Composition.DiagSvc.DidServices_0x5051, service-port=Dcm.DidServices_0x5051
    service connector prototype Dcm_DidServices_0x5052_DiagSvc_DidServices_0x5052: application-port=ECU_Composition.DiagSvc.DidServices_0x5052, service-port=Dcm.DidServices_0x5052
    service connector prototype Dcm_DidServices_0x5aab_DiagSvc_DidServices_0x5aab: application-port=ECU_Composition.DiagSvc.DidServices_0x5aab, service-port=Dcm.DidServices_0x5aab
    service connector prototype Dcm_DidServices_0xf100_DiagSvc_DidServices_0xf100: application-port=ECU_Composition.DiagSvc.DidServices_0xf100, service-port=Dcm.DidServices_0xf100
    service connector prototype Dcm_DidServices_0xf10b_DiagSvc_DidServices_0xf10b: application-port=ECU_Composition.DiagSvc.DidServices_0xf10b, service-port=Dcm.DidServices_0xf10b
    service connector prototype Dcm_DidServices_0xf10d_DiagSvc_DidServices_0xf10d: application-port=ECU_Composition.DiagSvc.DidServices_0xf10d, service-port=Dcm.DidServices_0xf10d
    service connector prototype Dcm_DidServices_0xf154_DiagSvc_DidServices_0xf154: application-port=ECU_Composition.DiagSvc.DidServices_0xf154, service-port=Dcm.DidServices_0xf154
    service connector prototype Dcm_DidServices_0xf155_DiagSvc_DidServices_0xf155: application-port=ECU_Composition.DiagSvc.DidServices_0xf155, service-port=Dcm.DidServices_0xf155
    service connector prototype Dcm_DidServices_0xf158_DiagSvc_DidServices_0xf158: application-port=ECU_Composition.DiagSvc.DidServices_0xf158, service-port=Dcm.DidServices_0xf158
    service connector prototype Dcm_DidServices_0xf{180..188}_DiagSvc_DidServices_0xf{180..188}: application-port=ECU_Composition.DiagSvc.DidServices_0xf{180..188}, service-port=Dcm.DidServices_0xf{180..188}
    service connector prototype Dcm_DidServices_0xf18c_DiagSvc_DidServices_0xf18c: application-port=ECU_Composition.DiagSvc.DidServices_0xf18c, service-port=Dcm.DidServices_0xf18c
    service connector prototype Dcm_DidServices_0xf{191..195}_DiagSvc_DidServices_0xf{191..195}: application-port=ECU_Composition.DiagSvc.DidServices_0xf{191..195}, service-port=Dcm.DidServices_0xf{191..195}
    service connector prototype Dcm_DidServices_0xf1a0_DiagSvc_DidServices_0xf1a0: application-port=ECU_Composition.DiagSvc.DidServices_0xf1a0, service-port=Dcm.DidServices_0xf1a0
    service connector prototype Dcm_DidServices_0xf1a3_DiagSvc_DidServices_0xf1a3: application-port=ECU_Composition.DiagSvc.DidServices_0xf1a3, service-port=Dcm.DidServices_0xf1a3
    service connector prototype Dcm_DidServices_0xf1a4_DiagSvc_DidServices_0xf1a4: application-port=ECU_Composition.DiagSvc.DidServices_0xf1a4, service-port=Dcm.DidServices_0xf1a4
    service connector prototype Dcm_DidServices_0xfd{01..03}_DiagSvc_DidServices_0xfd{01..03}: application-port=ECU_Composition.DiagSvc.DidServices_0xfd{01..03}, service-port=Dcm.DidServices_0xfd{01..03}
    service connector prototype Dcm_DidServices_0xfd07_DiagSvc_DidServices_0xfd07: application-port=ECU_Composition.DiagSvc.DidServices_0xfd07, service-port=Dcm.DidServices_0xfd07
    service connector prototype Dcm_DidServices_0xfd0d_DiagSvc_DidServices_0xfd0d: application-port=ECU_Composition.DiagSvc.DidServices_0xfd0d, service-port=Dcm.DidServices_0xfd0d
    service connector prototype Dcm_DidServices_0xfd0e_DiagSvc_DidServices_0xfd0e: application-port=ECU_Composition.DiagSvc.DidServices_0xfd0e, service-port=Dcm.DidServices_0xfd0e
    service connector prototype Dcm_DidServices_0xfd{10..14}_DiagSvc_DidServices_0xfd{10..14}: application-port=ECU_Composition.DiagSvc.DidServices_0xfd{10..14}, service-port=Dcm.DidServices_0xfd{10..14}
    service connector prototype Dcm_DidServices_0xfd17_DiagSvc_DidServices_0xfd17: application-port=ECU_Composition.DiagSvc.DidServices_0xfd17, service-port=Dcm.DidServices_0xfd17
    service connector prototype Dcm_DidServices_0xfd19_DiagSvc_DidServices_0xfd19: application-port=ECU_Composition.DiagSvc.DidServices_0xfd19, service-port=Dcm.DidServices_0xfd19
    service connector prototype Dcm_DidServices_0xfd1a_DiagSvc_DidServices_0xfd1a: application-port=ECU_Composition.DiagSvc.DidServices_0xfd1a, service-port=Dcm.DidServices_0xfd1a
    service connector prototype Dcm_DidServices_0xfd1b_DiagSvc_DidServices_0xfd1b: application-port=ECU_Composition.DiagSvc.DidServices_0xfd1b, service-port=Dcm.DidServices_0xfd1b
    service connector prototype Dcm_DidServices_0xfd1c_DiagSvc_DidServices_0xfd1c: application-port=ECU_Composition.DiagSvc.DidServices_0xfd1c, service-port=Dcm.DidServices_0xfd1c
    service connector prototype Dcm_DidServices_0xfd1e_DiagSvc_DidServices_0xfd1e: application-port=ECU_Composition.DiagSvc.DidServices_0xfd1e, service-port=Dcm.DidServices_0xfd1e
    service connector prototype Dcm_DidServices_0xfd20_DiagSvc_DidServices_0xfd20: application-port=ECU_Composition.DiagSvc.DidServices_0xfd20, service-port=Dcm.DidServices_0xfd20
    service connector prototype Dcm_DidServices_0xfd21_DiagSvc_DidServices_0xfd21: application-port=ECU_Composition.DiagSvc.DidServices_0xfd21, service-port=Dcm.DidServices_0xfd21
    service connector prototype Dcm_DidServices_0xfd23_DiagSvc_DidServices_0xfd23: application-port=ECU_Composition.DiagSvc.DidServices_0xfd23, service-port=Dcm.DidServices_0xfd23
    service connector prototype Dcm_DidServices_0xfd{25..27}_DiagSvc_DidServices_0xfd{25..27}: application-port=ECU_Composition.DiagSvc.DidServices_0xfd{25..27}, service-port=Dcm.DidServices_0xfd{25..27}
    service connector prototype Dcm_DidServices_0xfd{29..31}_DiagSvc_DidServices_0xfd{29..31}: application-port=ECU_Composition.DiagSvc.DidServices_0xfd{29..31}, service-port=Dcm.DidServices_0xfd{29..31}
    service connector prototype Dcm_DidServices_0xfda{1..3}_DiagSvc_DidServices_0xfda{1..3}: application-port=ECU_Composition.DiagSvc.DidServices_0xfda{1..3}, service-port=Dcm.DidServices_0xfda{1..3}
    service connector prototype Dcm_DidServices_0xfdac_DiagSvc_DidServices_0xfdac: application-port=ECU_Composition.DiagSvc.DidServices_0xfdac, service-port=Dcm.DidServices_0xfdac
    service connector prototype Dcm_DidServices_0xfdad_DiagSvc_DidServices_0xfdad: application-port=ECU_Composition.DiagSvc.DidServices_0xfdad, service-port=Dcm.DidServices_0xfdad
    service connector prototype Dcm_DidServices_0xfdae_DiagSvc_DidServices_0xfdae: application-port=ECU_Composition.DiagSvc.DidServices_0xfdae, service-port=Dcm.DidServices_0xfdae
    service connector prototype Dcm_DidServices_0xfdaf_DiagSvc_DidServices_0xfdaf: application-port=ECU_Composition.DiagSvc.DidServices_0xfdaf, service-port=Dcm.DidServices_0xfdaf
    service connector prototype Dcm_DidServices_0xfdb{0..7}_DiagSvc_DidServices_0xfdb{0..7}: application-port=ECU_Composition.DiagSvc.DidServices_0xfdb{0..7}, service-port=Dcm.DidServices_0xfdb{0..7}
    service connector prototype NvM_PS_Rte_NvmBlock_DiagSvc_ECULifeTimeMins_DiagSvc_ECULifeTimeMins: application-port=ECU_Composition.DiagSvc.ECULifeTimeMins, service-port=NvM.PS_Rte_NvmBlock_DiagSvc_ECULifeTimeMins
    service connector prototype NvM_PS_Rte_NvmBlock_DiagSvc_ECUSerialNumber_DiagSvc_ECUSerialNumberData: application-port=ECU_Composition.DiagSvc.ECUSerialNumberData, service-port=NvM.PS_Rte_NvmBlock_DiagSvc_ECUSerialNumber
    service connector prototype NvM_PS_Rte_NvmBlock_DiagSvc_ECUSparePartNo_DiagSvc_ECUSparePartNo: application-port=ECU_Composition.DiagSvc.ECUSparePartNo, service-port=NvM.PS_Rte_NvmBlock_DiagSvc_ECUSparePartNo
    service connector prototype NvM_PS_Rte_NvmBlock_DiagSvc_EOLConfigData_DiagSvc_EOLConfiguration: application-port=ECU_Composition.DiagSvc.EOLConfiguration, service-port=NvM.PS_Rte_NvmBlock_DiagSvc_EOLConfigData
    service connector prototype NvM_PS_Rte_NvmBlock_DiagSvc_EraseRoutineStatus_DiagSvc_EraseRoutineStatus: application-port=ECU_Composition.DiagSvc.EraseRoutineStatus, service-port=NvM.PS_Rte_NvmBlock_DiagSvc_EraseRoutineStatus
    service connector prototype NvM_PS_Rte_NvmBlock_DiagSvc_FirstDTCDetectMins_DiagSvc_FirstDTCDetectMins: application-port=ECU_Composition.DiagSvc.FirstDTCDetectMins, service-port=NvM.PS_Rte_NvmBlock_DiagSvc_FirstDTCDetectMins
    service connector prototype NvM_PS_Rte_NvmBlock_DiagSvc_FirstDTCDetectSecs_DiagSvc_FirstDTCDetectSecs: application-port=ECU_Composition.DiagSvc.FirstDTCDetectSecs, service-port=NvM.PS_Rte_NvmBlock_DiagSvc_FirstDTCDetectSecs
    service connector prototype NvM_PS_Rte_NvmBlock_DiagSvc_OdometerFlashProg_DiagSvc_OdometerFlashProg: application-port=ECU_Composition.DiagSvc.OdometerFlashProg, service-port=NvM.PS_Rte_NvmBlock_DiagSvc_OdometerFlashProg
    service connector prototype NvM_PS_Rte_NvmBlock_DiagSvc_ProgAttemptsCounter_DiagSvc_ProgrammingAttemptCounter: application-port=ECU_Composition.DiagSvc.ProgrammingAttemptCounter, service-port=NvM.PS_Rte_NvmBlock_DiagSvc_ProgAttemptsCounter
    service connector prototype NvM_PS_Rte_NvmBlock_DiagSvc_ProgrammingStatus_DiagSvc_ProgrammingStatus: application-port=ECU_Composition.DiagSvc.ProgrammingStatus, service-port=NvM.PS_Rte_NvmBlock_DiagSvc_ProgrammingStatus
    service connector prototype NvM_PS_Rte_NvmBlock_DiagSvc_ProxiConfigurationData_DiagSvc_ProxiConfiguration: application-port=ECU_Composition.DiagSvc.ProxiConfiguration, service-port=NvM.PS_Rte_NvmBlock_DiagSvc_ProxiConfigurationData
    service connector prototype NvM_PS_Rte_NvmBlock_DiagSvc_ProxiCounter_DiagSvc_ProxiCounter: application-port=ECU_Composition.DiagSvc.ProxiCounter, service-port=NvM.PS_Rte_NvmBlock_DiagSvc_ProxiCounter
    service connector prototype Dcm_ResetService_DiagSvc_ResetService: application-port=ECU_Composition.DiagSvc.ResetService, service-port=Dcm.ResetService
    service connector prototype Dcm_RoutineServices_0x0200_DiagSvc_RoutineServices_0x0200: application-port=ECU_Composition.DiagSvc.RoutineServices_0x0200, service-port=Dcm.RoutineServices_0x0200
    service connector prototype Dcm_RoutineServices_0xd001_DiagSvc_RoutineServices_0xd001: application-port=ECU_Composition.DiagSvc.RoutineServices_0xd001, service-port=Dcm.RoutineServices_0xd001
    service connector prototype Dcm_RoutineServices_0xd002_DiagSvc_RoutineServices_0xd002: application-port=ECU_Composition.DiagSvc.RoutineServices_0xd002, service-port=Dcm.RoutineServices_0xd002
    service connector prototype Dcm_RoutineServices_0xf000_DiagSvc_RoutineServices_0xf000: application-port=ECU_Composition.DiagSvc.RoutineServices_0xf000, service-port=Dcm.RoutineServices_0xf000
    service connector prototype Dcm_RoutineServices_0xf001_DiagSvc_RoutineServices_0xf001: application-port=ECU_Composition.DiagSvc.RoutineServices_0xf001, service-port=Dcm.RoutineServices_0xf001
    service connector prototype Dcm_RoutineServices_0xf{003..005}_DiagSvc_RoutineServices_0xf{003..005}: application-port=ECU_Composition.DiagSvc.RoutineServices_0xf{003..005}, service-port=Dcm.RoutineServices_0xf{003..005}
    service connector prototype Dcm_RoutineServices_0xf008_DiagSvc_RoutineServices_0xf008: application-port=ECU_Composition.DiagSvc.RoutineServices_0xf008, service-port=Dcm.RoutineServices_0xf008
    service connector prototype Dcm_RoutineServices_0xf009_DiagSvc_RoutineServices_0xf009: application-port=ECU_Composition.DiagSvc.RoutineServices_0xf009, service-port=Dcm.RoutineServices_0xf009
    service connector prototype Dcm_RoutineServices_0xf0ff_DiagSvc_RoutineServices_0xf0ff: application-port=ECU_Composition.DiagSvc.RoutineServices_0xf0ff, service-port=Dcm.RoutineServices_0xf0ff
    service connector prototype Dcm_RoutineServices_0xfee0_DiagSvc_RoutineServices_0xfee0: application-port=ECU_Composition.DiagSvc.RoutineServices_0xfee0, service-port=Dcm.RoutineServices_0xfee0
    service connector prototype Dcm_SecurityAccess_1_DiagSvc_SecurityAccess_1: application-port=ECU_Composition.DiagSvc.SecurityAccess_1, service-port=Dcm.SecurityAccess_1
    service connector prototype Dcm_SessionControl_DiagSvc_SessionControl: application-port=ECU_Composition.DiagSvc.SessionControl, service-port=Dcm.SessionControl
    service connector prototype NexteerLibs_SystemTime_DiagSvc_SystemTime: application-port=ECU_Composition.DiagSvc.SystemTime, service-port=NexteerLibs.SystemTime
    service connector prototype NvM_PS_Rte_NvmBlock_DiagSvc_TotalOdometer_DiagSvc_TotalOdometer: application-port=ECU_Composition.DiagSvc.TotalOdometer, service-port=NvM.PS_Rte_NvmBlock_DiagSvc_TotalOdometer
    service connector prototype NvM_PS_Rte_NvmBlock_DiagSvc_TuningSetSelectData_DiagSvc_TuningSetSelect: application-port=ECU_Composition.DiagSvc.TuningSetSelect, service-port=NvM.PS_Rte_NvmBlock_DiagSvc_TuningSetSelectData
    service connector prototype NvM_PS_Rte_NvmBlock_DiagSvc_VINCurrent_DiagSvc_VINCurrent: application-port=ECU_Composition.DiagSvc.VINCurrent, service-port=NvM.PS_Rte_NvmBlock_DiagSvc_VINCurrent
    service connector prototype NvM_PS_Rte_NvmBlock_DiagSvc_VINOriginal_DiagSvc_VINOriginal: application-port=ECU_Composition.DiagSvc.VINOriginal, service-port=NvM.PS_Rte_NvmBlock_DiagSvc_VINOriginal
    service connector prototype NvMProxy_PS_NvMP_NvmBlock_DigTrqTrim_DigHwTrqSENT_NvM_DigHwTrqSENTTrim_Srv: application-port=ECU_Composition.DigHwTrqSENT.NvM_DigHwTrqSENTTrim_Srv, service-port=NvMProxy.PS_NvMP_NvmBlock_DigTrqTrim
    service connector prototype NexteerLibs_SystemTime_FltInjection_SystemTime: application-port=ECU_Composition.FltInjection.SystemTime, service-port=NexteerLibs.SystemTime
    service connector prototype NexteerLibs_SystemTime_IoHwAbstractionUsr_SystemTime: application-port=ECU_Composition.IoHwAbstractionUsr.SystemTime, service-port=NexteerLibs.SystemTime
    service connector prototype NvM_PS_Rte_NvmBlock_LrnEOT_LearnedEOT_LrnEOT_LearnedEOTData: application-port=ECU_Composition.LrnEOT.LearnedEOTData, service-port=NvM.PS_Rte_NvmBlock_LrnEOT_LearnedEOT
    service connector prototype NexteerLibs_SystemTime_LrnEOT_SystemTime: application-port=ECU_Composition.LrnEOT.SystemTime, service-port=NexteerLibs.SystemTime
    service connector prototype NexteerLibs_SystemTime_MtrDrvDiag_SystemTime: application-port=ECU_Composition.MtrDrvDiag.SystemTime, service-port=NexteerLibs.SystemTime
    service connector prototype NvMProxy_PS_NvMP_NvmBlock_Polarity_Polarity_Polarity: application-port=ECU_Composition.Polarity.Polarity, service-port=NvMProxy.PS_NvMP_NvmBlock_Polarity
    service connector prototype NexteerLibs_SystemTime_PwrLmtFuncCr_SystemTime: application-port=ECU_Composition.PwrLmtFuncCr.SystemTime, service-port=NexteerLibs.SystemTime
    service connector prototype NvMProxy_PS_NvMP_NvmBlock_DigColPsEOL_Sa_DigColPs_EOLDigColPosCals: application-port=ECU_Composition.Sa_DigColPs.EOLDigColPosCals, service-port=NvMProxy.PS_NvMP_NvmBlock_DigColPsEOL
    service connector prototype ComM_UR_ComMUser_CCAN_SrlComInput_ComM_UserRequest: application-port=ECU_Composition.SrlComInput.ComM_UserRequest, service-port=ComM.UR_ComMUser_CCAN
    service connector prototype NexteerLibs_SystemTime_SrlComInput_SystemTime: application-port=ECU_Composition.SrlComInput.SystemTime, service-port=NexteerLibs.SystemTime
    service connector prototype NexteerLibs_SystemTime_SrlComOutput_SystemTime: application-port=ECU_Composition.SrlComOutput.SystemTime, service-port=NexteerLibs.SystemTime
    service connector prototype NvMProxy_PS_NvMP_NvmBlock_CloseCheckData_StaMd_CloseCheckData: application-port=ECU_Composition.StaMd.CloseCheckData, service-port=NvMProxy.PS_NvMP_NvmBlock_CloseCheckData
    service connector prototype NvMProxy_PS_NvMP_NvmBlock_TypeHRamBuffer_StaMd_TypeHData: application-port=ECU_Composition.StaMd.TypeHData, service-port=NvMProxy.PS_NvMP_NvmBlock_TypeHRamBuffer
    service connector prototype NexteerLibs_SystemTime_StOpCtrl_SystemTime: application-port=ECU_Composition.StOpCtrl.SystemTime, service-port=NexteerLibs.SystemTime
    service connector prototype NexteerLibs_SystemTime_Sweep_SystemTime: application-port=ECU_Composition.Sweep.SystemTime, service-port=NexteerLibs.SystemTime
    service connector prototype NvM_PS_Rte_NvmBlock_ThrmlDutyCycle_ThrmlDutyCycle_FltStVal_ThrmlDutyCycle_ThrmlDutyCycle_FltStVar: application-port=ECU_Composition.ThrmlDutyCycle.ThrmlDutyCycle_FltStVar, service-port=NvM.PS_Rte_NvmBlock_ThrmlDutyCycle_ThrmlDutyCycle_FltStVal
    service connector prototype NexteerLibs_SystemTime_TmprlMon_SystemTime: application-port=ECU_Composition.TmprlMon.SystemTime, service-port=NexteerLibs.SystemTime
    service connector prototype NexteerLibs_SystemTime_TmprlMon2_SystemTime: application-port=ECU_Composition.TmprlMon2.SystemTime, service-port=NexteerLibs.SystemTime
    service connector prototype NvMProxy_PS_NvMP_NvmBlock_CogTrqCal_TrqCanc_EOLCogTrqCanc: application-port=ECU_Composition.TrqCanc.EOLCogTrqCanc, service-port=NvMProxy.PS_NvMP_NvmBlock_CogTrqCal
    service connector prototype NvMProxy_PS_NvMP_NvmBlock_CogTrqRplComp_TrqCanc_EOLCogTrqRplComp: application-port=ECU_Composition.TrqCanc.EOLCogTrqRplComp, service-port=NvMProxy.PS_NvMP_NvmBlock_CogTrqRplComp
    service connector prototype NvMProxy_PS_NvMP_NvmBlock_TorqueCmdSF_TrqCmdScl_TrqCmdScl: application-port=ECU_Composition.TrqCmdScl.TrqCmdScl, service-port=NvMProxy.PS_NvMP_NvmBlock_TorqueCmdSF
    service connector prototype NvMProxy_PS_NvMP_NvmBlock_MotPosReset_VehDyn_NVM_VehDynReset_Srv: application-port=ECU_Composition.VehDyn.NVM_VehDynReset_Srv, service-port=NvMProxy.PS_NvMP_NvmBlock_MotPosReset
    service connector prototype NexteerLibs_SystemTime_VehDyn_SystemTime: application-port=ECU_Composition.VehDyn.SystemTime, service-port=NexteerLibs.SystemTime
    service connector prototype ComM_UR_ComMUser_CCAN_VehPwrMd_ComM_UserRequest: application-port=ECU_Composition.VehPwrMd.ComM_UserRequest, service-port=ComM.UR_ComMUser_CCAN
    service connector prototype NexteerLibs_SystemTime_VehPwrMd_SystemTime: application-port=ECU_Composition.VehPwrMd.SystemTime, service-port=NexteerLibs.SystemTime
package /ECUCompositionType
  composition type ECU_Composition
    87 x component:
      AbsHwPos: type=Ap_AbsHwPos
      ActivePull: type=Ap_ActivePull
      ApXcp: type=Ap_ApXcp
      Assist: type=Ap_Assist
      AssistFirewall: type=Ap_AssistFirewall
      AstLmt: type=Ap_AstLmt
      AvgFricLrn: type=Ap_AvgFricLrn
      BatteryVoltage: type=Ap_BatteryVoltage
      BkCpPc: type=Sa_BkCpPc
      BVDiag: type=Ap_BVDiag
      CDDInterface: type=Sa_CDDInterface
      ChkPtAp10: type=Ap_ChkPtAp10
      ChkPtAp8: type=Ap_ChkPtAp8
      ChkPtAp9: type=Ap_ChkPtAp9
      CmMtrCurr: type=Sa_CmMtrCurr
      ComplErr: type=Ap_ComplErr
      CtrldDisShtdn: type=Ap_CtrldDisShtdn
      CtrlTemp: type=Sa_CtrlTemp
      CurrCmd: type=Ap_CurrCmd
      CurrParamComp: type=Ap_CurrParamComp
      Damping: type=Ap_Damping
      DampingFirewall: type=Ap_DampingFirewall
      DemIf: type=Ap_DemIf
      DiagMgr10: type=Ap_DiagMgr10
      DiagMgr8: type=Ap_DiagMgr8
      DiagMgr9: type=Ap_DiagMgr9
      DiagSvc: type=Ap_DiagSvc
      DigHwTrqSENT: type=Sa_DigHwTrqSENT
      DigMSB: type=Sa_DigMSB
      DigPhsReasDiag: type=Ap_DigPhsReasDiag
      ElePwr: type=Ap_ElePwr
      EOTActuatorMng: type=Ap_EOTActuatorMng
      ePWM2: type=Ap_ePWM2
      EtDmpFw: type=Ap_EtDmpFw
      FltInjection: type=Ap_FltInjection
      FrqDepDmpnInrtCmp: type=Ap_FrqDepDmpnInrtCmp
      Gsod: type=Ap_Gsod
      HighFreqAssist: type=Ap_HighFreqAssist
      HiLoadStall: type=Ap_HiLoadStall
      HwPwUp: type=Ap_HwPwUp
      HystComp: type=Ap_HystComp
      IoHwAbsDigSig: type=IoHwAbstraction
      IoHwAbstractionUsr: type=IoHwAbstractionUsr
      LmtCod: type=Ap_LmtCod
      LrnEOT: type=Ap_LrnEOT
      MtrDrvDiag: type=Sa_MtrDrvDiag
      MtrTempEst: type=Ap_MtrTempEst
      MtrVel: type=Sa_MtrVel
      MtrVel2: type=Sa_MtrVel2
      MtrVel3: type=Sa_MtrVel3
      Nhet1: type=Cd_Nhet1
      NtWrap: type=NtWrap
      OvrVoltMon: type=Sa_OvrVoltMon
      PeakCurrEst: type=Ap_PeakCurrEst
      PICurrCntrl: type=Ap_PICurrCntrl
      Polarity: type=Ap_Polarity
      PwrLmtFuncCr: type=Ap_PwrLmtFuncCr
      QuadDet: type=Ap_QuadDet
      Return: type=Ap_Return
      ReturnFirewall: type=Ap_ReturnFirewall
      RteErrata: type=RteErrata10
      RteErrata8: type=RteErrata8
      RteErrata9: type=RteErrata9
      Sa_DigColPs: type=Sa_DigColPs
      ShtdnMech: type=Sa_ShtdnMech
      SignlCondn: type=Ap_SignlCondn
      SrlComInput: type=Ap_SrlComInput
      SrlComOutput: type=Ap_SrlComOutput
      StabilityComp: type=Ap_StabilityComp
      StabilityComp2: type=Ap_StabilityComp2
      StaMd: type=Ap_StaMd
      StaMd8: type=Ap_StaMd8
      StaMd9: type=Ap_StaMd9
      StOpCtrl: type=Ap_StOpCtrl
      Sweep: type=Ap_Sweep
      Sweep2: type=Ap_Sweep2
      ThrmlDutyCycle: type=Ap_ThrmlDutyCycle
      TmprlMon: type=Sa_TmprlMon
      TmprlMon2: type=Sa_TmprlMon2
      TqRsDg: type=Ap_TqRsDg
      TrqCanc: type=Ap_TrqCanc
      TrqCmdScl: type=Ap_TrqCmdScl
      TuningSelAuth: type=Ap_TuningSelAuth
      uDiag: type=Cd_uDiag
      VehDyn: type=Ap_VehDyn
      VehPwrMd: type=Ap_VehPwrMd
      VehSpdLmt: type=Ap_VehSpdLmt
    connect AbsHwPos.AbsHwPos_SCom -> NtWrap.C_AbsHwPos_SCom
    connect AbsHwPos.HandwheelAuthority -> ActivePull.HandwheelAuthority
    connect AbsHwPos.HandwheelAuthority -> AvgFricLrn.HwPosAuthority
    connect AbsHwPos.HandwheelAuthority -> EOTActuatorMng.HandWheelAuth
    connect AbsHwPos.HandwheelAuthority -> EtDmpFw.HandwheelAuthority
    connect AbsHwPos.HandwheelAuthority -> LrnEOT.HandwheelAuthority
    connect AbsHwPos.HandwheelAuthority -> Return.HandwheelAuthority
    connect AbsHwPos.HandwheelAuthority -> SrlComOutput.HandwheelAuthority
    connect AbsHwPos.HandwheelAuthority -> VehDyn.HwAuth
    connect AbsHwPos.HandwheelAuthority -> VehSpdLmt.HwPosAuth
    connect AbsHwPos.HandwheelPosition -> ActivePull.HandwheelPosition
    connect AbsHwPos.HandwheelPosition -> AvgFricLrn.HwAng
    connect AbsHwPos.HandwheelPosition -> DiagSvc.HwPos
    connect AbsHwPos.HandwheelPosition -> EOTActuatorMng.HandWheelPos
    connect AbsHwPos.HandwheelPosition -> EtDmpFw.HandwheelPosition
    connect AbsHwPos.HandwheelPosition -> LrnEOT.HandwheelPosition
    connect AbsHwPos.HandwheelPosition -> Return.HandwheelPosition
    connect AbsHwPos.HandwheelPosition -> ReturnFirewall.HandwheelPosition
    connect AbsHwPos.HandwheelPosition -> VehDyn.HandwheelPosition
    connect AbsHwPos.HandwheelPosition -> VehSpdLmt.HwPos
    connect AbsHwPos.RelHwPos -> VehDyn.RelHwPos
    connect AbsHwPos.SrlComHwPos -> SrlComOutput.HandwheelPosition
    connect AbsHwPos.SrlComHwPosStatus -> SrlComOutput.SrlComHwPosStatus
    connect ActivePull.PullCompCmd -> AstLmt.PullCompCmd
    connect ApXcp.ActiveTunOvrPtrAddr -> TuningSelAuth.ActiveTunOvrPtrAddr
    connect ApXcp.TuningSessionActPtr -> TuningSelAuth.TuningSessionActPtr
    connect Assist.BaseAssistCmd -> AssistFirewall.BaseAssistCmd
    connect Assist.BaseAssistCmd -> DampingFirewall.BaseAssistCmd
    connect Assist.BaseAssistCmd -> FrqDepDmpnInrtCmp.BaseAssistCmd
    connect Assist.BaseAssistCmd -> HystComp.BaseAssistCmd
    connect AssistFirewall.AsstFirewallActive -> DampingFirewall.AsstFirewallActive
    connect AssistFirewall.AsstFirewallActive -> StabilityComp.AsstFWActive
    connect AssistFirewall.AsstFirewallActive -> StabilityComp2.AsstFWActive
    connect AssistFirewall.CombinedAssist -> StabilityComp.CombinedAssist
    connect AssistFirewall.CombinedAssist -> StabilityComp2.CombinedAssist
    connect AstLmt.AstLmt_Scom -> NtWrap.C_AstLmt_Scom
    connect AstLmt.PreLimitForStall -> HiLoadStall.PreLimitForStall
    connect AstLmt.PreLimitTorque -> EOTActuatorMng.PreLimitTorque
    connect AstLmt.SumLimTrqCmd -> Sweep2.InputMtrTrq
    connect AstLmt.TrqLimitMin -> TqRsDg.TrqLimitMin
    connect AvgFricLrn.FricOffset -> HystComp.FricOffset
    connect BatteryVoltage.SysC_Vecu -> Gsod.SysC_Vecu
    connect BatteryVoltage.Vecu -> CDDInterface.Vecu
    connect BatteryVoltage.Vecu -> CmMtrCurr.Vecu
    connect BatteryVoltage.Vecu -> CurrCmd.Vecu
    connect BatteryVoltage.Vecu -> DiagSvc.Vecu_Volt_f32
    connect BatteryVoltage.Vecu -> ElePwr.Vecu
    connect BatteryVoltage.Vecu -> Gsod.Vecu
    connect BatteryVoltage.Vecu -> PwrLmtFuncCr.Vecu
    connect BkCpPc.CapPcDcStub -> BkCpPc.PhyCapDischarge
    connect BkCpPc.CapPcDcStub -> BkCpPc.PhyCapPrecharge
    connect BkCpPc.PwrDiscATestComplete -> HwPwUp.PwrDiscATestComplete
    connect BkCpPc.PwrDiscBTestComplete -> HwPwUp.PwrDiscBTestComplete
    connect CDDInterface.ADCMtrCurr1 -> CmMtrCurr.ADCMtrCurr1
    connect CDDInterface.ADCMtrCurr2 -> CmMtrCurr.ADCMtrCurr2
    connect CDDInterface.CorrectedElecMtrPos -> DigMSB.CorrectedElecMtrPos
    connect CDDInterface.CorrMtrCurrPosition -> CmMtrCurr.CorrMtrCurrPosition
    connect CDDInterface.CorrMtrPosElec -> DigPhsReasDiag.LRPRCorrectedMtrPosCaptured
    connect CDDInterface.CorrMtrPosElec -> Gsod.Corrected_MtrPos
    connect CDDInterface.CorrMtrPosElec -> PICurrCntrl.CorrMtrPosElec
    connect CDDInterface.CumMechMtrPos -> DigMSB.CumMechMtrPos
    connect CDDInterface.DampingSrlComSvcDft -> Damping.DefeatDampingSvc
    connect CDDInterface.DampingSrlComSvcDft -> DampingFirewall.Defeat_Damping_Svc
    connect CDDInterface.DftAsstTbl -> Assist.DftAsstTbl
    connect CDDInterface.DftAsstTbl -> AssistFirewall.Defeat_AsstTbl_Service
    connect CDDInterface.Die1RxError -> DigMSB.Die1RxError
    connect CDDInterface.Die1RxMtrPos -> DigMSB.Die1RxMtrPos
    connect CDDInterface.Die1RxRevCtr -> DigMSB.Die1RxRevCtr
    connect CDDInterface.Die1UnderVoltgFltAccum -> DigMSB.Die1UnderVoltgFltAccum
    connect CDDInterface.Die2RxError -> DigMSB.Die2RxError
    connect CDDInterface.Die2RxMtrPos -> DigMSB.Die2RxMtrPos
    connect CDDInterface.Die2RxRevCtr -> DigMSB.Die2RxRevCtr
    connect CDDInterface.DwnldAsstGain -> Assist.DwnldAsstGain
    connect CDDInterface.EnergyModeState -> DigMSB.EnergyModeState
    connect CDDInterface.EngONSrlComSvcDft -> VehPwrMd.EngONSrlComSvcDft
    connect CDDInterface.EOTImpactSrlComSvcDft -> EOTActuatorMng.EOTDisable
    connect CDDInterface.EOTImpactSrlComSvcDft -> EtDmpFw.EOTDisable
    connect CDDInterface.EOTThermalSrlComSvcDft -> HiLoadStall.DftStallLimit
    connect CDDInterface.ExpectedOnTimeA -> DigPhsReasDiag.ExpectedOnTimeA
    connect CDDInterface.ExpectedOnTimeB -> DigPhsReasDiag.ExpectedOnTimeB
    connect CDDInterface.ExpectedOnTimeC -> DigPhsReasDiag.ExpectedOnTimeC
    connect CDDInterface.FreqDepDmpSrlComSvcDft -> DampingFirewall.FreqDepDmpSrlComSvcDft
    connect CDDInterface.FreqDepDmpSrlComSvcDft -> FrqDepDmpnInrtCmp.FreqDepDmpSrlComSvcDft
    connect CDDInterface.FricLrnSrlComSvcDft -> AvgFricLrn.DefeatFricLearning
    connect CDDInterface.HystCompSrlComSvcDft -> HystComp.DefeatHystService
    connect CDDInterface.IgnCnt -> DiagMgr10.IgnCnt
    connect CDDInterface.IgnCnt -> DiagMgr8.IgnCnt
    connect CDDInterface.IgnCnt -> DiagMgr9.IgnCnt
    connect CDDInterface.LimitSrlComSvcDft -> AstLmt.DefeatLimitService
    connect CDDInterface.LRPRPhaseadvanceCaptured -> DigPhsReasDiag.LRPRPhaseadvanceCaptured
    connect CDDInterface.MeasuredOnTimeA -> DigPhsReasDiag.MeasuredOnTimeA
    connect CDDInterface.MeasuredOnTimeB -> DigPhsReasDiag.MeasuredOnTimeB
    connect CDDInterface.MeasuredOnTimeC -> DigPhsReasDiag.MeasuredOnTimeC
    connect CDDInterface.MEC -> AbsHwPos.ManufMode
    connect CDDInterface.MEC -> AssistFirewall.MEC_Counter
    connect CDDInterface.MEC -> CmMtrCurr.MEC
    connect CDDInterface.MEC -> DampingFirewall.MEC_Counter
    connect CDDInterface.MEC -> DiagMgr10.MEC
    connect CDDInterface.MEC -> DiagMgr8.MEC
    connect CDDInterface.MEC -> DiagMgr9.MEC
    connect CDDInterface.MEC -> DiagSvc.MEC
    connect CDDInterface.MEC -> DigHwTrqSENT.MECCounter
    connect CDDInterface.MEC -> EtDmpFw.MEC_Counter
    connect CDDInterface.MEC -> ReturnFirewall.MEC_Counter
    connect CDDInterface.MEC -> Sa_DigColPs.MecState
    connect CDDInterface.MEC -> SrlComInput.MEC
    connect CDDInterface.MEC -> VehPwrMd.MEC
    connect CDDInterface.MechMtrPos1 -> VehDyn.MechMtrPos
    connect CDDInterface.MechMtrPos1TimeStamp -> MtrVel2.MechMtrPos1Timestamp
    connect CDDInterface.MechMtrPos2TimeStamp -> MtrVel.MechMtrPos2Timestamp
    connect CDDInterface.MfgDiagInhibit -> DiagMgr10.MfgDiagInhibit
    connect CDDInterface.MfgDiagInhibit -> DiagMgr8.MfgDiagInhibit
    connect CDDInterface.MfgDiagInhibit -> DiagMgr9.MfgDiagInhibit
    connect CDDInterface.ModIdxFinal -> DigPhsReasDiag.LRPRModulationIndexCaptured
    connect CDDInterface.MtrCurrDax -> ElePwr.MtrCurrDax
    connect CDDInterface.MtrCurrDax -> PeakCurrEst.MtrCurrDax
    connect CDDInterface.MtrCurrK1 -> CmMtrCurr.MtrCurrK1
    connect CDDInterface.MtrCurrK2 -> CmMtrCurr.MtrCurrK2
    connect CDDInterface.MtrCurrQax -> ElePwr.MtrCurrQax
    connect CDDInterface.MtrCurrQax -> PeakCurrEst.MtrCurrQax
    connect CDDInterface.MtrVoltDax -> ElePwr.MtrVoltDax
    connect CDDInterface.MtrVoltQax -> ElePwr.MtrVoltQax
    connect CDDInterface.PullCompSrlComSvcDft -> ActivePull.DisableLearning
    connect CDDInterface.PullCompSrlComSvcDft -> ActivePull.DisableOutput
    connect CDDInterface.ReturnSrlComSvcDft -> Return.DefeatReturnSvc
    connect CDDInterface.ReturnSrlComSvcDft -> ReturnFirewall.Defeat_Return_Svc
    connect CDDInterface.RxMsgsSrlComSvcDft -> SrlComInput.RxMsgsSrlComSvcDft
    connect CDDInterface.RxMtrPosParityAccum -> DigMSB.RxMtrPosParityAccum
    connect CDDInterface.SrlComSvcDft -> CmMtrCurr.SrlComSvcDft
    connect CDDInterface.SysCCorrMtrPosElec -> Gsod.SysC_Corrected_MtrPos
    connect CDDInterface.SysCVSwitchADC -> IoHwAbstractionUsr.SysCVSwitchADC
    connect CDDInterface.ThermalDCSrlComSvcDft -> ThrmlDutyCycle.DefeatDutySvc
    connect CDDInterface.TrqRmpSrlComSvcDft -> StOpCtrl.RampSrlComSvcDft
    connect CDDInterface.UncorrMechMtrPos1 -> DigMSB.UncorrMechMtrPos1
    connect CmMtrCurr.CmMtrCurr_SCom -> NtWrap.C_CmMtrCurr_SCom
    connect CmMtrCurr.ComOffset -> CDDInterface.CommOffset
    connect CmMtrCurr.CurrentGainSvc -> CurrCmd.CurrentGainSvc
    connect CmMtrCurr.MtrCurr1TempOffset -> CDDInterface.MtrCurr1TempOffset
    connect CmMtrCurr.MtrCurr2TempOffset -> CDDInterface.MtrCurr2TempOffset
    connect ComplErr.ComplErr -> AbsHwPos.ComplError
    connect CtrldDisShtdn.CntDisMtrTrqCmdCRF -> AvgFricLrn.CRFMtrTrq
    connect CtrldDisShtdn.CntDisMtrTrqCmdCRF -> ComplErr.TorqueCmdCRF
    connect CtrldDisShtdn.CntDisMtrTrqCmdCRF -> Gsod.Torque_Cmd_CRF
    connect CtrldDisShtdn.CntDisMtrTrqCmdCRF -> VehDyn.TorqueCmdCRF
    connect CtrldDisShtdn.CntDisMtrTrqCmdMRF -> DiagMgr10.MtrTrq
    connect CtrldDisShtdn.CntDisMtrTrqCmdMRF -> DiagMgr8.MtrTrq
    connect CtrldDisShtdn.CntDisMtrTrqCmdMRF -> DiagMgr9.MtrTrq
    connect CtrldDisShtdn.CntDisMtrTrqCmdMRF -> Gsod.Torque_Cmd_MRF
    connect CtrldDisShtdn.CntDisMtrTrqCmdMRF -> PwrLmtFuncCr.CntDisMtrTrqCmdMRF
    connect CtrldDisShtdn.CtrldDmpStsCmp -> ePWM2.CtrldDmpStsCmp
    connect CtrldDisShtdn.CtrldDmpStsCmp -> StaMd.ControlledDampStatusComplete
    connect CtrldDisShtdn.CtrldDmpStsCmp -> StaMd8.ControlledDampStatusComplete
    connect CtrldDisShtdn.SysC_CRFMtrTrqCmd -> Gsod.SysC_Torque_Cmd_CRF
    connect CtrldDisShtdn.SysC_MRFMtrTrqCmd -> Gsod.SysC_Torque_Cmd_MRF
    connect CtrlTemp.FiltMeasTemp -> CmMtrCurr.FiltCntrlTemp
    connect CtrlTemp.FiltMeasTemp -> DiagSvc.Temperature_DegC_f32
    connect CtrlTemp.FiltMeasTemp -> MtrTempEst.CtrlTempFinal
    connect CtrlTemp.FiltMeasTemp -> ThrmlDutyCycle.FiltMeasTemp
    connect CurrCmd.MtrCurrAngle -> CmMtrCurr.MtrCurrAngle
    connect CurrCmd.MtrCurrDaxRef -> CurrParamComp.MtrCurrDaxRef
    connect CurrCmd.MtrCurrDaxRef -> PeakCurrEst.MtrCurrDaxRef
    connect CurrCmd.MtrCurrDaxRef -> PICurrCntrl.MtrCurrDaxRef
    connect CurrCmd.MtrCurrDaxRef -> TrqCanc.MtrCurrDaxRef
    connect CurrCmd.MtrCurrQaxRef -> CurrParamComp.MtrCurrQaxRef
    connect CurrCmd.MtrCurrQaxRef -> PeakCurrEst.MtrCurrQaxRef
    connect CurrCmd.MtrCurrQaxRef -> TrqCanc.MtrCurrQaxRef
    connect CurrParamComp.EstKe -> CurrCmd.EstKe
    connect CurrParamComp.EstKe -> PICurrCntrl.EstKe
    connect CurrParamComp.EstKe -> PwrLmtFuncCr.EstKe
    connect CurrParamComp.EstKe -> TrqCanc.EstKe
    connect CurrParamComp.EstLd -> CurrCmd.EstLd
    connect CurrParamComp.EstLd -> TrqCanc.EstLd
    connect CurrParamComp.EstLq -> CurrCmd.EstLq
    connect CurrParamComp.EstLq -> TrqCanc.EstLq
    connect CurrParamComp.EstR -> CurrCmd.EstR
    connect CurrParamComp.EstR -> PICurrCntrl.EstR
    connect CurrParamComp.SCom_EOLNomMtrParam -> NtWrap.C_SCom_EOLNomMtrParam
    connect Damping.DampingCmd -> DampingFirewall.DampingCmd
    connect DampingFirewall.CombinedDamping -> AstLmt.CombinedDamping
    connect DemIf.DemIf -> DiagMgr9.DemIf
    connect DiagMgr10.DiagRampRate -> StOpCtrl.DiagRampRate
    connect DiagMgr10.DiagRampValue -> StOpCtrl.DiagRampValue
    connect DiagMgr10.DiagRmpToZeroActive -> StaMd.FTerm
    connect DiagMgr10.DiagRmpToZeroActive -> StaMd8.FTerm
    connect DiagMgr10.DiagRmpToZeroActive -> StOpCtrl.DiagStsDiagRmpActive
    connect DiagMgr10.DiagStsCtrldDisRmpPres -> CtrldDisShtdn.DiagStsF2Active
    connect DiagMgr10.DiagStsCtrldDisRmpPres -> ePWM2.DiagStsCtrldDisRmpPres
    connect DiagMgr10.DiagStsDefTemp -> CtrlTemp.DiagStsTempRdPrf
    connect DiagMgr10.DiagStsDefVehSpd -> SrlComInput.DefaultVehSpd
    connect DiagMgr10.DiagStsHWASbSystmFltPres -> AbsHwPos.DiagStatusHwPosReducedPerf
    connect DiagMgr10.DiagStsHWASbSystmFltPres -> LrnEOT.DiagStsHwPosDis
    connect DiagMgr10.DiagStsHWASbSystmFltPres -> Return.DiagStsHwPosDis
    connect DiagMgr10.DiagStsNonRecRmpToZeroFltPres -> ePWM2.DiagStsNonRecRmpToZeroFltPres
    connect DiagMgr10.NxtrDiagMgr10 -> AbsHwPos.NxtrDiagMgr
    connect DiagMgr10.NxtrDiagMgr10 -> AssistFirewall.NxtrDiagMgr
    connect DiagMgr10.NxtrDiagMgr10 -> BatteryVoltage.NxtrDiagMgr
    connect DiagMgr10.NxtrDiagMgr10 -> CmMtrCurr.NxtrDiagMgr
    connect DiagMgr10.NxtrDiagMgr10 -> DampingFirewall.NxtrDiagMgr
    connect DiagMgr10.NxtrDiagMgr10 -> DigHwTrqSENT.NxtrDiagMgr
    connect DiagMgr10.NxtrDiagMgr10 -> DigMSB.NxtrDiagMgr
    connect DiagMgr10.NxtrDiagMgr10 -> DigPhsReasDiag.NxtrDiagMgr
    connect DiagMgr10.NxtrDiagMgr10 -> Gsod.NxtrDiagMgr
    connect DiagMgr10.NxtrDiagMgr10 -> IoHwAbstractionUsr.NxtrDiagMgr
    connect DiagMgr10.NxtrDiagMgr10 -> MtrDrvDiag.NxtrDiagMgr
    connect DiagMgr10.NxtrDiagMgr10 -> MtrVel.NxtrDiagMgr
    connect DiagMgr10.NxtrDiagMgr10 -> Nhet1.NxtrDiagMgr
    connect DiagMgr10.NxtrDiagMgr10 -> OvrVoltMon.NxtrDiagMgr
    connect DiagMgr10.NxtrDiagMgr10 -> Polarity.NxtrDiagMgr
    connect DiagMgr10.NxtrDiagMgr10 -> PwrLmtFuncCr.NxtrDiagMgr
    connect DiagMgr10.NxtrDiagMgr10 -> ReturnFirewall.NxtrDiagMgr
    connect DiagMgr10.NxtrDiagMgr10 -> Sa_DigColPs.NxtrDiagMgr
    connect DiagMgr10.NxtrDiagMgr10 -> StabilityComp.NxtrDiagMgr
    connect DiagMgr10.NxtrDiagMgr10 -> StaMd.NxtrDiagMgr
    connect DiagMgr10.NxtrDiagMgr10 -> TmprlMon.NxtrDiagMgr
    connect DiagMgr10.NxtrDiagMgr10 -> TqRsDg.NxtrDiagMgr
    connect DiagMgr10.NxtrDiagMgr10 -> uDiag.NxtrDiagMgr
    connect DiagMgr10.NxtrDiagMgr10 -> VehDyn.NxtrDiagMgr
    connect DiagMgr8.NxtrDiagMgr8 -> MtrVel2.NxtrDiagMgr
    connect DiagMgr8.NxtrDiagMgr8 -> StaMd8.NxtrDiagMgr
    connect DiagMgr9.DiagMgr_StaCtrl -> StaMd9.DiagMgr_StaCtrl
    connect DiagMgr9.NxtrDiagMgr9 -> AvgFricLrn.NxtrDiagMgr
    connect DiagMgr9.NxtrDiagMgr9 -> BkCpPc.NxtrDiagMgr
    connect DiagMgr9.NxtrDiagMgr9 -> BVDiag.NxtrDiagMgr
    connect DiagMgr9.NxtrDiagMgr9 -> CtrlTemp.NxtrDiagMgr
    connect DiagMgr9.NxtrDiagMgr9 -> DiagSvc.NxtrDiagMgr
    connect DiagMgr9.NxtrDiagMgr9 -> LrnEOT.NxtrDiagMgr
    connect DiagMgr9.NxtrDiagMgr9 -> SrlComInput.NxtrDiagMgr
    connect DiagMgr9.NxtrDiagMgr9 -> SrlComOutput.NxtrDiagMgr
    connect DiagMgr9.NxtrDiagMgr9 -> ThrmlDutyCycle.NxtrDiagMgr
    connect DiagMgr9.NxtrDiagMgr9 -> VehPwrMd.NxtrDiagMgr
    connect DiagSvc.CityUserEnableDisable -> SrlComInput.CityUserEnableDisable
    connect DiagSvc.DesiredTunSet -> ApXcp.DesiredTunSet
    connect DiagSvc.DesiredTunSet -> TuningSelAuth.DesiredTunSet
    connect DiagSvc.DisableFailSafeReaction -> SrlComInput.DisableFailSafeReaction
    connect DiagSvc.IgnitionPreStart -> SrlComInput.IgnitionPreStart
    connect DiagSvc.ProxiValid -> SrlComOutput.ProxiValid
    connect DiagSvc.StartStopLogicEnable -> VehPwrMd.StartStopLogicEnable
    connect DigHwTrqSENT.DigHwTrqSENT_SCom -> NtWrap.C_DigHwTrqSENT_SCom
    connect DigHwTrqSENT.HwTorque -> Gsod.Ana_Hw_Torque
    connect DigHwTrqSENT.HwTorque -> Sweep.InputHwTrq
    connect DigHwTrqSENT.SrlComHwTrq -> SrlComOutput.SrlComHwTrq
    connect DigHwTrqSENT.SrlComHwTrqValid -> SrlComOutput.SrlComHwTrqValid
    connect DigHwTrqSENT.SysCHwTorque -> Gsod.SysC_Ana_Hw_Torque
    connect DigMSB.AlignedCumMechMtrPosCRF -> AbsHwPos.AlignedCumMechMtrPosCRF
    connect DigMSB.AlignedCumMechMtrPosStatus -> AbsHwPos.TurnsCntrValidity
    connect DigMSB.CumMechMtrPosCRF -> AbsHwPos.CumMechMtrPosCRF
    connect DigMSB.CumMechMtrPosMRF -> Gsod.Cum_Mtr_Pos_CRF
    connect DigMSB.CumMechMtrPosMRF -> MtrVel2.CumMechMtrPosMRF
    connect DigMSB.CumMechMtrPosMRF -> QuadDet.MRFCumMtrPos
    connect DigMSB.MechMtrPos2 -> MtrVel.MechMtrPos2
    connect DigMSB.SysCCumMechMtrPosMRF -> Gsod.SysC_Cum_Mtr_Pos_CRF
    connect ElePwr.SupplyCurrent -> SrlComOutput.SupplyCurrent
    connect EOTActuatorMng.AssistEOTDamping -> EtDmpFw.AssistEOTDamping
    connect EOTActuatorMng.AssistEOTGain -> LmtCod.AssistEOTGain
    connect EOTActuatorMng.AssistEOTLimit -> LmtCod.AssistEOTLimit
    connect EtDmpFw.EOTDampingLtd -> AstLmt.AssistEOTDamping
    connect FltInjection.FltInjection_SCom -> Assist.FltInjection_SCom
    connect FltInjection.FltInjection_SCom -> AvgFricLrn.FltInjection_SCom
    connect FltInjection.FltInjection_SCom -> BatteryVoltage.FltInjection_SCom
    connect FltInjection.FltInjection_SCom -> Damping.FltInjection_SCom
    connect FltInjection.FltInjection_SCom -> DigHwTrqSENT.FaultInjection_SCom
    connect FltInjection.FltInjection_SCom -> EtDmpFw.FaultInjection_SCom
    connect FltInjection.FltInjection_SCom -> FrqDepDmpnInrtCmp.FltInjection_SCom
    connect FltInjection.FltInjection_SCom -> HystComp.FltInjection_SCom
    connect FltInjection.FltInjection_SCom -> LmtCod.FltInjection_SCom
    connect FltInjection.FltInjection_SCom -> Return.FltInjection_SCom
    connect FltInjection.FltInjection_SCom -> SignlCondn.FaultInjection_SCom
    connect FltInjection.FltInjection_SCom -> StabilityComp.FaultInjection_SCom
    connect FrqDepDmpnInrtCmp.FrqDepDmpnInrtCmp -> DampingFirewall.InertiaComp
    connect HighFreqAssist.HighFreqAssist -> AssistFirewall.HighFreqAssist
    connect HiLoadStall.AssistStallLimit -> LmtCod.AssistStallLimit
    connect HwPwUp.MtrDrvrInitStart -> MtrDrvDiag.MtrDrvrInitStart
    connect HwPwUp.PwrDiscATestStart -> BkCpPc.PwrDiscATestStart
    connect HwPwUp.PwrDiscBTestStart -> BkCpPc.PwrDiscBTestStart
    connect HwPwUp.PwrDiscBTestStart -> OvrVoltMon.PwrDiscBTestStart
    connect HwPwUp.TMFTestStart -> TmprlMon.TMFTestStart
    connect HystComp.HysteresisComp -> AssistFirewall.HysteresisComp
    connect IoHwAbsDigSig.EpsEn -> SrlComInput.EpsEn
    connect IoHwAbsDigSig.EpsEn -> SrlComOutput.EpsEn
    connect IoHwAbsDigSig.EpsEn -> VehPwrMd.EpsEn
    connect IoHwAbsDigSig.FetDrvCntl -> TmprlMon.FetDrvCntl
    connect IoHwAbsDigSig.FetDrvReset -> MtrDrvDiag.FetDrvReset
    connect IoHwAbsDigSig.FetDrvReset -> ShtdnMech.FetDrvReset
    connect IoHwAbsDigSig.FetFlt1Data -> MtrDrvDiag.FetFlt1Data
    connect IoHwAbsDigSig.FetFlt2Clk -> MtrDrvDiag.FetFlt2Clk
    connect IoHwAbsDigSig.IoHwAbPortConfig -> MtrDrvDiag.IoHwAbPortConfig
    connect IoHwAbsDigSig.OvrVoltFdbk -> OvrVoltMon.phyOvrVoltFdbk
    connect IoHwAbsDigSig.PwrSwitchEn -> TmprlMon.PwrSwitchEn
    connect IoHwAbsDigSig.SysFault2 -> ShtdnMech.SysFault2
    connect IoHwAbsDigSig.SysFault2 -> TmprlMon.SysFault2
    connect IoHwAbsDigSig.SysFault3 -> ShtdnMech.SysFault3
    connect IoHwAbsDigSig.SysFault3 -> TmprlMon.SysFault3
    connect IoHwAbsDigSig.TODReset -> StaMd.TOD
    connect IoHwAbsDigSig.WdMonitor -> TmprlMon.WdMonitor
    connect IoHwAbsDigSig.WdMonitor -> TmprlMon2.WdMonitor
    connect IoHwAbsDigSig.WdReset -> TmprlMon.WdReset
    connect IoHwAbstractionUsr.Batt -> BatteryVoltage.Batt
    connect IoHwAbstractionUsr.Batt -> BkCpPc.Batt
    connect IoHwAbstractionUsr.Batt -> BVDiag.Batt
    connect IoHwAbstractionUsr.Batt -> SrlComInput.Batt
    connect IoHwAbstractionUsr.BattSwitched -> BatteryVoltage.BattSwitched
    connect IoHwAbstractionUsr.BattSwitched -> BkCpPc.BattSwitched
    connect IoHwAbstractionUsr.SysCVSwitch -> BatteryVoltage.SysCVSwitch
    connect IoHwAbstractionUsr.TemperatureADC -> CtrlTemp.TemperatureADC
    connect LmtCod.EOTGainLtd -> AstLmt.AssistEOTGain
    connect LmtCod.EOTLimitLtd -> AstLmt.AssistEOTLimit
    connect LmtCod.OutputRampMultLtd -> AstLmt.OutputRampMult
    connect LmtCod.OutputRampMultLtd -> EOTActuatorMng.OutputRampMultLtd
    connect LmtCod.StallLimitLtd -> AstLmt.AssistStallLimit
    connect LmtCod.ThermalLimitLtd -> AstLmt.ThermalLimit
    connect LmtCod.VehSpdLimitLtd -> AstLmt.AssistVehSpdLimit
    connect LrnEOT.CCWFound -> EOTActuatorMng.CcwFound
    connect LrnEOT.CCWPosition -> EOTActuatorMng.CcwEOT
    connect LrnEOT.CCWPosition -> VehDyn.CcwEOT
    connect LrnEOT.CCWPosition -> VehSpdLmt.CCWPosition
    connect LrnEOT.CWFound -> EOTActuatorMng.CwFound
    connect LrnEOT.CWPosition -> EOTActuatorMng.CwEOT
    connect LrnEOT.CWPosition -> VehDyn.CwEOT
    connect LrnEOT.CWPosition -> VehSpdLmt.CWPosition
    connect LrnEOT.LrnEOT_Scom -> DiagSvc.LrnEOT_Scom
    connect MtrDrvDiag.GateDriveResetActive -> DigPhsReasDiag.GateDriveResetActive
    connect MtrDrvDiag.MtrDrvrInitComplete -> HwPwUp.MtrDrvrInitComplete
    connect MtrTempEst.AssistMechTempEst -> AvgFricLrn.Temperature
    connect MtrTempEst.AssistMechTempEst -> Damping.AssistMechTempEst
    connect MtrTempEst.AssistMechTempEst -> HystComp.AssistMechTempEst
    connect MtrTempEst.AssistMechTempEst -> Return.AssistMechTempEst
    connect MtrTempEst.CuTempEst -> CurrParamComp.CuTempEst
    connect MtrTempEst.CuTempEst -> ThrmlDutyCycle.CuTempEst
    connect MtrTempEst.MagTempEst -> CurrParamComp.MagTempEst
    connect MtrTempEst.MagTempEst -> ThrmlDutyCycle.MagTempEst
    connect MtrTempEst.SiTempEst -> CurrParamComp.SiTempEst
    connect MtrTempEst.SiTempEst -> ThrmlDutyCycle.SiTempEst
    connect MtrVel.HandwheelVel -> ActivePull.HandwheelVelocity
    connect MtrVel.HandwheelVel -> AvgFricLrn.HwVel
    connect MtrVel.HandwheelVel -> MtrTempEst.HwVel
    connect MtrVel.HandwheelVel -> MtrVel2.HandwheelVel
    connect MtrVel.HandwheelVel -> Return.HandwheelVel
    connect MtrVel.MotorVelCRF -> CtrldDisShtdn.CRFMtrVel
    connect MtrVel.MotorVelCRF -> Damping.MotorVelCRF
    connect MtrVel.MotorVelCRF -> DampingFirewall.MtrVelCRF
    connect MtrVel.MotorVelCRF -> EOTActuatorMng.MotorVel
    connect MtrVel.MotorVelCRF -> EtDmpFw.CRFMtrVel
    connect MtrVel.MotorVelCRF -> FltInjection.MotorVelCRF
    connect MtrVel.MotorVelCRF -> FrqDepDmpnInrtCmp.CRFMotorVel
    connect MtrVel.MotorVelCRF -> HiLoadStall.MtrVelCRF
    connect MtrVel.MotorVelCRF -> LrnEOT.MtrVelCRF
    connect MtrVel.MotorVelCRF -> ThrmlDutyCycle.MotorVelCRF
    connect MtrVel.MotorVelCRF -> VehDyn.MotorVelCRF
    connect MtrVel.MotorVelMRF -> BkCpPc.MotorVelocityMRFUnfiltered
    connect MtrVel.MotorVelMRF -> CDDInterface.MRFMtrVel
    connect MtrVel.MotorVelMRF -> CmMtrCurr.MtrVel
    connect MtrVel.MotorVelMRF -> CurrCmd.MRFMtrVel
    connect MtrVel.MotorVelMRF -> DigPhsReasDiag.MotorVelMRFUnfiltered
    connect MtrVel.MotorVelMRF -> MtrVel2.MotorVelMRF
    connect MtrVel.MotorVelMRF -> PICurrCntrl.MRFMtrVel
    connect MtrVel.MotorVelMRF -> PwrLmtFuncCr.MotorVelMRF
    connect MtrVel.MotorVelMRF -> TrqCanc.MRFMtrVel
    connect MtrVel2.SysCDiagHwVel -> MtrVel.SysCDiagHwVel
    connect MtrVel2.SysCDiagMtrVelMRF -> MtrVel.SysCDiagMtrVelMRF
    connect Nhet1.DigHwTrqT1 -> DigHwTrqSENT.T1
    connect Nhet1.DigHwTrqT2 -> DigHwTrqSENT.T2
    connect NtWrap.AbsHwPos_SCom -> DiagSvc.AbsHwPos_SCom
    connect NtWrap.DigColPs_SCom -> DiagSvc.DigColPs_SCom
    connect NtWrap.VehDyn_SCom -> DiagSvc.VehDyn_SCom
    connect PeakCurrEst.EstPkCurr -> MtrTempEst.EstPkCurr
    connect PeakCurrEst.EstPkCurr -> ThrmlDutyCycle.MtrPkCurr
    connect PeakCurrEst.FiltEstPkCurr -> ThrmlDutyCycle.FilteredPkCurr
    connect PICurrCntrl.DervLambdaAlphaDiag -> TqRsDg.DervLambdaAlphaDiag
    connect PICurrCntrl.DervLambdaBetaDiag -> TqRsDg.DervLambdaBetaDiag
    connect Polarity.AssistAssyPolarity -> CtrldDisShtdn.AssistAssyPolarity
    connect Polarity.AssistAssyPolarity -> DigMSB.AssistAssemblyPolarity
    connect Polarity.AssistAssyPolarity -> MtrVel.AsstAssemblyPolarity
    connect Polarity.AssistAssyPolarity -> MtrVel2.AsstAssemblyPolarity
    connect Polarity.AssistAssyPolarity -> Polarity.DiagAssistAssyPolarity
    connect Polarity.HwPosPolarity -> Polarity.DiagHwPosPolarity
    connect Polarity.HwTrqPolarity -> Polarity.DiagHwTrqPolarity
    connect Polarity.MtrElecMechPolarity -> CDDInterface.MtrElecMechPolarity
    connect Polarity.MtrElecMechPolarity -> DigPhsReasDiag.MtrElecMechPolarity
    connect Polarity.MtrElecMechPolarity -> Gsod.MtrElecMech_Polarity
    connect Polarity.MtrElecMechPolarity -> Polarity.DiagMtrElecMechPolarity
    connect Polarity.MtrPosPolarity -> CDDInterface.MtrPosPolarity
    connect Polarity.MtrPosPolarity -> DigMSB.MtrPosPolarity
    connect Polarity.MtrPosPolarity -> Polarity.DiagMtrPosPolarity
    connect Polarity.MtrVelPolarity -> Polarity.DiagMtrVelPolarity
    connect Polarity.Polarity_SCom -> NtWrap.C_Polarity_SCom
    connect Polarity.SysC_MtrElecMechPolarity -> Gsod.SysC_MtrElecMech_Polarity
    connect PwrLmtFuncCr.FltTrqLmt -> AstLmt.PowerLimitPerc
    connect PwrLmtFuncCr.MRFMtrTrqCmd -> TrqCmdScl.MRFMtrTrqCmd
    connect QuadDet.MtrQuad -> CurrCmd.MtrQuad
    connect Return.ReturnCmd -> ReturnFirewall.ReturnCmd
    connect ReturnFirewall.LimitedReturn -> AstLmt.LimitedReturn
    connect Sa_DigColPs.DigColPs_SCom -> NtWrap.C_DigColPs_SCom
    connect Sa_DigColPs.I2CHwAbsPos -> AbsHwPos.I2CHwAbsPos
    connect Sa_DigColPs.I2CHwAbsPosValid -> AbsHwPos.I2CHwAbsPosValid
    connect SignlCondn.VehicleSpeed -> ActivePull.VehicleSpeed
    connect SignlCondn.VehicleSpeed -> Assist.VehSpd
    connect SignlCondn.VehicleSpeed -> AssistFirewall.VehicleSpeed
    connect SignlCondn.VehicleSpeed -> AstLmt.VehSpd
    connect SignlCondn.VehicleSpeed -> AvgFricLrn.VehSpd
    connect SignlCondn.VehicleSpeed -> CmMtrCurr.VehSpd
    connect SignlCondn.VehicleSpeed -> CurrCmd.VehSpd
    connect SignlCondn.VehicleSpeed -> Damping.VehicleSpeed
    connect SignlCondn.VehicleSpeed -> DampingFirewall.VehicleSpeed
    connect SignlCondn.VehicleSpeed -> DiagMgr10.VehSpd
    connect SignlCondn.VehicleSpeed -> DiagMgr8.VehSpd
    connect SignlCondn.VehicleSpeed -> DiagMgr9.VehSpd
    connect SignlCondn.VehicleSpeed -> DiagSvc.VehSpd
    connect SignlCondn.VehicleSpeed -> EOTActuatorMng.VehicleSpeed
    connect SignlCondn.VehicleSpeed -> EtDmpFw.Vehicle_Speed
    connect SignlCondn.VehicleSpeed -> FrqDepDmpnInrtCmp.VehicleSpeed
    connect SignlCondn.VehicleSpeed -> HighFreqAssist.VehicleSpeed
    connect SignlCondn.VehicleSpeed -> HystComp.VehicleSpeed
    connect SignlCondn.VehicleSpeed -> LmtCod.VehicleSpeed
    connect SignlCondn.VehicleSpeed -> Return.VehicleSpeed
    connect SignlCondn.VehicleSpeed -> ReturnFirewall.VehicleSpeed
    connect SignlCondn.VehicleSpeed -> StabilityComp.VehicleSpeed
    connect SignlCondn.VehicleSpeed -> StabilityComp2.VehicleSpeed
    connect SignlCondn.VehicleSpeed -> Sweep.VehSpd
    connect SignlCondn.VehicleSpeed -> TuningSelAuth.VehicleSpeed
    connect SignlCondn.VehicleSpeed -> VehDyn.VehicleSpeed
    connect SignlCondn.VehicleSpeed -> VehPwrMd.VehicleSpeed
    connect SignlCondn.VehicleSpeed -> VehSpdLmt.VehSpd
    connect SrlComInput.CityModeSts -> DiagSvc.CityModeSts
    connect SrlComInput.CmdIgnFailSts -> DiagSvc.CmdIgnFailSts
    connect SrlComInput.CmdIgnSts -> DiagSvc.CmdIgnSts
    connect SrlComInput.CmdIgnSts -> VehPwrMd.CmdIgnSts
    connect SrlComInput.DesiredTunPers -> TuningSelAuth.DesiredTunPers
    connect SrlComInput.EngStartStopSts -> VehPwrMd.EngStartStopSts
    connect SrlComInput.OperationalModeSts -> DiagSvc.OperationalModeSts
    connect SrlComInput.OperationalModeSts -> VehPwrMd.OperationalModeSts
    connect SrlComInput.OpModeStsCTCEnableCriteria -> DemIf.OpModeStsCTCEnableCriteria
    connect SrlComInput.SrlComVehSpd -> SignlCondn.SrlComVehSpeed
    connect SrlComInput.StartStopSts -> VehPwrMd.StartStopSts
    connect SrlComInput.TotalOdometerIPC -> DiagSvc.TotalOdometerIPC
    connect SrlComInput.VehicleSpeedValid -> ActivePull.VehicleSpeedValid
    connect SrlComInput.VehicleSpeedValid -> AvgFricLrn.VehicleSpeedValid
    connect SrlComInput.VehicleSpeedValid -> CmMtrCurr.VhSpdValid
    connect SrlComInput.VehicleSpeedValid -> DiagSvc.VehicleSpeedValid
    connect SrlComInput.VehicleSpeedValid -> Sweep.VehSpdValid
    connect SrlComInput.VehicleSpeedValid -> VehDyn.VehicleSpeedValid
    connect SrlComInput.VehicleSpeedValid -> VehPwrMd.VehicleSpeedValid
    connect SrlComOutput.ElectricStrFailSts -> DiagSvc.ElectricStrFailSts
    connect StabilityComp.AssistCmd -> AstLmt.AssistCmd
    connect StabilityComp.AssistCmd -> Damping.AssistCmd
    connect StabilityComp2.SysAssistCmd -> StabilityComp.SysAssistCmd_MtrNm
    connect StaMd.MilestoneRqst -> HwPwUp.MilestoneRqst
    connect StaMd.SystemState -> AssistFirewall.SystemState
    connect StaMd.SystemState -> BatteryVoltage.SystemState
    connect StaMd.SystemState -> CDDInterface.SystemState
    connect StaMd.SystemState -> CmMtrCurr.SystemState
    connect StaMd.SystemState -> CtrldDisShtdn.SystemState
    connect StaMd.SystemState -> DampingFirewall.SystemState
    connect StaMd.SystemState -> DiagMgr10.SystemState
    connect StaMd.SystemState -> DigPhsReasDiag.SystemState
    connect StaMd.SystemState -> ePWM2.SystemState
    connect StaMd.SystemState -> FrqDepDmpnInrtCmp.SystemState
    connect StaMd.SystemState -> Gsod.SystemState
    connect StaMd.SystemState -> HwPwUp.SystemState
    connect StaMd.SystemState -> MtrDrvDiag.SystemState
    connect StaMd.SystemState -> OvrVoltMon.SystemState
    connect StaMd.SystemState -> PeakCurrEst.SystemState
    connect StaMd.SystemState -> PICurrCntrl.SystemState
    connect StaMd.SystemState -> PwrLmtFuncCr.SystemState
    connect StaMd.SystemState -> ReturnFirewall.SystemState
    connect StaMd.SystemState -> RteErrata.SystemState
    connect StaMd.SystemState -> StaMd.CurrentSystemState
    connect StaMd.SystemState -> TmprlMon.SystemState
    connect StaMd.SystemState -> TqRsDg.SystemState
    connect StaMd.SystemState -> VehDyn.SystemState
    connect StaMd8.SystemState8 -> DiagMgr8.SystemState
    connect StaMd8.SystemState8 -> RteErrata8.SystemState
    connect StaMd9.StaMd_SCom -> DiagSvc.StaMd_SCom
    connect StaMd9.SystemState9 -> ActivePull.SystemState
    connect StaMd9.SystemState9 -> AvgFricLrn.SystemState
    connect StaMd9.SystemState9 -> BkCpPc.SystemState
    connect StaMd9.SystemState9 -> DiagMgr9.SystemState
    connect StaMd9.SystemState9 -> DiagSvc.SystemState
    connect StaMd9.SystemState9 -> RteErrata9.SystemState
    connect StaMd9.SystemState9 -> SrlComInput.SystemState
    connect StaMd9.SystemState9 -> SrlComOutput.SystemState
    connect StaMd9.SystemState9 -> VehPwrMd.SystemState
    connect StOpCtrl.OutputRampMult -> LmtCod.OutputRampMult
    connect StOpCtrl.OutputRampMult -> TqRsDg.OutputRampMult
    connect StOpCtrl.RampDwnStatusComplete -> ePWM2.RampDwnStatusComplete
    connect StOpCtrl.RampDwnStatusComplete -> StaMd.RampStatusComplete
    connect StOpCtrl.RampDwnStatusComplete -> StaMd8.RampStatusComplete
    connect Sweep.OutputHwTrq -> ActivePull.HwTorque
    connect Sweep.OutputHwTrq -> Assist.HwTrq
    connect Sweep.OutputHwTrq -> AssistFirewall.HwTorque
    connect Sweep.OutputHwTrq -> AvgFricLrn.HwTrq
    connect Sweep.OutputHwTrq -> Damping.HwTorque
    connect Sweep.OutputHwTrq -> DampingFirewall.HwTorque
    connect Sweep.OutputHwTrq -> DiagMgr10.HwTrq
    connect Sweep.OutputHwTrq -> DiagMgr8.HwTrq
    connect Sweep.OutputHwTrq -> DiagMgr9.HwTrq
    connect Sweep.OutputHwTrq -> DiagSvc.HwTrq
    connect Sweep.OutputHwTrq -> EOTActuatorMng.HwTorque
    connect Sweep.OutputHwTrq -> FrqDepDmpnInrtCmp.HwTorque
    connect Sweep.OutputHwTrq -> HighFreqAssist.HwTorque
    connect Sweep.OutputHwTrq -> HystComp.HwTorque
    connect Sweep.OutputHwTrq -> LrnEOT.HwTorque
    connect Sweep.OutputHwTrq -> Return.HwTorque
    connect Sweep.OutputHwTrq -> StabilityComp.HwTorque
    connect Sweep.OutputHwTrq -> StabilityComp2.HwTorque
    connect Sweep.OutputHwTrq -> TuningSelAuth.HwTorque
    connect Sweep.OutputHwTrq -> VehDyn.HwTorque
    connect Sweep2.OutputMtrTrq -> CtrldDisShtdn.SumLimTrqCmd
    connect ThrmlDutyCycle.DutyCycleLevel -> Assist.DutyCycleLevel
    connect ThrmlDutyCycle.ThermalLimit -> LmtCod.ThermalLimit
    connect ThrmlDutyCycle.ThermLimitPerc -> AstLmt.ThermalLimitPerc
    connect TmprlMon.TMFTestComplete -> HwPwUp.TMFTestComplete
    connect TmprlMon.TMFTestComplete -> StaMd.TMFTestComplete
    connect TmprlMon.TMFTestComplete -> StaMd8.TMFTestComplete
    connect TrqCanc.TrqCanc_Scom -> NtWrap.C_TrqCanc_Scom
    connect TrqCmdScl.MRFMtrTrqCmdScl -> CurrCmd.MRFTrqCmdScl
    connect TrqCmdScl.MRFMtrTrqCmdScl -> QuadDet.MRFMtrTrqCmdScl
    connect TrqCmdScl.MRFMtrTrqCmdScl -> TrqCanc.MtrTrqCmdMRFScl
    connect TrqCmdScl.TrqCmdScl_SCom -> NtWrap.C_TrqCmdScl_SCom
    connect TuningSelAuth.ActiveTunPers -> ApXcp.ActiveTunPers
    connect TuningSelAuth.ActiveTunSet -> ApXcp.ActiveTunSet
    connect VehDyn.SensorlessAuthority -> AbsHwPos.SensorlessAuthority
    connect VehDyn.SensorlessHwPos -> AbsHwPos.SensorlessHwPos
    connect VehDyn.VehDyn_SCom -> NtWrap.C_VehDyn_SCom
    connect VehPwrMd.ATermActive -> StaMd.ATerm
    connect VehPwrMd.ATermActive -> StaMd8.ATerm
    connect VehPwrMd.CTermActive -> StaMd.CTerm
    connect VehPwrMd.CTermActive -> StaMd8.CTerm
    connect VehPwrMd.OperRampRate -> StOpCtrl.OperRampRate
    connect VehPwrMd.OperRampValue -> StOpCtrl.OperRampValue
    connect VehPwrMd.PowerLatchTimeDID191D -> DiagSvc.PowerLatchTimeDID191D
    connect VehSpdLmt.AstVehSpdLimit -> LmtCod.AssistVehSpdLimit
package /VehicleProject
  system EPS: fibex-element=EPS
    mapping EPS_MPPNG
      sw-impl-mappings:
        87 x swc to impl mapping:
          D_EC5BCD55_5839_4343_B385_CBFD8DC85CA2_IMPL: component-implementation=Ap_AbsHwPos_Implementation, component=ECU_Composition.AbsHwPos
          D_642E4217_9CF0_4731_BF0C_ED582D5FA3A2_IMPL: component-implementation=Ap_ActivePull_Implementation, component=ECU_Composition.ActivePull
          D_1FC49CD3_E473_4DD0_89DA_13A2850E82B4_IMPL: component-implementation=Ap_ApXcp_Implementation, component=ECU_Composition.ApXcp
          D_B7BD3E35_94AD_4B0E_A58F_5F61E3C3072B_IMPL: component-implementation=Ap_Assist_Implementation, component=ECU_Composition.Assist
          D_85EA5B69_F722_4F96_915B_E9581E728D69_IMPL: component-implementation=Ap_AssistFirewall_Implementation, component=ECU_Composition.AssistFirewall
          D_BB205E77_0A65_43B7_BF8E_1081E453D9FC_IMPL: component-implementation=Ap_AstLmt_Implementation, component=ECU_Composition.AstLmt
          D_49D825DA_E7DA_47B0_A5AB_D7807D7D0496_IMPL: component-implementation=Ap_AvgFricLrn_Implementation, component=ECU_Composition.AvgFricLrn
          D_AEAC99F4_BFF9_43CF_90FB_64CC1ED8CCBE_IMPL: component-implementation=Ap_BatteryVoltage_Implementation, component=ECU_Composition.BatteryVoltage
          D_198F8F1B_B7AC_4AC3_A07F_BC6783A2E949_IMPL: component-implementation=Sa_BkCpPc_Implementation, component=ECU_Composition.BkCpPc
          D_94893CC7_3596_4479_A90F_6568CAC3276B_IMPL: component-implementation=Ap_BVDiag_Implementation, component=ECU_Composition.BVDiag
          D_47441384_62B0_479D_AC40_D2F4BDF96096_IMPL: component-implementation=Sa_CDDInterface_Implementation, component=ECU_Composition.CDDInterface
          D_605EB91C_A0AA_4E4F_AEBB_1CC33C84A3D6_IMPL: component-implementation=Ap_ChkPtAp10_Implementation, component=ECU_Composition.ChkPtAp10
          D_1502FCA5_07EA_4D67_B2DE_16529A617117_IMPL: component-implementation=Ap_ChkPtAp8_Implementation, component=ECU_Composition.ChkPtAp8
          D_26CB7CC7_EE9B_4D8B_A0F3_2D75568AA997_IMPL: component-implementation=Ap_ChkPtAp9_Implementation, component=ECU_Composition.ChkPtAp9
          D_41DCF888_3081_45F2_8E2F_B97590FC2CF1_IMPL: component-implementation=Sa_CmMtrCurr_Implementation, component=ECU_Composition.CmMtrCurr
          D_AE0D2034_AA2A_4770_A36A_54E9F58E2DE3_IMPL: component-implementation=Ap_ComplErr_Implementation, component=ECU_Composition.ComplErr
          D_647DAB00_D3C5_4B4B_BF9C_A846A9E67697_IMPL: component-implementation=Ap_CtrldDisShtdn_Implementation, component=ECU_Composition.CtrldDisShtdn
          D_9B375D17_0652_4C73_80C1_992513D476D9_IMPL: component-implementation=Sa_CtrlTemp_Implementation, component=ECU_Composition.CtrlTemp
          D_2D263756_FA80_4337_AAD4_B5777AAC387F_IMPL: component-implementation=Ap_CurrCmd_Implementation, component=ECU_Composition.CurrCmd
          D_C842DD71_1114_43E6_B8B2_6BFC16E72DE3_IMPL: component-implementation=Ap_CurrParamComp_Implementation, component=ECU_Composition.CurrParamComp
          D_249FB7D4_0940_4DC1_B8F8_16D93FFABD16_IMPL: component-implementation=Ap_Damping_Implementation, component=ECU_Composition.Damping
          D_8DEC6B24_200A_4913_A9B0_EFB24AD487E2_IMPL: component-implementation=Ap_DampingFirewall_Implementation, component=ECU_Composition.DampingFirewall
          D_B829653C_11B3_4820_B9E4_9844B0421B79_IMPL: component-implementation=Ap_DemIf_Implementation, component=ECU_Composition.DemIf
          D_22F4D95B_09A8_402D_A429_1C10073EBB5E_IMPL: component-implementation=Ap_DiagMgr10_Implementation, component=ECU_Composition.DiagMgr10
          D_2188AB88_BBDB_494F_A957_5EAB154D18A1_IMPL: component-implementation=Ap_DiagMgr8_Implementation, component=ECU_Composition.DiagMgr8
          D_0F001674_F301_4471_873F_DEDB14B183E1_IMPL: component-implementation=Ap_DiagMgr9_Implementation, component=ECU_Composition.DiagMgr9
          D_7EC30965_7F3E_4C1C_9AA8_DCDB8E39F45D_IMPL: component-implementation=Ap_DiagSvc_Implementation, component=ECU_Composition.DiagSvc
          D_215BFEC5_FCA3_480A_96A0_2F9CD8EF22DC_IMPL: component-implementation=Sa_DigHwTrqSENT_Implementation, component=ECU_Composition.DigHwTrqSENT
          D_EEFEB775_58B1_4C23_8F9F_70D339E0DA82_IMPL: component-implementation=Sa_DigMSB_Implementation, component=ECU_Composition.DigMSB
          D_BBC48BDB_B140_492D_97AD_63B242B3B212_IMPL: component-implementation=Ap_DigPhsReasDiag_Implementation, component=ECU_Composition.DigPhsReasDiag
          D_7B3438E5_1B58_4F3F_AFBC_973AA0E46F95_IMPL: component-implementation=Ap_ElePwr_Implementation, component=ECU_Composition.ElePwr
          D_2B31DF15_1515_4C79_96B1_952B84AC8D31_IMPL: component-implementation=Ap_EOTActuatorMng_Implementation, component=ECU_Composition.EOTActuatorMng
          D_501CE02D_0F30_4598_8268_4F94299DF00C_IMPL: component-implementation=Ap_ePWM2_Implementation, component=ECU_Composition.ePWM2
          D_71C7D7C4_904E_43D8_A2BF_00224B382EDA_IMPL: component-implementation=Ap_EtDmpFw_Implementation, component=ECU_Composition.EtDmpFw
          D_82F19303_8B3F_4B4A_ABB7_043FF69555C1_IMPL: component-implementation=Ap_FltInjection_Implementation, component=ECU_Composition.FltInjection
          D_9C5E7319_48B9_44E8_B42F_371D7389ED20_IMPL: component-implementation=Ap_FrqDepDmpnInrtCmp_Implementation, component=ECU_Composition.FrqDepDmpnInrtCmp
          D_570C958A_D5BA_45A9_AF27_2F365B50F086_IMPL: component-implementation=Ap_Gsod_Implementation, component=ECU_Composition.Gsod
          D_6379ED31_0467_445E_A959_659A7934FE8A_IMPL: component-implementation=Ap_HighFreqAssist_Implementation, component=ECU_Composition.HighFreqAssist
          D_12BDE42A_7A19_40A1_8F13_4C004D908C78_IMPL: component-implementation=Ap_HiLoadStall_Implementation, component=ECU_Composition.HiLoadStall
          D_24612320_BFC5_4531_9FBA_F0C65901D8C4_IMPL: component-implementation=Ap_HwPwUp_Implementation, component=ECU_Composition.HwPwUp
          D_C874B5F5_AA93_4653_B754_51BBFA3BED92_IMPL: component-implementation=Ap_HystComp_Implementation, component=ECU_Composition.HystComp
          D_A18AD9BD_E32E_4C52_B48B_40A6D2CE2658_IMPL: component-implementation=IoHwAbstraction_Implementation, component=ECU_Composition.IoHwAbsDigSig
          D_89643BA3_4DAF_4277_B4DF_1E32D3B832B0_IMPL: component-implementation=IoHwAbstractionUsr_Implementation, component=ECU_Composition.IoHwAbstractionUsr
          D_86C09783_45D3_494C_86B4_2A6FE92339BF_IMPL: component-implementation=Ap_LmtCod_Implementation, component=ECU_Composition.LmtCod
          D_3EB24370_07B5_4CBC_AF80_392ED0F9996C_IMPL: component-implementation=Ap_LrnEOT_Implementation, component=ECU_Composition.LrnEOT
          D_A31E24F3_F536_4CFF_A052_8E11A67FA949_IMPL: component-implementation=Sa_MtrDrvDiag_Implementation, component=ECU_Composition.MtrDrvDiag
          D_80088C2D_DF13_4443_844C_678102124731_IMPL: component-implementation=Ap_MtrTempEst_Implementation, component=ECU_Composition.MtrTempEst
          D_39C4DEB4_218B_412D_9E7C_69D10056D9AD_IMPL: component-implementation=Sa_MtrVel_Implementation, component=ECU_Composition.MtrVel
          D_293548E7_39A9_43B8_AB54_12D2C1919475_IMPL: component-implementation=Sa_MtrVel2_Implementation, component=ECU_Composition.MtrVel2
          D_F9C17DF2_5D83_4D9A_9013_80D12E216438_IMPL: component-implementation=Sa_MtrVel3_Implementation, component=ECU_Composition.MtrVel3
          D_D127E3CD_C662_46B9_AF18_3FAF36F0E575_IMPL: component-implementation=Cd_Nhet1_Implementation, component=ECU_Composition.Nhet1
          D_E7DD6F3B_ED91_44CA_86FD_6AD7D696153B_IMPL: component-implementation=NtWrap_Implementation, component=ECU_Composition.NtWrap
          D_6CAE87E7_AAB4_4526_B235_CDFE0198FBA2_IMPL: component-implementation=Sa_OvrVoltMon_Implementation, component=ECU_Composition.OvrVoltMon
          D_5866CE00_9A8A_4F01_B68F_98AF6F4950EA_IMPL: component-implementation=Ap_PeakCurrEst_Implementation, component=ECU_Composition.PeakCurrEst
          D_76A42325_B2AE_44D3_AC30_0AE6B828E792_IMPL: component-implementation=Ap_PICurrCntrl_Implementation, component=ECU_Composition.PICurrCntrl
          D_10305BD6_795A_4ADC_A6BD_1C0384B9FCE6_IMPL: component-implementation=Ap_Polarity_Implementation, component=ECU_Composition.Polarity
          D_EC75AD08_A890_4046_A3FC_B7FBD2654942_IMPL: component-implementation=Ap_PwrLmtFuncCr_Implementation, component=ECU_Composition.PwrLmtFuncCr
          D_37F8A9C6_78E1_4D73_80B5_CDF8C7AFF810_IMPL: component-implementation=Ap_QuadDet_Implementation, component=ECU_Composition.QuadDet
          D_9F9E1025_3734_4D87_AB55_120CA036919C_IMPL: component-implementation=Ap_Return_Implementation, component=ECU_Composition.Return
          D_4707A28E_3A37_4901_8EA6_D29138955CD0_IMPL: component-implementation=Ap_ReturnFirewall_Implementation, component=ECU_Composition.ReturnFirewall
          D_DFD34AB5_347B_419A_B745_0DC00689C337_IMPL: component-implementation=RteErrata10_Implementation, component=ECU_Composition.RteErrata
          D_60005E61_1531_4100_8783_CC5590DFA5F7_IMPL: component-implementation=RteErrata8_Implementation, component=ECU_Composition.RteErrata8
          D_3C33E0CD_6BFE_4045_9308_0883535C5BDE_IMPL: component-implementation=RteErrata9_Implementation, component=ECU_Composition.RteErrata9
          D_FFA91D01_DBC8_4F40_BC93_3D332A91A542_IMPL: component-implementation=Sa_DigColPs_Implementation, component=ECU_Composition.Sa_DigColPs
          D_2C355A93_D742_4296_A699_C37FB01B4923_IMPL: component-implementation=Sa_ShtdnMech_Implementation, component=ECU_Composition.ShtdnMech
          D_9E89FA7F_CB8F_4738_A75A_E7353D05D583_IMPL: component-implementation=Ap_SignlCondn_Implementation, component=ECU_Composition.SignlCondn
          D_71598B15_D9BB_45D7_B51B_95FA7F11DEE7_IMPL: component-implementation=Ap_SrlComInput_Implementation, component=ECU_Composition.SrlComInput
          D_3F4CF8F8_C0D4_4EA6_8AC6_3BBAF6C17B86_IMPL: component-implementation=Ap_SrlComOutput_Implementation, component=ECU_Composition.SrlComOutput
          D_F70AF12B_570D_4BD6_94C4_41928C9A5521_IMPL: component-implementation=Ap_StabilityComp_Implementation, component=ECU_Composition.StabilityComp
          D_D26F4C29_0429_4F6A_B528_1CE0EF84CC10_IMPL: component-implementation=Ap_StabilityComp2_Implementation, component=ECU_Composition.StabilityComp2
          D_3813B022_BEF0_4860_9ACA_C012DB74C65D_IMPL: component-implementation=Ap_StaMd_Implementation, component=ECU_Composition.StaMd
          D_FD48B27A_1DEF_4B7C_B1C1_0EB4B6845955_IMPL: component-implementation=Ap_StaMd8_Implementation, component=ECU_Composition.StaMd8
          D_64A861F0_61F4_4AAC_983B_3A1DE8F322B0_IMPL: component-implementation=Ap_StaMd9_Implementation, component=ECU_Composition.StaMd9
          D_62A2D82B_0283_4399_86A2_52B411D50823_IMPL: component-implementation=Ap_StOpCtrl_Implementation, component=ECU_Composition.StOpCtrl
          D_7E4B5709_9B7D_4FD6_B056_6AB48B16B6AA_IMPL: component-implementation=Ap_Sweep_Implementation, component=ECU_Composition.Sweep
          D_A0C1D405_7D63_4AD7_9415_7DDBEB0A6E23_IMPL: component-implementation=Ap_Sweep2_Implementation, component=ECU_Composition.Sweep2
          D_0EDB7A07_512A_4694_AC58_D7E3DE3A2169_IMPL: component-implementation=Ap_ThrmlDutyCycle_Implementation, component=ECU_Composition.ThrmlDutyCycle
          D_A1361BE3_E6DC_4BEA_A9A3_652C73603031_IMPL: component-implementation=Sa_TmprlMon_Implementation, component=ECU_Composition.TmprlMon
          D_FB34DEDB_DDFB_4FDE_8A7F_267052ADF4D9_IMPL: component-implementation=Sa_TmprlMon2_Implementation, component=ECU_Composition.TmprlMon2
          D_F5551515_F075_4A1B_8681_F45A04A357D5_IMPL: component-implementation=Ap_TqRsDg_Implementation, component=ECU_Composition.TqRsDg
          D_E6843C99_C0E5_4209_954C_CF84D0DCB9B1_IMPL: component-implementation=Ap_TrqCanc_Implementation, component=ECU_Composition.TrqCanc
          D_3E10F2A9_A533_4753_BEC6_F04E3FBCF692_IMPL: component-implementation=Ap_TrqCmdScl_Implementation, component=ECU_Composition.TrqCmdScl
          D_12898697_8FCE_4F46_87DF_E5AAD3D89841_IMPL: component-implementation=Ap_TuningSelAuth_Implementation, component=ECU_Composition.TuningSelAuth
          D_9361E416_1ECA_4DAC_B3F5_2ED81DBE08BA_IMPL: component-implementation=Cd_uDiag_Implementation, component=ECU_Composition.uDiag
          D_D263F0DF_ECB6_41B5_96ED_5A3F524B5D37_IMPL: component-implementation=Ap_VehDyn_Implementation, component=ECU_Composition.VehDyn
          D_651C15AD_6516_4695_84A0_840EFDBD96C8_IMPL: component-implementation=Ap_VehPwrMd_Implementation, component=ECU_Composition.VehPwrMd
          D_F40AD1BC_7790_427D_ACC4_4698CAE44A21_IMPL: component-implementation=Ap_VehSpdLmt_Implementation, component=ECU_Composition.VehSpdLmt
      sw-mappings:
        87 x swc to ecu mapping, all with ecu-instance=EPS:
          D_EC5BCD55_5839_4343_B385_CBFD8DC85CA2_: component=ECU_Composition.AbsHwPos
          D_642E4217_9CF0_4731_BF0C_ED582D5FA3A2_: component=ECU_Composition.ActivePull
          D_1FC49CD3_E473_4DD0_89DA_13A2850E82B4_: component=ECU_Composition.ApXcp
          D_B7BD3E35_94AD_4B0E_A58F_5F61E3C3072B_: component=ECU_Composition.Assist
          D_85EA5B69_F722_4F96_915B_E9581E728D69_: component=ECU_Composition.AssistFirewall
          D_BB205E77_0A65_43B7_BF8E_1081E453D9FC_: component=ECU_Composition.AstLmt
          D_49D825DA_E7DA_47B0_A5AB_D7807D7D0496_: component=ECU_Composition.AvgFricLrn
          D_AEAC99F4_BFF9_43CF_90FB_64CC1ED8CCBE_: component=ECU_Composition.BatteryVoltage
          D_198F8F1B_B7AC_4AC3_A07F_BC6783A2E949_: component=ECU_Composition.BkCpPc
          D_94893CC7_3596_4479_A90F_6568CAC3276B_: component=ECU_Composition.BVDiag
          D_47441384_62B0_479D_AC40_D2F4BDF96096_: component=ECU_Composition.CDDInterface
          D_605EB91C_A0AA_4E4F_AEBB_1CC33C84A3D6_: component=ECU_Composition.ChkPtAp10
          D_1502FCA5_07EA_4D67_B2DE_16529A617117_: component=ECU_Composition.ChkPtAp8
          D_26CB7CC7_EE9B_4D8B_A0F3_2D75568AA997_: component=ECU_Composition.ChkPtAp9
          D_41DCF888_3081_45F2_8E2F_B97590FC2CF1_: component=ECU_Composition.CmMtrCurr
          D_AE0D2034_AA2A_4770_A36A_54E9F58E2DE3_: component=ECU_Composition.ComplErr
          D_647DAB00_D3C5_4B4B_BF9C_A846A9E67697_: component=ECU_Composition.CtrldDisShtdn
          D_9B375D17_0652_4C73_80C1_992513D476D9_: component=ECU_Composition.CtrlTemp
          D_2D263756_FA80_4337_AAD4_B5777AAC387F_: component=ECU_Composition.CurrCmd
          D_C842DD71_1114_43E6_B8B2_6BFC16E72DE3_: component=ECU_Composition.CurrParamComp
          D_249FB7D4_0940_4DC1_B8F8_16D93FFABD16_: component=ECU_Composition.Damping
          D_8DEC6B24_200A_4913_A9B0_EFB24AD487E2_: component=ECU_Composition.DampingFirewall
          D_B829653C_11B3_4820_B9E4_9844B0421B79_: component=ECU_Composition.DemIf
          D_22F4D95B_09A8_402D_A429_1C10073EBB5E_: component=ECU_Composition.DiagMgr10
          D_2188AB88_BBDB_494F_A957_5EAB154D18A1_: component=ECU_Composition.DiagMgr8
          D_0F001674_F301_4471_873F_DEDB14B183E1_: component=ECU_Composition.DiagMgr9
          D_7EC30965_7F3E_4C1C_9AA8_DCDB8E39F45D_: component=ECU_Composition.DiagSvc
          D_215BFEC5_FCA3_480A_96A0_2F9CD8EF22DC_: component=ECU_Composition.DigHwTrqSENT
          D_EEFEB775_58B1_4C23_8F9F_70D339E0DA82_: component=ECU_Composition.DigMSB
          D_BBC48BDB_B140_492D_97AD_63B242B3B212_: component=ECU_Composition.DigPhsReasDiag
          D_7B3438E5_1B58_4F3F_AFBC_973AA0E46F95_: component=ECU_Composition.ElePwr
          D_2B31DF15_1515_4C79_96B1_952B84AC8D31_: component=ECU_Composition.EOTActuatorMng
          D_501CE02D_0F30_4598_8268_4F94299DF00C_: component=ECU_Composition.ePWM2
          D_71C7D7C4_904E_43D8_A2BF_00224B382EDA_: component=ECU_Composition.EtDmpFw
          D_82F19303_8B3F_4B4A_ABB7_043FF69555C1_: component=ECU_Composition.FltInjection
          D_9C5E7319_48B9_44E8_B42F_371D7389ED20_: component=ECU_Composition.FrqDepDmpnInrtCmp
          D_570C958A_D5BA_45A9_AF27_2F365B50F086_: component=ECU_Composition.Gsod
          D_6379ED31_0467_445E_A959_659A7934FE8A_: component=ECU_Composition.HighFreqAssist
          D_12BDE42A_7A19_40A1_8F13_4C004D908C78_: component=ECU_Composition.HiLoadStall
          D_24612320_BFC5_4531_9FBA_F0C65901D8C4_: component=ECU_Composition.HwPwUp
          D_C874B5F5_AA93_4653_B754_51BBFA3BED92_: component=ECU_Composition.HystComp
          D_A18AD9BD_E32E_4C52_B48B_40A6D2CE2658_: component=ECU_Composition.IoHwAbsDigSig
          D_89643BA3_4DAF_4277_B4DF_1E32D3B832B0_: component=ECU_Composition.IoHwAbstractionUsr
          D_86C09783_45D3_494C_86B4_2A6FE92339BF_: component=ECU_Composition.LmtCod
          D_3EB24370_07B5_4CBC_AF80_392ED0F9996C_: component=ECU_Composition.LrnEOT
          D_A31E24F3_F536_4CFF_A052_8E11A67FA949_: component=ECU_Composition.MtrDrvDiag
          D_80088C2D_DF13_4443_844C_678102124731_: component=ECU_Composition.MtrTempEst
          D_39C4DEB4_218B_412D_9E7C_69D10056D9AD_: component=ECU_Composition.MtrVel
          D_293548E7_39A9_43B8_AB54_12D2C1919475_: component=ECU_Composition.MtrVel2
          D_F9C17DF2_5D83_4D9A_9013_80D12E216438_: component=ECU_Composition.MtrVel3
          D_D127E3CD_C662_46B9_AF18_3FAF36F0E575_: component=ECU_Composition.Nhet1
          D_E7DD6F3B_ED91_44CA_86FD_6AD7D696153B_: component=ECU_Composition.NtWrap
          D_6CAE87E7_AAB4_4526_B235_CDFE0198FBA2_: component=ECU_Composition.OvrVoltMon
          D_5866CE00_9A8A_4F01_B68F_98AF6F4950EA_: component=ECU_Composition.PeakCurrEst
          D_76A42325_B2AE_44D3_AC30_0AE6B828E792_: component=ECU_Composition.PICurrCntrl
          D_10305BD6_795A_4ADC_A6BD_1C0384B9FCE6_: component=ECU_Composition.Polarity
          D_EC75AD08_A890_4046_A3FC_B7FBD2654942_: component=ECU_Composition.PwrLmtFuncCr
          D_37F8A9C6_78E1_4D73_80B5_CDF8C7AFF810_: component=ECU_Composition.QuadDet
          D_9F9E1025_3734_4D87_AB55_120CA036919C_: component=ECU_Composition.Return
          D_4707A28E_3A37_4901_8EA6_D29138955CD0_: component=ECU_Composition.ReturnFirewall
          D_DFD34AB5_347B_419A_B745_0DC00689C337_: component=ECU_Composition.RteErrata
          D_60005E61_1531_4100_8783_CC5590DFA5F7_: component=ECU_Composition.RteErrata8
          D_3C33E0CD_6BFE_4045_9308_0883535C5BDE_: component=ECU_Composition.RteErrata9
          D_FFA91D01_DBC8_4F40_BC93_3D332A91A542_: component=ECU_Composition.Sa_DigColPs
          D_2C355A93_D742_4296_A699_C37FB01B4923_: component=ECU_Composition.ShtdnMech
          D_9E89FA7F_CB8F_4738_A75A_E7353D05D583_: component=ECU_Composition.SignlCondn
          D_71598B15_D9BB_45D7_B51B_95FA7F11DEE7_: component=ECU_Composition.SrlComInput
          D_3F4CF8F8_C0D4_4EA6_8AC6_3BBAF6C17B86_: component=ECU_Composition.SrlComOutput
          D_F70AF12B_570D_4BD6_94C4_41928C9A5521_: component=ECU_Composition.StabilityComp
          D_D26F4C29_0429_4F6A_B528_1CE0EF84CC10_: component=ECU_Composition.StabilityComp2
          D_3813B022_BEF0_4860_9ACA_C012DB74C65D_: component=ECU_Composition.StaMd
          D_FD48B27A_1DEF_4B7C_B1C1_0EB4B6845955_: component=ECU_Composition.StaMd8
          D_64A861F0_61F4_4AAC_983B_3A1DE8F322B0_: component=ECU_Composition.StaMd9
          D_62A2D82B_0283_4399_86A2_52B411D50823_: component=ECU_Composition.StOpCtrl
          D_7E4B5709_9B7D_4FD6_B056_6AB48B16B6AA_: component=ECU_Composition.Sweep
          D_A0C1D405_7D63_4AD7_9415_7DDBEB0A6E23_: component=ECU_Composition.Sweep2
          D_0EDB7A07_512A_4694_AC58_D7E3DE3A2169_: component=ECU_Composition.ThrmlDutyCycle
          D_A1361BE3_E6DC_4BEA_A9A3_652C73603031_: component=ECU_Composition.TmprlMon
          D_FB34DEDB_DDFB_4FDE_8A7F_267052ADF4D9_: component=ECU_Composition.TmprlMon2
          D_F5551515_F075_4A1B_8681_F45A04A357D5_: component=ECU_Composition.TqRsDg
          D_E6843C99_C0E5_4209_954C_CF84D0DCB9B1_: component=ECU_Composition.TrqCanc
          D_3E10F2A9_A533_4753_BEC6_F04E3FBCF692_: component=ECU_Composition.TrqCmdScl
          D_12898697_8FCE_4F46_87DF_E5AAD3D89841_: component=ECU_Composition.TuningSelAuth
          D_9361E416_1ECA_4DAC_B3F5_2ED81DBE08BA_: component=ECU_Composition.uDiag
          D_D263F0DF_ECB6_41B5_96ED_5A3F524B5D37_: component=ECU_Composition.VehDyn
          D_651C15AD_6516_4695_84A0_840EFDBD96C8_: component=ECU_Composition.VehPwrMd
          D_F40AD1BC_7790_427D_ACC4_4698CAE44A21_: component=ECU_Composition.VehSpdLmt
    software composition ECU_Composition: software-composition=ECU_Composition
