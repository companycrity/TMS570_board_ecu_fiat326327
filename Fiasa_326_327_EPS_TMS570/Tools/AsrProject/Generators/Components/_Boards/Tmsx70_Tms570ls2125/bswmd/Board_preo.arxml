AUTOSAR XML (schema 3.0.1)
package /MICROSAR
  module config Board_Pre: definition=Board
    BoardGeneral: BoardUseExtendedAsrVersionCheck=false, BoardSizeOfIdType=Four_Byte, BoardPCAndLTCRCCheck=false
    InterruptFunctionality: BoardUseSchm=true
  module config Board_Rec: definition=Board
    BoardGeneral: BoardOsType=Autosar
