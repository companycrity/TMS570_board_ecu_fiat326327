AUTOSAR XML (schema 3.0.1)
package /MICROSAR
  bsw implementation FiM_Impl: code-generator=GENy, programming-language=C, sw-major-version=3, sw-minor-version=1, sw-patch-version=0, vendor-id=30, ar-major-version=3, ar-minor-version=0, ar-patch-version=1, preconfigured-configuration=Fim_Pre, recommended-configuration=Fim_Rec, vendor-specific-module-def=Fim
  module definition Fim [0..1]: refined-module-def=Fim, variants pre-compile/link-time  # Configuration of the Fim (Function Inhibition Manager) module.
    container FimEventSummary [0..*]  # NOT USED by Vecor Fim The summarized EventId definition record consists of a summarized event ID and a specific EventId. This record means that a particular FID that has to be disabled in case of summarized event (defined above) is to be disabled in any of the specific events. A possible solution could be assigning events as summarized events along with a list of specific events. During the configuration process the summarized event substitutes the referenced single events. However, it is not outlined how this requirement is solved - whether by configuration process or by implementation within the FIM. The FIM configuration tool could also build up a suitable data structure for summarized events and deal with it in the FIM implementation.
      symbolic name reference FimInputSumEventRef: set at pre-compile, destination=DemEventParameter  # NOT USED by Vecor Fim
      symbolic name reference FimOutputSumEventRef: set at pre-compile, destination=FimSummaryEventId  # NOT USED by Vecor Fim
    container FimFid [0..*]  # This container defines the symbolic name of a FimFunctionId.
      integer FimFuntionId: 0..65535, set at pre-compile, symbolic-name-value=true  # The configuration parameter is used as an ID which represents a functionality. FimFuntionId is the unique identifier assigned during Fim configuration. Implementation Type: Fim_FunctionIdType.
    container FimGeneral
      boolean FimCyclicEventEvaluation: set at pre-compile, default-value=false  # This configuration parameter specifies whether the evaluation of Dem events is performed by the Fim cyclically or the Dem informs Fim about changes of event states. true: Fim cyclically evaluates event states in the Dem. false: Dem informs Fim about changes of event states. RESTRICTIONS: This parameter must always be FALSE for Vector Fim.
      boolean FimDataFixed: set at pre-compile, default-value=true  # Enable or disable calibration of inhibit relations The scope of the parameter is to meet the requirement (FIM008) to have the option to calibrate inhibit data on the one hand side and also to provide the option to protect inhibit data for consistency reasons. RESTRICTIONS: This parameter must always be TRUE for Vector Fim.
      boolean FimDevErrorDetect: set at pre-compile  # Enable or disable the "Development Error Detection" functionality. If 'Development Error Detection' is enabled, development errors are reported to the Development Error Tracer (DET). The following development errors may occur within the FIM: - FIM_E_WRONG_PERMISSION_REQ occurs if API Fim_GetPermissionStatus was called before complete initialization of Fim - FIM_E_FID_OUT_OF_RANGE occurs if API Fim_GetPermissionStatus was called with wrong Fid - FIM_E_DEM_GETEVENTSTATUS_WRONG_RETURN_VALUE occurs if Dem API Dem_GetEventStatus returns not E_OK All development errors are reported to the Development Error Tracer. Note: In general, the development error detection is recommended during pre-test phase. It is not recommended to enable the development error detection in production code due to increased runtime and ROM needs.
      integer FimMaxEventFidLinks: 1..65535, set at pre-compile  # This configuration parameter specifies the total maximum number of links between EventIds and Fids.
      integer FimMaxEventsPerFid: 1..65535, set at pre-compile  # This configuration parameter specifies the maximum number of EventIds that can be linked to a single Fid.
      integer FimMaxFidsPerEvent: 1..65535, set at pre-compile  # This configuration parameter specifies the maximum number of Fids that can be linked to a single event.
      integer FimMaxSummaryEvents: 0..65535, set at published-information  # NOT USED by Vector Fim because summarized events are not supported This configuration parameter specifies the maximum number of summarized events that can be configured.
      integer FimMaxSummaryLinks: 0..65535, set at published-information  # NOT USED by Vector Fim because summarized events are not supported This configuration parameter specifies the total maximum number of links between EventIds and summarized events.
      integer FimMaxTotalLinks: 1..65535, set at pre-compile  # NOT USED by Vecor Fim This configuration parameter specifies the total maximum number of links between EventIds and Fids plus the number of links between EventIds and summarized events.
      boolean FimVersionInfoApi: set at pre-compile  # En-/ disable the function Fim_GetVersionInfo() to get the major, minor and patch version information.
      boolean FimSupportRTE: set at pre-compile, origin=Vector Informatik, default-value=false  # If this option is enabled, a port interface description (Software Component Template) is generated which can be used for the Rte configuration.
      string FimSoftwareComponentName: set at pre-compile in variant pre-compile / link in variant link-time, origin=Vector Informatik, default-value=Fim  # This name is used as component name (ShortName) in the generated software component template. Change this name if you try to import the Fim components of several ECUs and have problems with name clashes.
      string FimUserConfigFile: set at pre-compile, origin=Vector Informatik  # This option specifies a path to a custom user config file for the Fim. If you want to overwrite some of the settings in the generated configuration file (FiM_Cfg.h), you can specify a path to a user defined configuration file. The user defined configuration file will be included at the end of the generated preprocessor switches. Definitions in the user defined configuration file can overwrite definitions in the generated configuration file. NOTE: Not all of the features can be overwritten simply by triggering the preprocessor switch. Some of the options are complex and the code generator generates less or more code depending on the setting. USE SUCH A FILE ONLY AFTER DISCUSSION WITH VECTOR.
    container FimInhibitionConfiguration [0..*]  # This container includes all configuration parameters concerning the relationship between event and Fid.
      enumeration FimInhInhibitionMask: {FIM_LAST_FAILED, FIM_NOT_TESTED, FIM_TESTED, FIM_TESTED_AND_FAILED}, set at pre-compile in variant pre-compile / link in variant link-time  # The configuration parameter is used to specify the inhibition mask for an event - Fid relation.
      reference FimInhFunctionIdRef: set at pre-compile in variant pre-compile / link in variant link-time, destination=FimFid  # Reference to a FimFid to which the inhibtions masks are mapped.
      container FimInhEventId  # The configuration parameter is used for an existing Dem event and summarized events as well.
        choice container FimInhRefChoice
          container FimInhChoiceDemRef
            reference FimInhEventRef: set at pre-compile in variant pre-compile / link in variant link-time, destination=DemEventParameter  # Reference to DemEventParameter on which the inhibtion mask can be applied.
          container FimInhChoiceSumRef
            symbolic name reference FimInhSumRef: set at pre-compile, destination=FimSummaryEventId  # NOT USED by Vecor Fim
    container FimSummaryEventId [0..*]  # NOT USED by Vecor Fim This container defines the name of a summarized event.
      integer FimEventSumId: 0..65535, set at pre-compile, symbolic-name-value=true  # NOT USED by Vecor Fim The summarized EventId definition record defines the existence of a summarized event with a specific name. This summarized event can be referenced in the EventSummary (as FimSummaryEventId) and Inhibition configuration (as FimInhEventId).
    container VectorCommonData
      string BswmdVersion: configuration-class-affection=affection-kind=NO-AFFECT, set at published-information, origin=Vector Informatik, default-value=1.01.00  # NOT USED - META INFORMATION
  module config Fim_Rec: definition=Fim
    FimGeneral: FimSupportRTE=true
  module config Fim_Pre: definition=Fim
    FimGeneral: FimCyclicEventEvaluation=false, FimDataFixed=true
