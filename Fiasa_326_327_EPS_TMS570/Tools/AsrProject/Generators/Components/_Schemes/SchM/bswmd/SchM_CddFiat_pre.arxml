AUTOSAR XML (schema 3.0.1)
package /MICROSAR
  module config SchM_Rec: definition=SchM, implementation-config-variant=VARIANT-PRE-COMPILE  # Configuration of the SchM (BSW Scheduler) module.
    CddFiat (SchMModuleConfiguration): SchMModuleLiteral=CddFiat, SchMModuleInclude=, SchMModuleConfigVersion=1.0.0, SchMModuleImplementationRef=CddFiat_Impl
      SCHM_CDDFIAT_INSTANCE_0 (InstanceConfiguration): SchMInstanceLiteral=SCHM_CDDFIAT_INSTANCE_0
        CDDFIAT_EXCLUSIVE_AREA_0 (ExclusiveAreaConf): SchMExclusiveAreaLiteral=CDDFIAT_EXCLUSIVE_AREA_0, SchMExclusiveAreaDescription=
