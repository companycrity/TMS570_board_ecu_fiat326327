AUTOSAR XML (schema 3.0.1)
package /MICROSAR
  module config SchM_Rec: definition=SchM, implementation-config-variant=VARIANT-PRE-COMPILE  # Configuration of the SchM (BSW Scheduler) module.
    CanIf (SchMModuleConfiguration): SchMModuleLiteral=CanIf, SchMModuleInclude=CanIf.h, SchMModuleConfigVersion=1.2.0, SchMModuleImplementationRef=CanIf_Impl
      SCHM_CANIF_INSTANCE_0 (InstanceConfiguration): SchMInstanceLiteral=SCHM_CANIF_INSTANCE_0
        6 x ExclusiveAreaConf:
          CANIF_EXCLUSIVE_AREA_0: SchMExclusiveAreaLiteral=CANIF_EXCLUSIVE_AREA_0, SchMExclusiveAreaDescription=Using to secure read-modify-write of CanIf_ControllerMode. This Area should be protected. For details please look at the technical Reference.
          CANIF_EXCLUSIVE_AREA_1: SchMExclusiveAreaLiteral=CANIF_EXCLUSIVE_AREA_1, SchMExclusiveAreaDescription=Used everywhere the Transmitqueue is handeled. This area needs to be protected. For details please look at the technical reference.
          CANIF_EXCLUSIVE_AREA_2: SchMExclusiveAreaLiteral=CANIF_EXCLUSIVE_AREA_2, SchMExclusiveAreaDescription=Used to secure the Queue handling. This area needs to be protected. For details please look at the technical reference.
          CANIF_EXCLUSIVE_AREA_3: SchMExclusiveAreaLiteral=CANIF_EXCLUSIVE_AREA_3, SchMExclusiveAreaDescription=Used to secure queue handling. This area needs to be protected. For details please look at the technical reference.
          CANIF_EXCLUSIVE_AREA_4: SchMExclusiveAreaLiteral=CANIF_EXCLUSIVE_AREA_4, SchMExclusiveAreaDescription=Used to secure data if function is called reentrant. This area needs to be protected. For details please look at the technical reference.
          CANIF_EXCLUSIVE_AREA_5: SchMExclusiveAreaLiteral=CANIF_EXCLUSIVE_AREA_5, SchMExclusiveAreaDescription=Used to secure the consistency of dynamic CAN identifier. This area needs to be protected.. This area needs to be protected. For details please look at the technical reference.
