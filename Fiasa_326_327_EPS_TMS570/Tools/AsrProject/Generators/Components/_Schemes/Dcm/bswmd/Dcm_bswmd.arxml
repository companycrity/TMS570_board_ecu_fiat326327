AUTOSAR XML (schema 3.0.1)
# COPYRIGHT
# Copyright (c) 2010 by Vector Informatik GmbH. All rights reserved.
# This software is copyright protected and proprietary to Vector Informatik GmbH.
# Vector Informatik GmbH grants to you only those rights as set out in the license conditions.
package /MICROSAR
  bsw implementation Dcm_Impl: code-generator=GENy, programming-language=C, sw-major-version=4, sw-minor-version=12, sw-patch-version=0, vendor-id=30, ar-major-version=3, ar-minor-version=0, ar-patch-version=0, preconfigured-configuration=Dcm_Pre, recommended-configuration=Dcm_Rec, vendor-specific-module-def=Dcm
  module definition Dcm: refined-module-def=Dcm, variants pre-compile/link-time/post-build  # Configuration of the Dcm (Diagnostic Communications Manager) module.
    container DcmDsd  # These parameters apply to Diagnostic Service Dispatcher. All parameters for all service dispatchers are included in this one configuration container. upperMultiplicity: Service dispatcher is multiple times configurable in this one configuration container. lowerMultiplicity: There must always be one service dispatcher in a DCM.
      container DcmDsdServiceTable [1..31]  # This container contains the configuration (DSD parameters) for Service Identifier Table.
        string DcmDiagnosticDatabase: set at pre-compile in variant pre-compile / link in variant link-time+post-build, origin=Vector Informatik  # This parameter is a file reference to the diagnostic service description database. Based on the contents the Dcm services will be configured. RESTRICTIONS: The Vector GENy tool supports CANdela document (.cdd) files to be imported.
        string DcmDiagnosticVariant: set at pre-compile in variant pre-compile / link in variant link-time+post-build, origin=Vector Informatik  # This parameter is an instance reference into the diagnostic service description database. Based on the contents the Dcm services will be configured. This parameter is optional. RESTRICTIONS: In the Vector GENy tool you have to select the proper diagnostic description variant (if more than one is available) in order to generate the correct diagnostic component.
    container DcmDsl  # These parameters apply to a Diagnostic Session Layer. There may be a parameter set (DSL Configuration) per protocol. upperMultiplicity: Each DCM configuration must have exactly one DSL configuration. lowerMultiplicity: Each DCM configuration must have exactly one DSL configuration.
      container DcmDslDiagResp  # This container contains the configuration (parameters) for the ResponsePending handling
        boolean DcmDslDiagRespForceRespPendEn: set at pre-compile  # NOT USED by Vector Dcm. Allow to enable (TRUE) or disable (FALSE) the mechanism of directly triggering of ResponsePending by application.
        integer DcmDslDiagRespMaxNumRespPend: 0..255, set at pre-compile  # NOT USED by Vector Dcm. Maximum number of negative responses with response code 0x78 (requestCorrectlyReceived-ResponsePending) allowed per request. Dcm will send a negative response with response code 0x10 (generalReject), in case the limit value gets reached.
      container DcmDslProtocol  # This container contains the configuration (parameters) for the protocol configuration (for each protocol) The following parameters needs to be configured per protocol.
        container DcmDslProtocolRow [1..*]  # Definition of a single Row of configuration for the protocol configuration (for each protocol)
          integer DcmDslProtocolID: 0..255, set at pre-compile, symbolic-name-value=true  # NOT USED by Vector Dcm. The SWS for DCM defines this as enum type of maxsize uint8 with values {OBD, UDS, ...}. It is effectively the name of the diagnostic protocol type for the Dcm Dsl Protocol that is being configured. 0x00 : DCM_OBD_ON_CAN OBD on CAN (ISO15765-4; ISO15031-5) 0x01 : DCM_UDS_ON_CAN UDS on CAN (ISO15765-3; ISO14229-1) 0x02 : DCM_UDS_ON_FLEXRAY UDS on FlexRay (Manufacturer specific; ISO14229-1) 0x03 : DCM_ROE_ON_CAN 0x04 : DCM_ROE_ON_FLEXRAY 0x05 : DCM_PERIODIC_ON_CAN 0x06 : DCM_PERIODIC_ON_FLEXRAY Implementation Type: Dcm_ProtocolType 0x07..0xEF : Reserved for further AUTOSAR implementation 0xF0..0xFF : Reserved for SW supplier specific
          boolean DcmDslProtocolIsParallelExecutab: set at pre-compile  # NOT USED by Vector Dcm. Enables the parallel processing of ROE or Periodic Transmission protocol. Only these both protocols are allowed to run in parallel to normal protocol (UDS, OBD).
          float DcmDslProtocolPreemptTimeout: 0.., set at pre-compile  # NOT USED by Vector Dcm. This is the value for the timeout (in milliseconds) of preempting protocol until protocol needs to be started. This is defined in the AUTOSAR SWS for Dcm as a uint16. The AUTOSAR configuration standard is to use SI units, so this parameter is defined as a float value in seconds. DCM configuration tools must convert this float value to the appropriate value format for the use in the software implementation of DCM. min: A negative value is not allowed. upperMultiplicity: Exactly one DcmDslProtocolPreemptTimeout value per DSL protocol timing structure. lowerMultiplicity: Exactly one DcmDslProtocolPreemptTimeout value per DSL timing structure. origin: Standard AUTOSAR configuration parameter.
          integer DcmDslProtocolPriority: 0..255, set at pre-compile  # NOT USED by Vector Dcm. The SWS for DCM defines this item as uint8. This is the protocol priority that is used during protocol preemption handling. 0 = Highest priority (protocol may not be preempted by other protocols) 1, 2, 3... = Reducing priority. Protocol may be preempted by other protocols with lower priority value. upperMultiplicity: Exactly one priority must be provided per Tx Protocol. lowerMultiplicity: Exactly one priority must be provided per Tx Protocol. origin: Standard AUTOSAR configuration parameter.
          integer DcmDslProtocolBufferSize: 8..4095, set at pre-compile in variant pre-compile / link in variant link-time+post-build  # Specifies the size of the diagnostic buffer (in bytes). For a linear buffer: size of the buffer shall be as large as the longest message (request or response). For a paged buffer (only Tx possible): size has impacts on the application performance. The diagnostic buffer is the main storage to receive requests and the place to store the response when sending it. The size required for this buffer depends on the diagnostic specification, or more specifically the size of the larges request or response that will have to be received or transmitted, respectively. Typically, services with rather large responses like the fault memory read outs, large dynamically defined DIDs or just combined DID requests (request several DIDs in a single ReadDataByIdentifier) can result in huge buffer consumption. Refer to the paged buffer options if you have space issues. Also note that large requests (WriteDataByIdentifier/Address) can not use such mechanisms, you need to provide enough buffer to receive the whole data.
          string DcmDiagnosticDatabase: set at pre-compile in variant pre-compile / link in variant link-time+post-build, origin=Vector Informatik  # NOT USED by Vector Dcm. For Vector Dcm, the parameter Dcm/DcmDsd/DcmDsdServiceTable/DcmDiagnosticDatabase is used instead. This parameter is a file reference to the diagnostic service description database. Based on the contents the Dcm services will be configured.
          string DcmDiagnosticVariant [0..1]: set at pre-compile in variant pre-compile / link in variant link-time+post-build, origin=Vector Informatik  # NOT USED by Vector Dcm. For Vector Dcm, the parameter Dcm/DcmDsd/DcmDsdServiceTable/DcmDiagnosticVariant is used instead. This parameter is an instance reference into the diagnostic service description database. Based on the contents the Dcm services will be configured. This parameter is optional.
          enumeration DcmDslProtocolTransType: {Type1, Type2}, set at pre-compile, origin=AUTOSAR, default-value=Type1  # NOT USED by Vector Dcm. Selects the transmission type for protocol. Unused since transmission type has to be selected separately for RoE and periodic Tx.
          reference DcmDslProtocolTimeLimit [0..1]: set at pre-compile, destination=DcmDslProtocolTimingRow  # NOT USED by Vector Dcm. Link to the extended / limit timing structure. Note: limits are checked when using AccessTimingParameter service. upperMultiplicity: Exactly one extended timing structure must be provided. lowerMultiplicity: Exactly one extended timing structure must be provided.
          container DcmDslConnection [1..*]  # This container contains links between Diagnostic Protocol (=DcmDslProtocolRow) and the according Rx or Tx channel. Because of the usecase to allow more then one diagnostic tester (using different CAN channels) it is necessary to allow configuration of multiple DcmDslConnections.
            enumeration DcmConnectionProtocolType: {UDS, OBD, UDSOBD}, set at pre-compile in variant pre-compile / link in variant link-time+post-build, origin=Vector Informatik, default-value=UDS  # Select how to pre-filter a request acceptance on a certain connection in OBD relevant ECUs. Enumeration values: UDS: Only diagnostic services with identifier greater or equal to 0x10 will be accepted. Any OBD request will be ignored. OBD: Only OBD requests (within the range 0x00 - 0x0F) will be accepted. Any other request message will be ignored. Can be used as service firewalling upon scan-tools. UDSOBD: Any request will be accepted, independently of its service identifier RESTRICTIONS: This setting is only relevant for OBD relevant ECUs.
            container DcmDslMainConnection  # This container contains configuration for Diagnostic Main Connection (DcmDslProtocolTx, DcmDslProtocolRx). In addition it contains links to the ROE connection (DcmDslROEConnectionRef) and the Periodic Transmission Connection (DcmDslPeriodicTranmissionConRef) relevant for protocols with DcmDslProtocolTransType = TYPE2.
              container DcmDslProtocolRx [1..*]  # This container contains the configuration (parameters) for the protocol configuration of RX channel (for each protocol) The following parameters needs to be configured per protocol. Please keep in mind, that the parameter DcmDslProtocolRxPduId can be given several times per protocol and that the combination from DcmDslProtocolRxPduId and DcmDslProtocolRxAddrType is unique. Only one physical protocol is allowed per connection. upperMultiplicity: More than one receive PDU ID may be configured for reception (e.g. one for func requests, one for phys requests). lowerMultiplicity: At least one receive PDU ID configuration must be provided per protocol.
                enumeration DcmDslProtocolRxAddrType: {FUNCTIONAL_TYPE, PHYSICAL_TYPE}, set at pre-compile in variant pre-compile / link in variant link-time+post-build  # Determines the addressing type of the Rx PduId referenced by DcmDslProtocolRxPduRef. Enumeration values: PHYSICAL_TYPE: Used for 1 to 1 communication. FUNCTIONAL_TYPE: Used for 1 to n communication.
                reference DcmDslProtocolRxPduRef: set at pre-compile in variant pre-compile / link in variant link-time+post-build, destination=Pdu  # Reference to Dcm Rx PduId used for reception of requests. Multiple links shall be allowed. (e.g. one Dcm Rx PduId to receive func requests, one Dcm Rx PduId to receive phys requests).
              container DcmDslProtocolTx  # This container contains the configuration (parameters) for the protocol configuration of TX channel (for each protocol) The included parameters needs to be configured per protocol.
                reference DcmDslProtocolTxPduRef: set at pre-compile in variant pre-compile / link in variant link-time+post-build, destination=Pdu  # Reference to a Dcm Tx PduId used for transmission of the main diagnostic responses.
            container DcmDslPeriodicTransmission [0..*]  # This container contains the configuration (parameters) for Periodic Transmission service. Hint: Periodic Transmission request comes via DcmDslMainConnection and PeriodicTransmission Event response is given via DcmDslPeriodicTransmission.
              reference DcmDslPeriodicTxPduRef [0..1]: set at pre-compile in variant pre-compile / link in variant link-time+post-build, destination=Pdu  # Reference to a Dcm Tx PduId to be used for periodic responses. RESTRICTIONS: Only needed for Type2 periodic transmission configurations.
            container DcmDslResponseOnEvent [0..1]  # This container contains the configuration (parameters) for ResponseOnEvent service. Hint: ROE service request is recept via DcmDslMainConnection and that Event response is given via DcmDslResposeOnEvent
              reference DcmDslRoeTxPduRef [0..1]: set at pre-compile in variant pre-compile / link in variant link-time+post-build, destination=Pdu  # Reference to the PduId for transmission of ROE response (only needed for ROE Transmission Type is Type2)
      container DcmDslProtocolTiming  # This container contains the configuration (parameters) for Protocol timing. This container contains rows of DcmDslProtocolTimingRow containers. Hint: DcmDslProtocolTiming is only relevant in case of using the UDS service AccessTimingParameter.
        container DcmDslProtocolTimingRow [0..*]  # Definition of a single row of configuration for protocol timing
          float DcmTimStrP2ServerMax: 0.., set at pre-compile  # NOT USED by Vector Dcm. For Vector Dcm, this value is imported from the diagnostic database referenced by /MICROSAR/Dcm/DcmDsd/DcmDsdServiceTable/DcmDiagnosticDatabase. This is the value for P2ServerMax in milliseconds. This is defined in the AUTOSAR SWS for DCM as a uint16. The AUTOSAR configuration standard is to use SI units, so this parameter is defined as a float value in seconds. DCM configuration tools must convert this float value to the appropriate value format for the use in the software implementation of DCM.
          float DcmTimStrP2ServerMin: 0.., set at pre-compile  # NOT USED by Vector Dcm. For Vector Dcm, this value is imported from the diagnostic database referenced by /MICROSAR/Dcm/DcmDsd/DcmDsdServiceTable/DcmDiagnosticDatabase. This is the value for P2ServerMin in milliseconds. This is defined in the AUTOSAR SWS for DCM as a uint16. The AUTOSAR configuration standard is to use SI units, so this parameter is defined as a float value in seconds. DCM configuration tools must convert this float value to the appropriate value format for the use in the software implementation of DCM.
          float DcmTimStrP2StarServerMax: 0.., set at pre-compile  # NOT USED by Vector Dcm. For Vector Dcm, this value is imported from the diagnostic database referenced by /MICROSAR/Dcm/DcmDsd/DcmDsdServiceTable/DcmDiagnosticDatabase. This is the value for P2*ServerMax in milliseconds. This is defined in the AUTOSAR SWS for DCM as a uint16. The AUTOSAR configuration standard is to use SI units, so this parameter is defined as a float value in seconds. DCM configuration tools must convert this float value to the appropriate value format for the use in the software implementation of DCM.
          float DcmTimStrP2StarServerMin: 0.., set at pre-compile  # NOT USED by Vector Dcm. For Vector Dcm, this value is imported from the diagnostic database referenced by /MICROSAR/Dcm/DcmDsd/DcmDsdServiceTable/DcmDiagnosticDatabase. This is the value for P2*ServerMin in milliseconds. This is defined in the AUTOSAR SWS for DCM as a uint16. The AUTOSAR configuration standard is to use SI units, so this parameter is defined as a float value in seconds. DCM configuration tools must convert this float value to the appropriate value format for the use in the software implementation of DCM.
          float DcmTimStrS3Server: 0.., set at pre-compile in variant pre-compile / link in variant link-time+post-build  # NOT USED by Vector Dcm. For Vector Dcm, this value is imported from the diagnostic database referenced by /MICROSAR/Dcm/DcmDsd/DcmDsdServiceTable/DcmDiagnosticDatabase. This is the value for S3Server (the time after which the tester is considered to be disconnected) in milliseconds. This is defined in the AUTOSAR SWS for Dcm as a uint16. The AUTOSAR configuration standard is to use SI units, so this parameter is defined as a float value in seconds. Dcm configuration tools must convert this float value to the appropriate value format for the use in the software implementation of Dcm.
    container DcmGeneral  # This container contains the configuration (parameters) for Component wide parameters
      boolean DcmRespondAllRequest: set at pre-compile, origin=Vector Informatik  # If set to FALSE the Dcm will not respond to diagnostic request that contains a service ID which is in the range from 0x40 to 0x7F or in the range from 0xC0 to 0xFF (Response IDs).
      boolean DcmDevErrorDetect: set at pre-compile  # Preprocessor switch to enable or disable the Development Error Detection (DET) mechanism. By enabling this option, you will turn on the Dcm internal monitoring of all APIs towards and from the application. Once an invalid parameter or return value has been detected, Dcm notifies the DET (Development Error Tracer) component about the fault.
      boolean DcmRequestIndicationEnabled: set at pre-compile  # NOT USED by Vector Dcm. Allows to enable or disable the requested indication mechanism.
      float DcmTaskTime: 0.001..0.255, set at link in variant link-time / pre-compile in variant pre-compile+post-build, default-value=0.010  # Allow to configure the time for the periodic cyclic task Dcm_MainFunction() (resp. Dcm_TimerTask()). Please note: This configuration value shall be equal to the value in the ScheduleManager module. All Dcm internal time calculations are based on this value so it is very important that the correct value is configured here.
      boolean DcmVersionInfoApi: set at pre-compile  # Preprocessor switch to enable or disable the output version info functionality. If the version information is not needed, disable this option to save resources (ROM).
      boolean DcmUseRte: set at pre-compile in variant pre-compile / link in variant link-time+post-build, origin=Vector Informatik, default-value=true  # Decides if the Dcm uses port interfaces or callback functions Enable this option if the ECU uses an RTE. If this option is enabled, a port interface description (Software Component Template) is generated which can be used for the RTE configuration. Disable this option if the ECU does not use an RTE. If this option is disabled, a code template is generated which supports you with the implementation of the interface of the Dcm towards the application.
      enumeration DcmParallelRequestHandling: {EXCLUSIVE_SILENT, EXCLUSIVE_REQUEST, EXCLUSIVE_SESSION}, set at pre-compile, origin=Vector Informatik, default-value=EXCLUSIVE_SILENT  # Choosing any value other than EXCLUSIVE_SILENTwill enable responses with NRC 0x21 to parallel requests from different testers. Enumeration values: Exclusive Silent: Requests received while the Dcm is still processing another request are ignored without response Exclusive Request: Requests received while the Dcm is still processing another request are rejected with NRC 0x21 Exclusive Session: Same as "Exclusive Request" but additionally, if a tester activates a non-default session, requests from other testers will be rejected with NRC 0x21 until the ECU switches back to the default session.
      integer DcmMaxNumberParallelRequest [0..1]: 0..255, set at pre-compile in variant pre-compile / link in variant link-time+post-build, origin=Vector Informatik, default-value=3  # Set the maximum number of parallel requests that can be rejected with negative response code 0x21. The optimal value for this setting is the total number of testers that are expected to communicate with the ECU at the same time. RESTRICTIONS: Only relevant if "DcmParallelRequestHandling" is not set to 'EXCLUSIVE_SILENT'
      integer DcmRuntimeLimiter: 1..255, set at pre-compile in variant pre-compile / link in variant link-time+post-build, origin=Vector Informatik, default-value=10  # Limit runtime of lengthy services, e.g. the faultmemory accesses to this number of elements per Dcm task cycle (see parameter DcmTaskTime). Longer service responses for e.g. the faultmemory services can take long enough to trigger task supervising errors or watchdog timeouts, especially on slow controllers. The runtime of such long service responses can be distributed over several Dcm task cycles to combat that. To find out the best value for your ECU, you have to take into account the DcmDslProtocolBufferSize, the DcmTaskTime and communication settings like CanTpTp Bs and STMin (time between consecutive frames) For faster bus transmission, more data is required per time unit. In that case, increase the limiter. This also reduces consecutive frame jitter. For slower hardware or tighter task runtime allowance reduce the limiter. This can cause jittering consecutive frames. You can also decrease the DcmTaskTime, and reduce the limiter to have the same amount of data per time unit, but shorter runtime of each task cycle. Also, a small paged diagnostic buffer will fill up quickly to the point where the buffer size limits the runtime more than this value. Note: You need at least a limiter of 3 to fill a CanTp consecutive frame per Dcm task cycle.
      integer DcmEcuResetDelayTime: 0..65535, set at pre-compile in variant pre-compile / link in variant link-time+post-build, origin=Vector Informatik, default-value=1000  # This option specifies the delay time in milliseconds to be applied from accepting a valid ECU reset request until its real execution.
      string DcmUserConfigFile: set at pre-compile, origin=Vector Informatik  # This option specifies a path to a custom user config file for the Dcm. If you want to overwrite some of the settings in the generated configuration file (Dcm_Cfg.h), you can specify a path to a user defined configuration file. The user defined configuration file will be included at the end of the generated preprocessor switches. Definitions in the user defined configuration file can overwrite definitions in the generated configuration file. NOTE: Not all of the features can be overwritten simply by triggering the preprocessor switch. Some of the options are complex and the code generator generates less or more code depending on the setting. USE SUCH A FILE ONLY AFTER DISCUSSION WITH VECTOR.
      enumeration DcmVariantModeSelection: {SIMPLE_ECU, MULTI_IDENTITY_MODE, VSG_MODE}, set at pre-compile, origin=Vector Informatik, default-value=SIMPLE_ECU  # Select the multi configuration variant mode. Enumeration values: SIMPLE_ECU: The diagnostics support one configuration only. (AUTOSAR standard) MULTI_IDENTITY_MODE: The diagnostics support different diagnostic variants. One variant is active a time. VSG_MODE: Diagnostic Entities (SubServices, DTCs...) are grouped into VSGs. Several VSGs can be activated at a time. Note: This setting is independent from communication identities!
      integer DcmMaxMemoryGapSize: 0..4294967295, set at pre-compile in variant pre-compile / link in variant link-time+post-build, origin=Vector Informatik, default-value=0  # Specifies the maximum gap size between two consecutive memory blocks that can be combined into a single memory block (i.e. the gap will be treated as accessible area too ). This process can be only applied if the properties of those memory blocks are equal: have the same access operations (read/write) and same access conditions (session, security access, etc.). Valid values: 0: no gap - combine only memory blocks that are attached. 1 - UINT_MAX: combine memory blocks only if the start address of the subsequent block is not farther than the end address of the first block + this value + 1.
      boolean DcmAsr4StyleMemoryAccess: configuration-class-affection=affection-kind=PC-AFFECTS-LT-AND-PB, set at pre-compile, origin=Vector Informatik, default-value=false  # If this option is enabled and one of the service 0x23 or 0x3D is available in the ECU diagnostic configuration , Dcm will require additional callouts to be implemented (see the Dcm TechnicalReference for details about them). If it is disabled, Dcm will provide a direct memory access to the requested address block without any application interaction.
      boolean DcmSupportMultiChannelFBL: configuration-class-affection=affection-kind=PC-AFFECTS-LT-AND-PB, set at pre-compile, origin=Vector Informatik, default-value=false  # If this option is enabled, the Dcm will provide additional information to the DcmFbl interface about the logical channel the request originated on. This allows the proper handling of ECUs that can jump to the boot loader from different channels. Also, the Dcm expects the DcmFbl to provide the same information after startup. Note: If the channel layout differs between Application and Bootloader, the channel mapping must be implemented in DcmFbl during integration (also see the DcmFbl TechnicalReference) This setting must match the DcmFbl interface and the boot loader used.
      string DcmSoftwareComponentName: set at pre-compile in variant pre-compile / link in variant link-time+post-build, origin=Vector Informatik, default-value=Dcm  # This name is used as component name (ShortName) in the generated software component template. Change this name if you try to import the Dcm components of several ECUs and have problems with name clashes. RESTRICTIONS: This setting is only relevant if "DcmUseRte" is enabled.
      boolean DcmUnspecifiedServiceSupport: set at pre-compile, origin=Vector Informatik, default-value=false  # Preprocessor switch to enable or disable the support of unspecified services in the diagnostic configuration. If this option is enabled, Dcm will not reject every unknown service, but will ask your application if the SID is an application specific one and if so will delegate the service processing to the application. Please refer to the Dcm technical reference for detailed description on this feature.
      enumeration DcmPeriodicTxType: set at pre-compile, origin=Vector Informatik, default-value=Type_II  # Select which type of periodic response is supported by Dcm. The per-protocol selection defined by AUTOSAR is not necessarily consistent, so this parameter is used as authoritative reference. - Type_I: Same Tx Pdu as for main response - Type_II: Dedicated (unsegmented) Tx Pdu
        Type_I  # Same Tx Pdu as for main response
        Type_II  # Dedicated (unsegmented) Tx Pdu
      enumeration DcmRoeTxType: set at pre-compile, origin=Vector Informatik, default-value=Type_II  # Select which type of periodic response is supported by Dcm. The per-protocol selection defined by AUTOSAR is not necessarily consistent, so this parameter is used as authoritative reference. - Type_I: Same Tx Pdu as for main response - Type_II: Dedicated (segmented) Tx Pdu
        Type_I  # Same Tx Pdu as for main response
        Type_II  # Dedicated (segmented) Tx Pdu
      boolean DcmSplitMainFunctionEnabled: set at pre-compile in variant pre-compile / link in variant link-time / post-build in variant post-build, origin=Vector Informatik, default-value=false  # Enable this option if you want to call Dcm_TimerTask and Dcm_StateTask separately. Disable this option if you want to call Dcm_MainFunction. Please note: This selection does not affect the Dcm embedded code. It merely sets up the SchM.
      boolean DcmSupplierNotificationSupport: set at pre-compile, origin=Vector Informatik, default-value=false  # Supplier specific request indication support. If enabled, This pre-handler is called prior to any more specific service handler, for each service
      boolean DcmOemNotificationSupport: set at pre-compile, origin=Vector Informatik, default-value=false  # Manufacturer specific request indication support. If enabled, This pre-handler is called prior to any more specific service handler, for each service
      boolean DcmOBDCalibrationSupport: set at pre-compile, origin=Vector Informatik, default-value=false  # If enabled, DCM will provide means to suppress OBD related parameter identifiers (PIDs) and corresponding UDS identifiers by means of offline-calibration. Please note, PIDs etc can only be disabled and re-enabled. You need to statically set up a superset of all PIDs you might need to support.
      boolean DcmAmdRuntimeMeasurement [0..1]: set at pre-compile, origin=Vector Informatik, default-value=false  # This parameter defines if AMD Runtime Measurement (RTM) is enabled for this module.
    container DcmPageBufferCfg  # This container contains the configuration (parameters) for paged buffer handling
      boolean DcmPagedBufferEnabled: set at pre-compile  # Allow to enable or disable the paged buffer mechanism. In order to save some RAM, you can enable this feature which will allow much longer responses to be sent with a small static buffer configuration. This feature just enables a Dcm implementation part allowing the usage of paged buffer transfer, but your application must decide for which service this response mechanism shall be used. Otherwise you will have much ROM and little runtime overhead in Dcm without any need.
      float DcmPagedBufferTimeout [0..1]: 0.., set at pre-compile in variant pre-compile / link in variant link-time+post-build  # NOT USED by Vector Dcm. Allow to configure the Timeout (in ms) towards the application for filling the next page. This parameter is only relevant if the paged buffer handling is enabled. (DcmPagedBufferEnabled = TRUE) RESTRICTIONS: This parameter has no effect for the Vector Dcm implementation.
    container VectorCommonData
      string BswmdVersion: configuration-class-affection=affection-kind=NO-AFFECT, set at published-information, origin=Vector Informatik, default-value=4.12.00  # NOT USED - META INFORMATION Marker used by the configuration tool
    container DcmConfigSet: multiple-configuration-container=true
      reference DcmActiveDslProtocolRowRef [1..*]: set at pre-compile in variant pre-compile / link in variant link-time+post-build, origin=Vector Informatik, destination=DcmDslProtocolRow  # References active connections in this identity.
      reference DcmActiveDsdServiceTableRef: set at pre-compile in variant pre-compile / link in variant link-time+post-build, origin=Vector Informatik, destination=DcmDsdServiceTable  # Reference to the service table active in a variant in multi configuration ECUs.
  module config Dcm_Pre: definition=Dcm
  module config Dcm_Rec: definition=Dcm
