AUTOSAR XML (schema 3.2.1)
package /MICROSAR
  module config PduR_Pre: definition=PduR
    PduRGeneral: PduRCanTp2ProvideRxBufferCalls=false
