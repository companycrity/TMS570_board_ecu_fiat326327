AUTOSAR XML (schema 3.0.1)
package /MICROSAR
  module config CanTp_Pre: definition=CanTp, implementation-config-variant=VARIANT-PRE-COMPILE
    CanTpGeneral:
      CanTpEnableRxNSduIdRemapping = false
      CanTpEnableTxNSduIdRemapping = false
      CanTpEnableAr40CompliantPduRApi = false
      CanTpEnableExtendedApiSTMin = false
      CanTpRc = false
      CanTpTc = false
      CanTpHavePaddingByte = true
      CanTpSupportMixed11Addressing = false
      CanTpSupportStandardAddressing = true
      CanTpSupportExtendedAddressing = false
      CanTpPaddingPattern = 0
      CanTpTcNotifyAlways = false
      CanTpRcNotifyAlways = false
      CanTpChangeParameterReqApi = false
      CanTpEnableExtendedApiBs = (unset)
      CanTpSupportFullBufferHandlingRx = true
      CanTpSupportFullBufferHandlingTx = true
      CanTpDynamicChannelAssignment = false
      CanTpSuppressPrePassIndication = false
      CanTpExtErrorDetect = false
      CanTpHasTxConfirmation = true
      CanTpStrictRxCallSeq = false
      CanTpPaddingActive = true
  module config CanTp_Rec: definition=CanTp
    CanTpGeneral: CanTpVersionInfoApi=false, CanTpOptimizeSingleConnection=true, CanTpProdErrorDetect=true
  module config CanTp_Rec_Class1: definition=CanTp
    CanTpRxNSdu: CanTpNar=0.025, CanTpRxPaddingActivation=CANTP_ON, CanTpNcr=0.15
  module config CanTp_Pre_Class1: definition=CanTp
    CanTpRxNSdu: CanTpBs=0, CanTpSTmin=0
  module config CanTp_Pre_Class2: definition=CanTp
    CanTpTxNSdu
  module config CanTp_Rec_Class2: definition=CanTp
    CanTpTxNSdu: CanTpNas=0.025, CanTpNbs=0.075, CanTpTxPaddingActivation=CANTP_ON
