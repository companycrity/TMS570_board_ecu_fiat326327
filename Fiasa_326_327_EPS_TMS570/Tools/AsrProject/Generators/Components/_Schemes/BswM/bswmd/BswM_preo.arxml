AUTOSAR XML (schema 3.0.2)
package /MICROSAR
  module config BswM_Pre: definition=BswM, implementation-config-variant=VARIANT-PRE-COMPILE
  module config BswM_Rec: definition=BswM
    BswMGeneral: BswMDevErrorDetect=false, BswMDcmResteMode=true, BswMDcmComControl=true
