AUTOSAR XML (schema 3.0.1)
package /MICROSAR
  module definition Xcp [0..1]: variants pre-compile
    container XcpGeneral  # XCP Protocol Layer basic information.
      string XcpStationIdentifier: set at pre-compile, origin=Vector Informatik  # The 'XCP Station Identifier' is an ASAM-MC2 filename without path and extension that identifies the ECU's software program version. It is used for slave device identification and automatic session configuration. The Master Control System (MCS) can interpret this identifier as file name for the ECU database. The ECU developer should change the XCP station identifier with each program change. This will prevent database mixups and grant the correct access of measurement and calibration objects from the MCS to the ECU. Another benefit of the usage of the XCP station identifier is the automatic assignment of the correct ECU database at program start of the MCS via the Plug&Play mechanism. The Plug&Play mechanism prevents the user to choose the wrong ECU database.
      boolean XcpCommandParameterCheck: set at pre-compile, origin=Vector Informatik, default-value=true  # The option 'Command Parameter Check' enables checks of the range and validity of Command Transfer Object (CTO) and Data Transfer Object (DTO) parameters.
      boolean XcpUseAsrFileNames: set at pre-compile, origin=Vector Informatik, default-value=true  # The option 'XcpUseAsrFileNames' generates ASR compatible file names.
      boolean XcpEventCodes: set at pre-compile, origin=Vector Informatik, default-value=false  # 'Event Codes' are transmitted within event packets (EV) from the slave device to the master device. The transmission is not guaranteed since event packets are not acknowledged. Please refer to the XCP Protocol Layer specification for the 'Table of Event codes'.
      boolean XcpBootloaderDownload: set at pre-compile, origin=Vector Informatik, default-value=false  # In order to reprogram the internal flash of some microcontrollers it is necessary to use a bootloader, because code cannot be executed from flash while programming flash.
      boolean XcpMemoryWriteProtection: set at pre-compile, origin=Vector Informatik, default-value=false  # The option 'Memory Write Protection' enables write access to memory areas. I.e. prior to carrying out write access to RAM an application callback function is called and the memory address is passed as parameter. The application has to either grant or deny the memory access.
      boolean XcpMemoryReadProtection: set at pre-compile, origin=Vector Informatik, default-value=false  # The option 'Memory Read Protection' enables read access to memory areas. I.e. prior to carrying out read access to RAM an application callback function is called and the memory address is passed as parameter. The application has to either grant or deny the memory access.
      boolean XcpControl: set at pre-compile, origin=Vector Informatik, default-value=false  # The option 'XCP Control' enables an API to en-/disable the whole XCP module by one API call.
      boolean XcpGetDataPointer: set at pre-compile, origin=Vector Informatik, default-value=false  # The option 'Get Xcp Data Pointer' enables the API $$Xcp_GetXcpDataPointer which can be used to request the pointer to the internal data of the XCP module. Using this pointer the internal data can be set to specific value (e.g. after entering a boot mode, where a certain connection set shall be preset).
      boolean XcpOpenCommandInterface: set at pre-compile, origin=Vector Informatik, default-value=false  # The 'Open Command Interface' option provides the possibility for the user to implement unsupported commands in the application.
      string XcpUserConfigFile: set at pre-compile, origin=Vector Informatik  # A configuration file (xcp_cfg.h) is generated by GENy. If you want to overwrite settings in the generated configuration file, you can specify a path to a user defined configuration file. The user defined configuration file will be included at the end of the generated file. Therefore definitions in the user defined configuration file can overwrite definitions in the generated configuration file.
      boolean XcpEEPROMReadAccess: set at pre-compile, origin=Vector Informatik, default-value=false  # The option 'Read Access' allows read access to EEPROM. The routines for accessing the EEPROM have to be implemented in the application.
      boolean XcpEEPROMWriteAccess: set at pre-compile, origin=Vector Informatik, default-value=false  # The option 'Write Access' allows write access to EEPROM. The routines for accessing the EEPROM have to be implemented in the application.
      boolean XcpSynchronousDataAquisition: set at pre-compile, origin=Vector Informatik, default-value=false  # Data elements located in the slave's memory are transmitted in Data Transfer Objects (DTOs) from slave to master (DAQ) and from master to slave (STIM). The Object Description Table (ODT) describes the mapping between the synchronous data transfer objects and the slave's memory.
      boolean XcpSendQueue: set at pre-compile, origin=Vector Informatik, default-value=true  # The 'Send Queue' should be enabled if more than one ODT (Object Description Table) is used and if the Transport Layer does not support data queuing or data buffering. The 'Send Queue' has to be enabled if the Vector XCP Transport Layer for CAN is enabled.
      integer XcpMemorySize: 1..65535, set at pre-compile, origin=Vector Informatik, default-value=256  # A memory area has to be reserved for the dynamic allocation of DAQ and ODT (Object Description Table) lists and for the transmit queue.
      boolean XcpPrescaler: set at pre-compile, origin=Vector Informatik, default-value=false  # If the option 'Prescaler' is enabled all DAQ lists support the prescaler for reducing the transmission period.
      boolean XcpOverrunIndication: set at pre-compile, origin=Vector Informatik, default-value=true  # Overrun situations are indicated to the Master Control System. An overrun situation is e.g. an overflow of the transmit queue.
      boolean XcpWriteDAQMultiple: set at pre-compile, origin=Vector Informatik, default-value=false  # If the feature is disabled the command will not be supported. Thus a Write DAQ Multiple request results in a negative response. The Write DAQ Multiple command is only applicable on communication busses with a MAX_CTO value of at least 16 bytes (e.g. on FlexRay or Ethernet).
      boolean XcpDAQODTMessageHeader: set at pre-compile, origin=Vector Informatik, default-value=false  # If the option 'DAQ/ODT message header' is enabled the 2 byte DAQ/ODT XCP Packet Identification is used: Relative ODT number (1 byte), absolute DAQ list number (1 byte). If the option 'DAQ/ODT message header' is disabled a 1 byte Packet Identification (PID) is used: Absolute ODT number. Attention: The 'DAQ/ODT Message Header' must not be enabled if the XCP Transport Layer for CAN is enabled. ODT = Object Description Table
      boolean XcpResumeMode: set at pre-compile, origin=Vector Informatik, default-value=false  # The option 'Resume Mode' or often also called 'Cold Start Measurement' allows automatic data transfer (DAQ, STIM) directly after power-up of the slave without prior connection to the master calibration system.
      boolean XcpGeneralInfo: set at pre-compile, origin=Vector Informatik, default-value=false  # The option 'General Info' enables the XCP command GET_DAQ_PROCESSOR_INFO, which provides general information on DAQ lists.
      boolean XcpResolutionInfo: set at pre-compile, origin=Vector Informatik, default-value=false  # The option 'Resolution Info' enables the command GET_DAQ_RESOLUTION_INFO, which provides information on the resolution of DAQ lists.
      boolean XcpSynchronousDataStimulation: set at pre-compile, origin=Vector Informatik, default-value=false  # 'Synchronous Data Stimulation (STIM)' is the inverse mode of 'Synchronous Data Acquisition (DAQ)'. Data elements located in the slave's memory are transmitted in Data Transfer Objects from the master device to the slave device. These data elements are written to RAM upon XCP events.
      integer XcpNumberofODTsforSTIM: 1..255, set at pre-compile, origin=Vector Informatik, default-value=1  # The maximum number of Object Descriptor Tables (ODTs) for Synchronous Data Stimulation (STIM) has to be configured.
      boolean XcpEventInfo: set at pre-compile, origin=Vector Informatik, default-value=false  # The option 'Event Info' enables the generation of event information to the a2l file. This feature provides infomration about: - Number of event channel - Name of event channel - Measurement cycle time of event channel - Direction of event channel: DAQ, STIM, DAQ&STIM
      boolean XcpDAQTimestamp: set at pre-compile, origin=Vector Informatik, default-value=true  # Timestamps can be attached to Data Transfer Object (DTO) Packets, to avoid measurement errors due to bus latency. The timestamp unit and ticks per unit have to be defined if timestamps are used.
      boolean XcpFixedTimestamp: set at pre-compile, origin=Vector Informatik, default-value=false  # If the 'Fixed Timestamp' option is selected the slave always sends Data Transfer Object (DTO) Packets in time stamped mode. Otherwise timestamps are dynamically and individually enabled for each DAQ list.
      enumeration XcpTimestampUnit: {DAQ_TIMESTAMP_UNIT_1NS, DAQ_TIMESTAMP_UNIT_10NS, DAQ_TIMESTAMP_UNIT_100NS, DAQ_TIMESTAMP_UNIT_1US, DAQ_TIMESTAMP_UNIT_10US, DAQ_TIMESTAMP_UNIT_100US, DAQ_TIMESTAMP_UNIT_1MS, DAQ_TIMESTAMP_UNIT_10MS, DAQ_TIMESTAMP_UNIT_100MS, DAQ_TIMESTAMP_UNIT_1S}, set at pre-compile, origin=Vector Informatik, default-value=DAQ_TIMESTAMP_UNIT_1MS
      integer XcpTimestampTicksPerUnit: 1..255, set at pre-compile, origin=Vector Informatik, default-value=1  # The timestamp will increment per unit by the value specified here and wrap around if an overflow occurs.
      boolean XcpCommunicationModeInfo: set at pre-compile, origin=Vector Informatik, default-value=false  # The XCP command 'GET_COMM_MODE_INFO' returns optional information on different Communication Modes supported by the slave and also the version number of the Protocol Layer implementation. If the master block mode is supported, also the maximum allowed block size and the minimum separation time are returned. The XCP Protocol Layer supports the Standard Communication model and also the Master Block Transfer Mode and the Slave Block Transfer Mode.
      boolean XcpSeedKey: set at pre-compile, origin=Vector Informatik, default-value=false  # Resources within the slave device can be protected by a 'Seed & Key' mechanism. The following resources can be protected: - synchronous data acquisition (DAQ) - synchronous data stimulation (STIM) - online calibration (CAL) - programming (PGM)
      boolean XcpModifyBits: set at pre-compile, origin=Vector Informatik, default-value=false  # If the feature is disabled the command will not be supported. Thus a modify bit request results in a negative response and no change of any bits.
      boolean XcpShortDownload: set at pre-compile, origin=Vector Informatik, default-value=false  # If the feature is disabled the command will not be supported. Thus a short download request results in a negative response. As the short download command is only applicable on communication busses with a data length greater eight bytes (e.g. FlexRay).
      boolean XcpUserDefinedCommand: set at pre-compile, origin=Vector Informatik, default-value=false  # The 'User Defined Command' is optional and can be implemented within the application. However it must not be used to implement functionalities done by other services. The application callback function 'ApplXcpUserService()' is provided to perform application specific actions.
      boolean XcpTransportLayerCommand: set at pre-compile, origin=Vector Informatik, default-value=false  # The option 'Transport Layer Command' has to be enabled if transport layer specific commands are used and supported by the transport layer component.
      boolean XcpBlockUpload: set at pre-compile, origin=Vector Informatik, default-value=false  # The Slave Block Transfer Mode speeds up memory uploads by transmitting an entire block of continuous response packets. There is only a response packet before and after transmission of the entire block. There are no limitations allowed for the master device. The slave returns whether it supports Slave Block Transfer Model in the response of the request 'CONNECT'.
      boolean XcpBlockDownload: set at pre-compile, origin=Vector Informatik, default-value=false  # The Master Block Transfer Mode speeds up memory downloads by transmitting an entire block of continuous request packets. There is only one response packet after transmission of the entire block. The XCP Master has to meet the slave's limitations of the maximum block size and the minimum separation time. These communication parameters are responded within the response to 'GET_COMM_MODE_INFO'.
      integer XcpMIN_STForBlockDownload: 0..255, set at pre-compile, origin=Vector Informatik, default-value=0  # MIN_ST indicates the required minimum separation time between the packets of a block transfer from the master device to the slave device in units of 100 microseconds.
      boolean XcpChecksum: set at pre-compile, origin=Vector Informatik, default-value=false  # The XCP command BUILD_CHECKSUM returns a checksum that is calculated over the memory block defined by the Memory Transfer Address (MTA) and block size. The MTA will be post-incremented by the block size. The checksum type (size of the checksum) and the calculation method can be configured.
      boolean XcpAUTOSARCRCModuleSupport: set at pre-compile, origin=Vector Informatik, default-value=false  # If 'AUTOSAR CRC Module Support' is enabled only the following checksum calculation methods are available: - CRC16_CCITT : CRC16 CCITT algorithm (for details please refer to the XCP Protocol Layer Specification) - CRC32 : CRC32 algorithm (for details please refer to the XCP Protocol Layer Specification) The CRC32 algorithm is only supported if the AUTOSAR CRC Module is used.
      enumeration XcpCRCCalculationMethod: {ADD_11, ADD_12, ADD_14, ADD_22, ADD_24, ADD_44, CRC16_CCITT, CRC32}, set at pre-compile, origin=Vector Informatik, default-value=ADD_12  # Defines the algorithm used for calculation of the checksum.
      integer XcpCRCBlockSize: 1..65535, set at pre-compile, origin=Vector Informatik, default-value=256  # Please refer to the help of 'Checksum'.
      boolean XcpPageSwitching: set at pre-compile, origin=Vector Informatik, default-value=false  # If calibration page switching (PAG) is enabled the access mode calibration data segments can be set. Calibration data segments and their pages are specified by logical numbers.
      boolean XcpGeneralPagingInfo: set at pre-compile, origin=Vector Informatik, default-value=false  # If 'General Paging Info' is enabled the XCP command 'GET_PAG_PROCESSOR_INFO' returns general information on paging. The following information is transferred from the slave device to the master device: - The total number of segments - Whether the freeze mode is supported Specific information for segments or pages is so far not supported.
      boolean XcpCopyPage: set at pre-compile, origin=Vector Informatik, default-value=false  # If more than one calibration page is defined, the slave can copy a calibration page into another. In principle any page of any segment can be copied to any page of any segment. However, restrictions might be possible.
      boolean XcpFreezeMode: set at pre-compile, origin=Vector Informatik, default-value=false  # If enahble the commands SET_SEGMENT_MODE and GET_SEGMENT_MODE are enabled and forwarded to the application.
      boolean XcpProgramming: set at pre-compile, origin=Vector Informatik, default-value=false  # The option 'Programming' enables the programming of non-volatile memory. If the internal flash of the microcontroller cannot be programmed while execution of code from the flash, the 'bootloader download' functionality has to be used instead.
      integer XcpMinStPgm: 0..255, set at pre-compile, origin=Vector Informatik, default-value=0  # This parameter is evaluated by the XCP Master and defines the requested delay between two consecutive PROGRAM_NEXT frames. Increase this value if the Slave is not fast enough to process multiple PROGRAM_NEXT frames in Block Mode received during a short time frame. Please note that this is a feature that must be supported by the XCP Master.
      boolean XcpProcessorAndSectorInfo: set at pre-compile, origin=Vector Informatik, default-value=false  # The option 'Processor and Sector Info' enables the commands: - GET_PGM_PROCESSOR_INFO Transfers the general properties for programming and the total number of available sectors from the slave device to the master device. - GET_SECTOR_INFO Transfers information on a specific sector from the slave device to the master device.
      boolean XcpServiceRequestMessage: set at pre-compile, origin=Vector Informatik, default-value=false  # 'Service Request Messages' are always transmitted within service request packets (SERV) by the slave device, in order to request the master device to perform some action. The transmission is not guaranteed since service request packets are not acknowledged by the master device. Please also refer to the XCP Protocol Layer specification for the 'Table of service request codes'.
      boolean XcpPrintf: set at pre-compile, origin=Vector Informatik, default-value=false  # The function XcpPrint(..) can be used for the transmission of service request packets that contain text.
      boolean XcpEnableCalibration: set at pre-compile, origin=Vector Informatik, default-value=true  # The option 'Enable Calibration' unlocks the commands - DOWNLOAD - DOWNLOAD_NEXT - DOWNLOAD_MAX - SHORT_DOWNLOAD - MODIFY_BITS If this option is disabled, these commands will return an ERR_CMD_UNKNOWN error and calibration of parameters will not be possible!
      boolean XcpProgrammingWriteProtection: set at pre-compile, origin=Vector Informatik, default-value=false  # The option 'Programming Write Protection' enables the programming write protection of non-volatile memory.
      enumeration XcpTimeStampSize: {TIMESTAMP_SIZE_BYTE, TIMESTAMP_SIZE_WORD, TIMESTAMP_SIZE_DWORD}, set at pre-compile, origin=Vector Informatik, default-value=TIMESTAMP_SIZE_WORD
      boolean Xcp_ReadCCConfig: set at pre-compile, origin=Vector Informatik, default-value=false  # If the “Virtual FlexRay Parameters” feature is enabled, the parameters can be read out in a platform independent way. They will be provided as virtual measurement values that can be read at fixed memory locations.
      integer Xcp_ExtAddrReadCCConfig: 0..255, set at pre-compile, origin=Vector Informatik, default-value=253  # The "Virtual FlexRay Parameters" are accessible with this address extension.
      boolean XcpDevelopmentErrorDetection: set at pre-compile, origin=Vector Informatik, default-value=false  # Detecion of Development Errors like: - service call initialization - invalid channel handle - rejection of service calls All errors are reported to the Development Error Tracer (if available)
      boolean XcpGenericMeasurement: set at pre-compile, origin=Vector Informatik, default-value=false  # Generic Measurement is an extension which allows the Master to take addresses for an a2l update directly from the ECU instead of the map file.
      boolean XcpSessionStatusAPI: set at pre-compile, origin=Vector Informatik, default-value=false  # This API allows to determine the session status of the XCP. It can be used to check the status for keep ECU awake handling.
      boolean XcpAmdRuntimeMeasurement: set at pre-compile, origin=Vector Informatik, default-value=false  # This parameter defines if AMD Runtime Measurement (RTM) is enabled for this module.
      boolean XcpGetDAQEventInfo: set at pre-compile, origin=Vector Informatik, default-value=false  # The option 'Get DAQ Event Info' enables the XCP command GET_DAQ_EVENT_INFO. GET_DAQ_EVENT_INFO provides the following information about event channels: - Number of event channel - Name of event channel - Measurement cycle time of event channel - Direction of event channel: DAQ, STIM, DAQ&STIM
      boolean XcpSendQueueOverflowFirst: set at pre-compile, origin=Vector Informatik, default-value=false  # Send Queue replacement behaviour False: Linear buffer True: Ring buffer
      float XcpMainFunctionPeriod: set at pre-compile, origin=Vector Informatik, default-value=0.005
      boolean XcpVersionInfoApi: set at pre-compile, origin=Vector Informatik, default-value=false  # Enables/disables the existence of the Xcp_GetVersionInfo() API service true: Xcp_GetVersionInfo() API service exists false: Xcp_GetVersionInfo() API service does not exist
      boolean XcpVxSupport: set at pre-compile, origin=Vector Informatik, default-value=false  # Enables support for the Vx measurement hardware.
      boolean XcpGetIdGeneric: set at pre-compile, origin=Vector Informatik, default-value=false  # The XCP GET_ID command is used for identification purposes. This option enables an call-back that is called when the XCP Master sends the GET_ID command and can be used to return the requested information (e.g. Map Filename, EPK Number, ...)
      boolean XcpCustomCRC: set at pre-compile, origin=Vector Informatik, default-value=false  # The CustomCRC Option enables a call-back that allows the user to implement his own CRC calculation method instead of the built in methods.
      container XcpChannelConfig [0..*]  # This container contains the configuration (parameters) of the bus channel(s). The channel parameter shall be harmonized within the whole communication stack.
        reference XcpComMChannelRef [0..1]: set at pre-compile, origin=Vector Informatik, destination=ComMChannel  # This is needed for GENy module activation of non-AUTOSAR components.
    container XcpEvent [1..65535]  # XCP Protocol Layer event specific information
      string XcpName: set at pre-compile, origin=Vector Informatik
      integer XcpCycleTime: 0..65535, set at pre-compile, origin=Vector Informatik, default-value=0
      enumeration XcpEventInfoUnit: {DAQ_TIMESTAMP_UNIT_1NS, DAQ_TIMESTAMP_UNIT_10NS, DAQ_TIMESTAMP_UNIT_100NS, DAQ_TIMESTAMP_UNIT_1US, DAQ_TIMESTAMP_UNIT_10US, DAQ_TIMESTAMP_UNIT_100US, DAQ_TIMESTAMP_UNIT_1MS, DAQ_TIMESTAMP_UNIT_10MS, DAQ_TIMESTAMP_UNIT_100MS, DAQ_TIMESTAMP_UNIT_1S}, set at pre-compile, origin=Vector Informatik
      boolean XcpDAQ: set at pre-compile, origin=Vector Informatik, default-value=true
      boolean XcpSTIM: set at pre-compile, origin=Vector Informatik, default-value=false
      integer XcpEventId: 0..65535, set at pre-compile, origin=Vector Informatik, default-value=0  # This parameter specifies the ID of this Event Info
    container XcpSector [1..255]  # XCP Protocol Layer flash sector information
      integer XcpStartAddress: 0.., set at pre-compile, origin=Vector Informatik, default-value=0  # Start Address of Sector
      integer XcpEndAddress: 0.., set at pre-compile, origin=Vector Informatik, default-value=0  # End Address of Sector
      string XcpSectorName: set at pre-compile, origin=Vector Informatik  # Name of Sector
  bsw implementation Xcp_Impl: code-generator=GENy, programming-language=C, sw-major-version=2, sw-minor-version=04, sw-patch-version=00, vendor-id=30, ar-major-version=3, ar-minor-version=0, ar-patch-version=1, preconfigured-configuration=Xcp_Pre, recommended-configuration=Xcp_Rec, vendor-specific-module-def=Xcp
  module config Xcp_Pre: definition=Xcp
  module config Xcp_Rec: definition=Xcp
