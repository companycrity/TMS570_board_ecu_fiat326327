AUTOSAR XML (schema 3.0.1)
# COPYRIGHT
# Copyright (c) 2013 by Vector Informatik GmbH. All rights reserved.
# This software is copyright protected and proprietary to Vector Informatik GmbH.
# Vector Informatik GmbH grants to you only those rights as set out in the license conditions.
package /MICROSAR
  bsw implementation CanIf_Impl: code-generator=GENy, programming-language=C, sw-major-version=04, sw-minor-version=22, sw-patch-version=01, vendor-id=30, ar-major-version=3, ar-minor-version=0, ar-patch-version=1, preconfigured-configuration=CanIf_Pre, recommended-configuration=CanIf_Rec, vendor-specific-module-def=CanIf
  module definition CanIf [0..1]: refined-module-def=CanIf, variants pre-compile/link-time/post-build  # This container includes all necessary configuration sub-containers according the CAN Interface configuration structure.
    container CanIfControllerConfig [1..*]  # This container contains the configuration (parameters) of all addressed CAN controllers by each underlying CAN driver.
      enumeration CanIfWakeupSupport: {CONTROLLER, NO_WAKEUP, TRANSCEIVER, TRANSCEIVER_AND_CONTROLLER}, set at link in variant link-time+post-build / pre-compile in variant pre-compile, default-value=NO_WAKEUP  # Enables wakeup support and defines the source device of a wakeup event. 0 Wakeup by Controller 1 No Wakeup 2 Wakeup by Transceiver 3 Wakeup by Tansceiver and Controller
      integer CanIf_DoubleHashRandom1 [0..1]: -2147483648..2147483647, set at pre-compile in variant pre-compile / link in variant link-time / post-build in variant post-build, origin=Vector Informatik, default-value=0  # Attribute will not be imported and is not visible. Do not enter any parameter here.
      integer CanIf_DoubleHashRandom2 [0..1]: -2147483648..2147483647, set at pre-compile in variant pre-compile / link in variant link-time / post-build in variant post-build, origin=Vector Informatik, default-value=0
      boolean CanIfChPnWuTxPduFilterSupport: set at pre-compile in variant pre-compile / link in variant link-time / post-build in variant post-build, origin=Vector Informatik, default-value=false  # Activate this if you want to support Tx Pdu filtering in case of partial networking wakeup on this channel. Tx Pdus which pass the filter are set up via 'Tx Pdu Pn Filter Pdu'. RESTRICTIONS: This parameter is only editable if 'Pn Wakeup Tx Pdu Filter Support' is activated.
      reference CanIfDriverNameRef: set at link in variant link-time+post-build / pre-compile in variant pre-compile, destination=CanIfDriverConfig  # Refers to the CAN Driver Name to which the controller belongs to. This parameter refers to CanIfDriverConfig container. not used.
      reference CanIfInitControllerRef: set at link in variant link-time+post-build / pre-compile in variant pre-compile, destination=CanIfInitControllerConfig  # Reference to the Init Controller Configuration.
      symbolic name reference CanIfControllerIdRef [0..*]: set at pre-compile in variant pre-compile / link in variant link-time+post-build, destination=CanController  # Logical handle of the underlying CAN controller to be served by the CAN Interface. Range: 0..max. number of underlying supported
    container CanIfDispatchConfig [0..1]  # Callout functions with respect to the upper layers. This callout functions defined in this container are common to all configured underlying CAN Drivers / CAN Transceiver Drivers.
      function name CanIfBusOffNotification: set at link in variant link-time+post-build / pre-compile in variant pre-compile, default-value=CanSM_ControllerBusOff  # Enter the name of the BusOff indication call back function used in the stack. (e.g. ComM_CanIf_BusOffIndication)
      function name CanIfWakeupNotification [0..1]: set at pre-compile in variant pre-compile / link in variant link-time+post-build, default-value=EcuM_SetWakeupEvent  # Enter the name of the WakeupEvent notification call back function used in the stack. (e.g. EcuM_SetWakeupEvent). If parameter is 0 no call-out function is configured.
      function name CanIfWakeupValidNotification [0..1]: set at pre-compile in variant pre-compile / link in variant link-time+post-build, default-value=EcuM_ValidateWakeupEvent  # Name of target Wakeup Validation notification services to target upper layers (ECU State Manager). If parameter is 0 no call-out function is configured.
    container CanIfDriverConfig [1..*]  # Configuration parameters for all the underlying CAN drivers are aggregated under this container.
      boolean CanIfBusoffNotification: set at link in variant link-time+post-build / pre-compile in variant pre-compile, default-value=true  # Selects whether BusOff indication notification is supported. True: Enabled False: Disabled
      boolean CanIfReceiveIndication: set at link in variant link-time+post-build / pre-compile in variant pre-compile, default-value=true  # Selects whether receive indication notification is supported. True: Enabled False: Disabled Will not be imported, only exported.
      boolean CanIfTransmitCancellation: set at pre-compile, default-value=true  # Enables/disables internal cancellation to prevent internal priority inversion. If this feature is enabled and the underlying CAN Driver supports cancellation from message objects low priority PDUs will be removed from the hardware object by the CAN Driver and inserted into the transmit buffer in the CAN Interface. True: Enabled False: Disabled
      boolean CanIfTxConfirmation: set at link in variant link-time+post-build / pre-compile in variant pre-compile, default-value=true  # Selects whether transmit confirmation notification is supported. Will not be imported, only exported.
      boolean CanIfWakeupNotification: set at pre-compile, default-value=true  # Selects whether wakeup indication notification is supported. True: Enabled False: Disabled
      reference CanIfDriverNameRef: set at pre-compile, destination=CanGeneral  # CAN Interface Driver Reference. This reference can be used to get any information (Ex. Driver Name, Vendor ID) from the CAN driver. The CAN Driver name can be derived from the ShortName of the CAN driver module. Not used.
      reference CanIfInitHohConfigRef: set at link in variant link-time+post-build / pre-compile in variant pre-compile, destination=CanIfInitHohConfig  # Reference to the Init Hoh Configuration
    container CanIfInitConfiguration [1..*]: multiple-configuration-container=true  # This container contains the init parameters of the CAN Interface.
      string CanIfConfigSet: set at link in variant link-time / pre-compile in variant pre-compile / post-build in variant post-build, default-value=Default  # Will only be exported and set to "CanIFConfig0". No import.
      integer CanIfNumberOfCanRxPduIds: 0..4294967295, set at link in variant link-time / pre-compile in variant pre-compile / post-build in variant post-build, default-value=0  # Total number of CanRxPduIds to be handled. Range: 0..max number of defined CanRxPduIds
      integer CanIfNumberOfCanTXPduIds: 0..4294967295, set at link in variant link-time / pre-compile in variant pre-compile / post-build in variant post-build, default-value=0  # Total number of CanTxPduIds to be handled. Range: 0..max number of defined CanTxPduIds
      integer CanIfNumberOfDynamicCanTXPduIds: 0..4294967295, set at link in variant link-time / pre-compile in variant pre-compile / post-build in variant post-build, default-value=0  # Total number of dynamic CanTxPduIds to be handled. Range: 0..max. nember of defined CanTxPduIds
      container CanIfInitControllerConfig [0..*]  # This container contains the references to the configuration setup of each underlying CAN driver.
        symbolic name reference CanIfControllerRefConfigSet: set at pre-compile, destination=CanController  # References the corresponding CAN Controller configuration setup of the corresponding CAN Driver. not used.
      container CanIfInitHohConfig [0..*]  # This container contains the references to the configuration setup of each underlying CAN Driver.
        reference CanIfRefConfigSet: set at link in variant link-time / pre-compile in variant pre-compile / post-build in variant post-build, destination=CanConfigSet  # Selects the CAN Interface specific configuration setup. This type of external data structure shall contain the post build initialization data for the CAN Interface for all underlying CAN Drivers.
        container CanIfHrhConfig [0..*]  # This container contains configuration parameters for each hardware receive object (HRH).
          enumeration CanIfHrhType: {BASIC_CAN, FULL_CAN}, set at pre-compile in variant pre-compile / link in variant link-time / post-build in variant post-build, default-value=BASIC_CAN  # Defines the HRH type i.e, whether its a BasicCan or FullCan. If BasicCan is configured, software filtering is enabled.
          boolean CanIfSoftwareFilterHrh: set at link in variant link-time+post-build / pre-compile in variant pre-compile, default-value=true  # Selects the hardware receive objects by using the HRH range/list from CAN Driver configuration to define, for which HRH a software filtering has to be performed at during receive processing. True: Software filtering is enabled False: Software filtering is enabled
          reference CanIfCanControllerHrhIdRef: set at link in variant link-time+post-build / pre-compile in variant pre-compile, destination=CanIfControllerConfig  # Reference to controller Id to which the HRH belongs to. A controller can contain one or more HRHs.
          symbolic name reference CanIfHrhIdSymRef: set at pre-compile in variant pre-compile / link in variant link-time / post-build in variant post-build, destination=CanHardwareObject  # The parameter refers to a particular HRH object in the CAN Driver Module configuration. The HRH id is unique in a given CAN Driver. The HRH Ids are defined in the CAN Driver Module and hence it is derived from CAN Driver Configuration.
          container CanIfHrhRangeConfig [0..*]  # Defines the parameters required for configuraing multiple CANID ranges for a given same HRH.
            integer CanIfRxPduLowerCanId: 0..4294967295, set at link in variant link-time / pre-compile in variant pre-compile / post-build in variant post-build, default-value=0  # Lower CAN Identifier of a receive CAN L-PDU for identifier range definition, in which all CAN Ids shall pass the software filtering. Range: 11 Bit for Standard CAN Identifier 29 Bit for Extended CAN Identifer Will only get imported. No export!
            integer CanIfRxPduUpperCanId: 0..4294967295, set at link in variant link-time / pre-compile in variant pre-compile / post-build in variant post-build, default-value=0  # Upper CAN Identifier of a receive CAN L-PDU for identifier range definition, in which all CAN Ids shall pass the software filtering. Range: 11 Bit for Standard CAN Identifier 29 Bit for Extended CAN Identifer Will only get imported. No export!
        container CanIfHthConfig [0..*]  # This container contains parameters related to each HTH.
          enumeration CanIfHthType: {BASIC_CAN, FULL_CAN}, set at link in variant link-time+post-build / pre-compile in variant pre-compile, default-value=BASIC_CAN  # If you enable 'Tx FullCAN' for a message, the message is assigned to a FullCAN object. A FullCAN message is handled in a dedicated hardware object and is therefore not influenced or blocked by messages with lower priority. For more information about 'FullCAN' see TechnicalReference_CANDriver.pdf.
          reference CanIfCanControllerIdRef: set at link in variant link-time+post-build / pre-compile in variant pre-compile, destination=CanIfControllerConfig  # Reference to controller Id to which the HTH belongs to. A controller can contain one or more HTHs.
          symbolic name reference CanIfHthIdSymRef: set at pre-compile in variant pre-compile / link in variant link-time / post-build in variant post-build, destination=CanHardwareObject  # The parameter refers to a particular HTH object in the CAN Driver Module configuration. The HTH id is unique in a given CAN Driver. The HTH Ids are defined in the CAN Driver Module and hence it is derived from CAN Driver Configuration.
      container CanIfRxPduConfig [0..*]  # This container contains the configuration (parameters) of each receive CAN L-PDU. The SHORT-NAME of "CanIfRxPduConfig" container itself represents the symolic name of Receive L-PDU.
        integer CanIfCanRxPduCanId: 0..536870911, set at link in variant link-time / pre-compile in variant pre-compile / post-build in variant post-build, default-value=0  # This is the identifier of the selected message respectively frame.
        integer CanIfCanRxPduDlc: 0..8, set at link in variant link-time / pre-compile in variant pre-compile / post-build in variant post-build, default-value=8  # This is the length of the selected message respectively frame in bytes.
        integer CanIfCanRxPduId: 0..4294967295, set at link in variant link-time / pre-compile in variant pre-compile / post-build in variant post-build, symbolic-name-value=true, default-value=0  # Each CAN message contains a CAN identifier. For the CAN identifier two types are defined: 'Standard Identifier' and 'Extended Identifier'. If the checkbox is clicked the selected message contains an 'Extended Identifier', otherwise it contains a 'Standard Identifier'.
        boolean CanIfReadRxPduData: set at link in variant link-time / pre-compile in variant pre-compile / post-build in variant post-build, default-value=false  # Enables and disables the Rx buffering for reading of received L-PDU data. True: Enabled False: Disabled Not used.
        boolean CanIfReadRxPduNotifyStatus: set at link in variant link-time / pre-compile in variant pre-compile / post-build in variant post-build, default-value=false  # Enables and disables receive indication for each receive CAN L-PDU for reading its' notification status. Not used.
        enumeration CanIfRxPduIdCanIdType: {EXTENDED_CAN, STANDARD_CAN}, set at link in variant link-time / pre-compile in variant pre-compile / post-build in variant post-build, default-value=STANDARD_CAN  # CAN Identtifier of receive CAN L-PDUs used by the CAN Driver for CAN L-PDU reception.
        enumeration CanIfRxUserType: {CAN_NM, CAN_TP, PDUR, APPL}, set at link in variant link-time / pre-compile in variant pre-compile / post-build in variant post-build, default-value=APPL  # This parameter defines the type of the receive indication call-outs called to the corresponding upper layer the used TargetRxPduId belongs to.
        function name CanIfUserRxIndication: set at pre-compile in variant pre-compile / link in variant link-time / post-build in variant post-build, default-value=NULL_PTR  # Name of target indication services to target upper layers (PduRouter, CanNm, CanTp and ComplexDeviceDrivers). If parameter is 0 no call-out function is configured.
        boolean CanIf_DlcCheck: set at pre-compile in variant pre-compile / link in variant link-time / post-build in variant post-build, origin=Vector Informatik, default-value=true  # Activate/Deactivate the message specific DLC check. If this attribute is disabled, no DLC check will be executed during the reception of this message
        boolean CanIf_FullCANLocked [0..1]: set at pre-compile in variant pre-compile / link in variant link-time / post-build in variant post-build, origin=Vector Informatik, default-value=false  # If the FullCAN attribute is locked, it cannot be changed by the filter optimization or any other component.
        function name CanIfUserDlcErrorNotification [0..1]: set at pre-compile in variant pre-compile / link in variant link-time / post-build in variant post-build, origin=Vector Informatik, default-value=NULL_PTR  # Enter the name of the DLC error notification call back function used in the stack. (e.g. User_DlcErrorNotification)
        reference CanIfCanRxPduHrhRef [0..*]: set at link in variant link-time / pre-compile in variant pre-compile / post-build in variant post-build, destination=CanIfHrhConfig  # The HRH to which Rx L-PDU belongs to, is referred through this parameter.
        reference PduIdRef: set at pre-compile in variant pre-compile / link in variant link-time / post-build in variant post-build, destination=Pdu  # Reference to the "global" Pdu structure to allow harmonization of handle IDs in the COM-Stack.
      container CanIfTxPduConfig [0..*]  # This container contains the configuration (parameters) of each transmit CAN L-PDU. The SHORT-NAME of "CanIfTxPduConfig" container represents the symolic name of Transmit L-PDU.
        integer CanIfCanTxPduId: 0..4294967295, set at link in variant link-time / pre-compile in variant pre-compile / post-build in variant post-build, symbolic-name-value=true, default-value=0  # ECU wide unique, symbolic handle for transmit CAN L-PDU. The CanIfCanTxPduId is configurable at pre-compile and post-built time. Range: 0..max. number of CantTxPduIds
        integer CanIfCanTxPduIdCanId: 0..536870911, set at link in variant link-time / pre-compile in variant pre-compile / post-build in variant post-build, default-value=0  # CAN Identifier of transmit CAN L-PDUs used by the CAN Driver for CAN L-PDU transmission. Range: 11 Bit For Standard CAN Identifier ... 29 Bit For Extended CAN identifier
        integer CanIfCanTxPduIdDlc: 0..8, set at link in variant link-time / pre-compile in variant pre-compile / post-build in variant post-build, default-value=8  # Data length code (in bytes) of transmit CAN L-PDUs used by the CAN Driver for CAN L-PDU transmission. The data area size of a CAN L-Pdu can have a range from 0 to 8 bytes.
        enumeration CanIfCanTxPduType: {DYNAMIC, STATIC}, set at link in variant link-time / pre-compile in variant pre-compile / post-build in variant post-build, default-value=STATIC  # Defines the type of each transmit CAN L-PDU.
        boolean CanIfReadTxPduNotifyStatus: set at link in variant link-time / pre-compile in variant pre-compile / post-build in variant post-build, default-value=false  # Enables and disables transmit confirmation for each transmit CAN L-PDU for reading its notification status. True: Enabled False: Disabled
        enumeration CanIfTxPduIdCanIdType: {EXTENDED_CAN, STANDARD_CAN}, set at pre-compile in variant pre-compile / link in variant link-time / post-build in variant post-build, default-value=STANDARD_CAN  # CAN Identifier type (ext. or std.) of transmit CAN L-PDUs used by the CAN Driver for CAN L-PDU transmission.
        enumeration CanIfTxUserType: {CAN_NM, CAN_TP, PDUR, APPL}, set at link in variant link-time / pre-compile in variant pre-compile / post-build in variant post-build, default-value=APPL  # This parameter defines the type of the transmit confirmation call-out called to the corresponding upper layer the used TargetTxPduId belongs to.
        function name CanIfUserTxConfirmation [0..1]: set at pre-compile in variant pre-compile / link in variant link-time / post-build in variant post-build, default-value=Dummy  # Name of target confirmation services to target upper layers (PduR, CanNm and CanTp. If parameter is not configured then no call-out function is provided by the upper layer for this Tx L-PDU.
        integer CanIfCanTxUpperLayerPduId [0..1]: 0..4294967295, set at link in variant link-time / pre-compile in variant pre-compile / post-build in variant post-build, origin=Vector Informatik, default-value=0  # TxPduId provided by the upper layer (Module wide unique). The function CanIfWrapper_Transmit has to be called if those PduIDs are used for transmission. Range: 0..max. number of CanTxPduIds
        boolean CanIfTxPduPnFilterPdu [0..1]: set at pre-compile in variant pre-compile / link in variant link-time / post-build in variant post-build, origin=Vector Informatik  # If CanIfTxPduPnFilterPdu is enabled, by this parameter PDUs could be configured which will pass the CanIfPnFilter. If there is no CanIfTxPduPnFilterPdu configured per controller, the corresponding controller applies no CanIfPnFilter.
        reference CanIfCanTxPduHthRef [0..*]: set at link in variant link-time / pre-compile in variant pre-compile / post-build in variant post-build, destination=CanIfHthConfig  # Handle, that defines the hardware object or the pool of hardware objects configured for transmission. The parameter refers HTH Id, to which the L-PDU belongs to.
        reference PduIdRef: set at pre-compile in variant pre-compile / link in variant link-time / post-build in variant post-build, destination=Pdu  # Reference to the "global" Pdu structure to allow harmonization of handle IDs in the COM-Stack.
      container CanIf_RangeConfig [0..*]  # A Range config corresponds to a Range of a channel in the Vector-Geny tool-component CanIf. Such a range maps any incoming message matching the filter to a callback function which may be set by the user. Thus, it may also map messages which are not configured in the system via CanIfRxPduConfig. Thus, one may compare the notion CanIf_RangeConfig to the notion of CanIfRxPduConfig with the difference that it does not refer to a certain message but to a set of possibly unkown messages. Similar to the CanIfRxPduConfig, it also refers to a hardware object containing the actual values for this range. However, since Geny stores the range via code and mask, the corresponding attributes are also stored in the CanIf_RangConfig container rather then in the CanIfHrhRangeConfig container.
        function name CanIf_UserRxIndication: set at pre-compile in variant pre-compile / link in variant link-time / post-build in variant post-build, origin=Vector Informatik, default-value=Dummy  # Choose an RxIndication function from CanIf_Vector/CanIf_RxIndicationFunction/CanIf_RxIndicationFunctionName. If no indication call back is required set the attribute to "0"
        integer CanIf_RangeConfigMask: 0..536870911, set at pre-compile in variant pre-compile / link in variant link-time / post-build in variant post-build, origin=Vector Informatik, default-value=0  # 'Code' and 'Mask' together declare the range in which the messages are received (ID&mask==code). Specify the 'Mask' to select the ID range.
        integer CanIf_RangeConfigCode: 0..536870911, set at pre-compile in variant pre-compile / link in variant link-time / post-build in variant post-build, origin=Vector Informatik, default-value=0  # "Code" and "Mask" together declare the range in which the messages are received (ID&mask==code). Specify the code by masking the ID that matches the selected range."
        boolean CanIf_RangeConfigExtendedIds: set at pre-compile in variant pre-compile / link in variant link-time / post-build in variant post-build, origin=Vector Informatik, default-value=false  # Selects whether the configued range receives messages with extented ID or standard ID format True: Extended ID format False: Standard ID format
        boolean CanIf_RangeConfigDisableDlcCheck: set at pre-compile in variant pre-compile / link in variant link-time / post-build in variant post-build, origin=Vector Informatik, default-value=false  # Selects whether DLC check is enabled. True: Enabled False: Disabled
        boolean CanIf_RangeConfigHandledByGeny: set at pre-compile in variant pre-compile / link in variant link-time / post-build in variant post-build, origin=Vector Informatik, default-value=false  # Will be set if ranges are configured for CanInterface. Attribute will not be imported, only exported.
        integer CanIf_RangeConfigMinimumDLC: 0..8, set at pre-compile in variant pre-compile / link in variant link-time / post-build in variant post-build, origin=Vector Informatik, default-value=0  # The minimum data length for all messages which pass the range can be specified. This minimum length is used for the DLC check if the DLC check is globally activated and not deactivated for the range. Selects whether DLC check for defined range is enabled. True: Enabled False: Disabled
        integer CanIf_RangeRxPduId: 0..4294967295, set at pre-compile in variant pre-compile / link in variant link-time / post-build in variant post-build, origin=Vector Informatik, symbolic-name-value=true, default-value=0  # The RxPduId is the symbolic handle which is passed to upper layers within the RxIndication function.
        reference CanIf_RangeConfigHrhRef: set at pre-compile in variant pre-compile / link in variant link-time / post-build in variant post-build, origin=Vector Informatik, destination=CanIfHrhConfig  # The HRH to which this range belongs to, is referred through this parameter.
    container CanIfPrivateConfiguration  # This container contains the private configuration (parameters) of the CAN Interface.
      boolean CanIfDlcCheck: set at pre-compile, default-value=true  # Enables DLC check for Rx PDUs. If enabled the DLC of received messages will be checked against the DLC of the message specified in the database. If the received DLC is smaller than the specified DLC the reception is abandoned.
      integer CanIfNumberOfTxBuffers: 0..4294967295, set at pre-compile in variant pre-compile / link in variant link-time / post-build in variant post-build, default-value=0  # Represents the currently used Transmit Buffer size. For pre-compile and link-time variant the size of the transmit buffer equals to the size of the currenltly used elements in the transmit buffer."
      integer CanIfNumberOfDynamicTxBuffers: 0..4294967295, set at pre-compile, origin=Vector Informatik, default-value=0  # Defined the number of L-PDU elements for the transmit buffering. The Tx L-PDU buffers shall be used to store an L-PDU once for each different L-PDU handle. Range: 0..max. number of Tx L-PDUs to be used. Default Value: NUMBER_OF_TX_PDUS
      enumeration CanIfSoftwareFilterType: {BINARY, INDEX, LINEAR, TABLE, DOUBLEHASH}, set at pre-compile, default-value=LINEAR  # Choose between linear, binary and double hash search algorithm: Linear Search: very efficient for a small amount of Rx PDUs. Search time increases linearly for Rx PDUs with low priority Binary Search: nearly constant search time for all PDUs. More efficient for big amounts of Rx PDUs Double Hash: always constant search time for all PDUs.
      integer CanIf_DoubleHashAdditionalMemory [0..1]: 0..65535, set at pre-compile in variant pre-compile / link in variant link-time / post-build in variant post-build, origin=Vector Informatik, default-value=0  # Additional memory consumption in case of DoubleHash search is used instead of linear search.
      boolean CanIf_TransceiverMapping: set at pre-compile, origin=Vector Informatik, default-value=false  # CAN Interface will map the transceiver index received by an upper layer to one or more different transceiver drivers
      boolean CanIf_TransceiverHandling: set at pre-compile, origin=Vector Informatik, default-value=false  # The CAN Interface will provide the API to control an AUTOSAR Transceiver Driver
      boolean CanIf_SupportExtendedIds: set at pre-compile, origin=Vector Informatik  # Support extended IDs: True: Enabled False: Disabled
      string CanIf_UserConfigFile: set at pre-compile, origin=Vector Informatik  # A configuration file is generated by GENy. If you want to overwrite settings in the generated configuration file, you can specify a path to a user defined configuration file.The user defined configuration file will be included at the end of the generated file. Therefore definitions in the user defined configuration file can overwrite definitions in the generated configuration file.The contents of the user defined configuration file is copied to the end of CanIf_Cfg.h.
      boolean CanIf_TransmitCancellationAPI: set at pre-compile, origin=Vector Informatik, default-value=false  # Enables/disables an API function to allow higher layers to cancel the transmission of PDUs. These PDUs will either be removed from the transmit buffer or directly from the message object if supported by the CAN driver. In both cases the Tx confirmation function will be suppressed.
      boolean CanIf_SupportNmOsek: set at pre-compile, origin=Vector Informatik  # Enables/disables an further type of RxIndication functions which is used to pass the received CAN Identifier to the NmOsek.
      boolean CanIf_BusOffRecovery: set at pre-compile, origin=Vector Informatik, default-value=false  # Enables the functions CanIf_ResetBusOffStart and CanIf_ResetBusOffEnd. These functions may be used by non AUTOSAR network management layers to recover from bus off. This feature can only be used if the CAN Driver supports this functionality as well.
      boolean CanIf_ExtendedStateMachine: set at pre-compile, origin=Vector Informatik, default-value=false  # Activates modifications to the state machine for non AUTOSAR compliant layers. Several state transitions will be affected if this feature is activated. (The state machine will not be AUTOSAR compliant)
      integer CanIf_StartAddress: 0..4294967295, set at pre-compile in variant pre-compile / link in variant link-time+post-build, origin=Vector Informatik, default-value=0  # This setting is mandatory when generating a configuration that will be written to the memory of your ECU at post-build time (i.e. when generating a hex-file). This setting is not relevant when generating the initial ECU configuration at link- or pre-compile time (i.e. when generating a C-file that will be linked with your project). The Modul Start Address must specify the start address of the memory area, where the generated hex-file will be mapped to. If the ECU supports selectable post-build configuration, the Modul Start Address can be any location that is accessible for the BSW module. If selectable post-build configuration is not supported by your ECU, the Modul Start Address must be the same address to which the initial configuration was mapped. Please see to your linker map file to get this address.
      integer CanIf_MaxControllerTableSize: 0..4294967295, set at pre-compile in variant pre-compile / link in variant link-time+post-build, origin=Vector Informatik, default-value=0  # The number of controllers can be changed at post-build time (Variant 3). This number specifies the maximum amount of usable controllers in the system. The current number of controllers is derived from the currently used amount of channels/databases. Refer to the CAN Driver's manual for the maximum number of supported controllers.
      boolean CanIf_Autosar21_ComM_Compliance: set at pre-compile, origin=Vector Informatik, default-value=false  # Activate compatibility to AUTOSAR 2.1. If this feature is activated the API of the CAN Interface is able to communicate with a AUTOSAR 2.1 compliant implementation of the ComM. This feature does not support a full AUTOSAR 2.1 compliance.
      boolean CanIfDlcFailedReportDem [0..1]: set at pre-compile, origin=Vector Informatik, default-value=true  # Specifies if reporting of the production error CANIF_E_INVALID_DLC to the module DEM shall be supported. True: Reporting enabled (default) False: Reporting disabled
      boolean CanIf_SupportConfigULPduIDCalc [0..1]: set at pre-compile, origin=Vector Informatik, default-value=false  # If this feature is activated the automatic calculation of RxPduIds is suppress (RxPduIds which are passed to the upper layers in the RxIndication function) and can be activated for single RxIndication callbacks (e.g. for one or several modules/higher layers).The RxPduIDs from the EcuC file will be imported and used for RxPduId parameter in the RxIndication function.
      boolean CanIf_AsrIfCan_IsLibrarySolution [0..1]: set at pre-compile in variant pre-compile / link in variant link-time+post-build, origin=Vector Informatik, default-value=false  # Specifies if the module is a library delivery or a source code delivery. This attribute (If_AsrIfCan_IsLibrarySolution) is suggested to be pre-configured at any time by setting the attribute to its desired value and by disabling the attribute itself.
      boolean CanIfOptimizeOneController: set at pre-compile, origin=Vector Informatik, default-value=false  # Optimize runtime for One Controller system. RESTRICTIONS: 'CanOptimizeOneController' does only work when one controller is used, and limited to one controller in case of postbuild (CanIf_MaxControllerTableSize).
      integer CanIf_DoubleHashAdjustCount [0..1]: 0..65535, set at pre-compile in variant pre-compile / link in variant link-time / post-build in variant post-build, origin=Vector Informatik, default-value=0  # Number of elements for the DoubleHash adjust table. Will not be imported.
      boolean CanIf_DynamicTxBuffersApi: set at pre-compile, origin=Vector Informatik, default-value=false  # Enables the feature dynamic Tx messages
      integer CanIf_MaxNumberOfTxPDUs: 0..65536, set at pre-compile in variant pre-compile / link in variant link-time / post-build in variant post-build, origin=Vector Informatik, default-value=0  # The maximum number of Tx PDUs over all channels. This parameter is only relevant if the Bitqueue is activated. For Bytequeue no declaration is necessary. For link time and precompile configurations the value will be computed, for postbuild configurations the parameter CanIfMaxNumberOfTxPDUs will be used.
      enumeration CanIf_TxBufferAPI: {None, Byte_queue, Bit_queue}, set at pre-compile, origin=Vector Informatik, symbolic-name-value=true, default-value=None  # Selects if and how the standard Tx object PDUs are buffered: None: Tx PDUs are not buffered at all Byte queue: Tx PDUs are buffered. Each flag for every standard Tx object PDU consumes one byte Bit queue: Tx PDUs are buffered. Less RAM and a little bit more runtime is consumed against Byte queue.
      boolean CanIfDlcCheckOptimization: set at pre-compile, origin=Vector Informatik, default-value=true  # Use this parameter to choose between DLC check against optimized DLC or not optimized DLC. Optimized DLC means that only data bytes of a CAN message which are allocated by defined signals within your data base are taken into account of calculation of DLC which is used for DLC check. Not optimized DLC means that the specified DLC of a CAN message within you data base is used for DLC check independent of allocation of data bytes by signals. If enabled DLC check against optimized DLC is performed. If disabled DLC check against NOT optimized DLC is performed. RESTRICTION: This paramter is only editable if 'DLC Check' is enabled.
    container CanIfPublicConfiguration  # This container contains the public configuration (parameters) of the CAN Interface.
      boolean CanIfDevErrorDetect: set at pre-compile, default-value=true  # If 'Development Error Detection' is enabled, all development errors are reported to the Development Error Tracer (DET). The errors are described in the [TechnicalReference_Asr_CanIf.pdf]. Note: In general, the development error detection is recommended during pre-test phase. It is not recommended to enable the development error detection in production code due to increased runtime and ROM needs. True: Enabled False: Disabled
      boolean CanIfMultipleDriverSupport: set at pre-compile, default-value=true  # Selects support for multiple CAN Drivers. True: Enabled False: Disabled Not used.
      integer CanIfNumberOfCanHwUnits: 1..4294967295, set at link in variant link-time+post-build / pre-compile in variant pre-compile, default-value=1  # Number of served CAN hardware units. Range: 1..max. number of underlying supported CAN Hardware units
      boolean CanIfReadRxPduDataApi: set at pre-compile, default-value=false  # if this attribute is disabled the function CanIf_ReadRxPduData will not be available in the CAN Interface. This function can be used within the Rx indication to acquire data and length from the currently received message. True: Enabled False: Disabled
      boolean CanIfReadRxPduNotifyStatusApi: set at pre-compile, default-value=false  # Enables and disables the API for reading the received L-PDU data. True: Enabled False: Disabled Not used.
      boolean CanIfReadTxPduNotifyStatusApi: set at pre-compile, default-value=false  # Enables and disables the API for reading the notification status of transmit and receive L-PDUs. True: Enabled False: Disabled Not used.
      boolean CanIfSetDynamicTxIdApi: set at pre-compile, default-value=false  # Enables and disables the API for reconfiguration of the CAN Identifier for each Transmit L-PDU. True: Enabled False: Disabled Not used.
      boolean CanIfVersionInfoApi: set at pre-compile, default-value=true  # Enables function CanIf_GetVersionInfo() to get major, minor and patch version information. True: Enabled False: Disabled
      boolean CanIfWakeupEventApi: set at pre-compile, default-value=true  # Enables/Disables the sleep/wake up support in the CAN Interface. If this feature is enabled the function CanIf_ControllerWakeup and thus support of the Sleep mode will be available in the CAN Interface True: Enabled False: Disabled
      boolean CanIfProdErrorDetect: set at pre-compile, origin=Vector Informatik, default-value=true  # If 'Production Error Detection' is enabled, production relevant errors are reported to the Diagnostics Event Manager (DEM). Disable this option, if no DEM is present in your system.
      boolean CanIfPnWakeupTxPduFilterSupport: set at pre-compile, origin=Vector Informatik, default-value=false  # Enables featue 'Partial networking Tx Pdu Filter' On Wakeup the CanIf will block every Tx message to transmit with exception of the configured one. Tx Pdus which pass the filter has to be configured CAN channel specific via 'CanIfTxPduPnFilterPdu'
      boolean CanIfPnTrcvHandlingSupport: set at pre-compile, origin=Vector Informatik, default-value=false  # Switch for activating/deactivating transceiver handling concerning feature 'Partial Networking'
      boolean CanIfPublicTxConfirmPollingSupport: set at pre-compile, origin=Vector Informatik  # Configuration parameter to enable/disable the API to poll for Tx Confirmation state.
      boolean CanIfPublicPnSupport: set at pre-compile, origin=Vector Informatik  # Selects support of Partial Networking features in CanIf. True: Enabled False: Disabled
      boolean CanIfAmdRuntimeMeasurement: set at pre-compile, origin=Vector Informatik, default-value=false  # This parameter defines if AMD Runtime Measurement (RTM) is enabled for this module.
    container CanIfTransceiverDrvConfig [1..*]  # This container contains the configuration (parameters) of all addressed CAN transceivers by each underlying CAN Transceiver Driver.
      boolean CanIfTrcvWakeupNotification: set at pre-compile in variant pre-compile / link in variant link-time+post-build, default-value=false  # Selects whether wakeup indication notification is supported. True: Enabled False: Disabled Not used.
      symbolic name reference CanIfTrcvIdRef [0..*]: set at pre-compile, destination=CanTrcvChannel  # Logical handle of the underlying CAN transceiver to be served by the CAN Interface. Not used.
    container CanIf_TxConfirmationFunction [1..*]
      string CanIf_TxConfirmationFunctionName: set at pre-compile in variant pre-compile / link in variant link-time+post-build, origin=Vector Informatik, default-value=NULL_PTR  # Enter the names of all TxConfirmation call back functions used in the stack. Each Tx message of the ECU can get assigned to one of the TxIndications which are entered here.
    container CanIf_RxIndicationFunction [1..*]
      string CanIf_RxIndicationFunctionName: set at pre-compile in variant pre-compile / link in variant link-time+post-build, origin=Vector Informatik, default-value=NULL_PTR  # Enter the names of all RxIndication call back functions used in the stack. Each Rx Message of the ECU can get assigned to one of the RxIndications which are entered here.
      enumeration CanIf_RxIndicationFunctionType: {TYPE_I_STANDARD, TYPE_II_ADVANCED, TYPE_III_NM_OSEK}, set at pre-compile in variant pre-compile / link in variant link-time+post-build, origin=Vector Informatik, default-value=TYPE_I_STANDARD  # Choose the type of RxIndication function: Type I: Standard: (used by NM and PduR) Prototype: 'RxIndication'(PduIdType CanRxPduId, const uint8* CanSduPtr); Type II: Advanced: (used by TP) Prototype: 'RxIndication'(PduIdType CanRxPduId, const PduInfoType* PduInfoPtr); Type III: OsekNm: (deviation from Autosar standard. Can only be used if "NmOsek RxIndication API support" is enabled) 'RxIndication'(PduIdType CanRxPduId, const uint8* CanSduPtr, Can_IdType CanId);
      boolean CanIf_AutoCalculateRxPduIds [0..1]: set at pre-compile in variant pre-compile / link in variant link-time / post-build in variant post-build, origin=Vector Informatik, default-value=true  # Not used.
    container VectorCommonData
      string BswmdVersion: configuration-class-affection=affection-kind=NO-AFFECT, set at published-information, origin=Vector Informatik, default-value=2.23.01  # Version of this file.
  module config CanIf_Pre: definition=CanIf
  module config CanIf_Rec: definition=CanIf
