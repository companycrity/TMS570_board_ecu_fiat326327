AUTOSAR XML (schema 3.2.1)
# COPYRIGHT
# Copyright (c) 2013 by Vector Informatik GmbH. All rights reserved.
# This software is copyright protected and proprietary to Vector Informatik GmbH.
# Vector Informatik GmbH grants to you only those rights as set out in the license conditions.
package /MICROSAR/CanTrcv_Generic1CanDio
  bsw implementation CanTrcv_Impl: code-generator=cMICROSAR,GENy, programming-language=C, sw-major-version=3, sw-minor-version=1, sw-patch-version=0, vendor-id=30, ar-major-version=1, ar-minor-version=4, ar-patch-version=0, preconfigured-configuration=CanTrcv_Pre, recommended-configuration=CanTrcv_Rec, vendor-api-infix=__Your_Trcv__, vendor-specific-module-def=CanTrcv
  module definition CanTrcv: refined-module-def=CanTrcv, variants post-build/pre-compile  # Configuration of the CanTrcv (CAN Transceiver driver) module.
    container CanTrcvConfigSet: multiple-configuration-container=true  # This is the multiple configuration set container for CAN Transceiver.
      integer CanTrcvSPICommRetries [0..1]: 0..255, set at post-build in variant post-build / pre-compile in variant pre-compile, default-value=0  # Not used. Indicates the maximum number of communication retries in case of a failed SPI communication (applies both to timed out communication and to errors/NACK in the response data). If configured value is '0', no retry is allowed (communication is expected to succeed at first try).
      integer CanTrcvSPICommTimeout [0..1]: 0..100, set at post-build in variant post-build / pre-compile in variant pre-compile, default-value=0  # Not used. Indicates the maximum time allowed to the CanTrcv for replying (either positively or negatively) to a SPI command. Timeout is configured in milliseconds. Timeout value of '0' means that no specific timeout is to be used by CanTrcv and the communication is executed at the best of the SPI HW capacity.
      container CanTrcvChannel [1..*]  # Container gives CAN transceiver driver information about a single CAN transceiver channel. Any CAN transceiver driver has such CAN transceiver channels.
        integer CanTrcvChannelId: 0..8, set at pre-compile, symbolic-name-value=true, default-value=0  # No import. Unique identifier of the CAN Transceiver Channel.
        boolean CanTrcvChannelUsed: set at pre-compile, default-value=true  # Shall the related CAN transceiver channel be used?
        boolean CanTrcvControlsPowerSupply [0..1]: set at pre-compile, default-value=false  # Not used. Is ECU power supply controlled by this transceiver? TRUE = Controlled by transceiver. FALSE = Not controlled by transceiver.
        boolean CanTrcvHwPnSupport: set at pre-compile, default-value=false  # Indicates whether the transceiver has the ability to be selectively woken up by a Wake-up Frame (WUF). TRUE = Selective wakeup functionality is available in transceiver. FALSE = Selective wakeup functionality is not available in transceiver.
        enumeration CanTrcvInitState: {CANTRCV_OP_MODE_NORMAL, CANTRCV_OP_MODE_SLEEP, CANTRCV_OP_MODE_STANDBY}, set at pre-compile, default-value=CANTRCV_OP_MODE_NORMAL  # State of CAN transceiver after call to CanTrcv_Init.
        integer CanTrcvMaxBaudrate: 0..1000, set at pre-compile, default-value=1000  # Not Used. Max baudrate for transceiver hardware type. Only used for validation purposes. Value shall be configured by configuration tool based on transceiver hardware type.
        boolean CanTrcvWakeupByBusUsed: set at pre-compile, default-value=false  # Is wake up by bus supported? If CAN transceiver hardware does not support wake up by bus value is always FALSE. If CAN transceiver hardware supports wake up by bus value is TRUE or FALSE depending whether it is used or not. TRUE = Is used. FALSE = Is not used.
        integer CanTrcv_WakeupSourceId [0..1]: 0..4294967296, set at pre-compile, origin=Vector Informatik, default-value=0  # If no CanTrcvWakeupSourceRef can be found, this integer serves as backup solution to store the wakeup source.
        boolean CanTrcvIcuControlEnabled: set at pre-compile, origin=Vector Informatik, default-value=false  # If enabled the CanTrcv driver will control the Icu channel on mode changes.
        symbolic name reference CanTrcvIcuChannelRef [0..1]: set at pre-compile, destination=IcuChannel  # Reference to the IcuChannel to enable/disable the interrupts for wakeups.
        symbolic name reference CanTrcvWakeupSourceRef: set at pre-compile, destination=EcuMWakeupSource  # Reference to a wakeup source in the EcuM configuration. This reference is only needed if CanTrcvWakeupByBusUsed is true. Implementation Type: reference to EcuM_WakeupSourceType
        choice container CanTrcvAccess [1..*]
          container CanTrcvDioAccess [0..1]  # Container gives CAN transceiver driver information about accessing ports and port pins. In addition relation between CAN transceiver hardware pin names and Dio port access information is given. If a CAN transceiver hardware has no Dio interface, there is no instance of this container.
            string CanTrcvHardwareInterfaceName: set at pre-compile  # CAN transceiver hardware interface name. It is typically the name of a pin. From a Dio point of view it is either a port, a single channel or a channel group. Depending on this fact either CANTRCV_DIO_PORT_SYMBOLIC_NAME or CANTRCV_DIO_CHANNEL_SYMBOLIC_NAME or CANTRCV_DIO_CHANNEL_GROUP_SYMBOLIC_NAME shall reference a Dio configuration. The CAN transceiver driver implementation description shall list up this name for the appropriate CAN transceiver hardware.
            choice reference CanTrcvDioSymNameRef: set at pre-compile, destination=[DioChannel, DioChannelGroup, DioPort]  # Choice Reference to a DIO Port, DIO Channel or DIO Channel Group. This reference replaces the CANTRCV_DIO_PORT_SYM_NAME, CANTRCV_DIO_CHANNEL_SYM_NAME and CANTRCV_DIO_GROUP_SYM_NAME references in the Can Trcv SWS.
          container CanTrcvSpiSequence [0..*]  # Container gives information about the SPI sequences used to access a CAN Transceiver device. It is assumed that one SPI sequence used by a CAN transceiver device is for its exclusive use.
            boolean CanTrcvSpiAccessSynchronous [0..1]: set at pre-compile, default-value=false  # This parameter is used to define whether the access to the Spi sequence is synchronous or asynchronous. true: SPI access is synchronous. false: SPI access is asynchronous.
            symbolic name reference CanTrcvSpiSequenceName [0..*]: set at pre-compile, destination=SpiSequence  # Reference to a Spi sequence configuration container.
        container CanTrcvPartialNetwork [0..1]  # Not used. Container gives CAN transceiver driver information about the configuration of Partial Networking functionality.
          integer CanTrcvBaudRate: 0..1000, set at post-build in variant post-build / pre-compile in variant pre-compile  # Indicates the CAN Bus communication baud rate in kbps.
          boolean CanTrcvBusErrFlag: set at post-build in variant post-build / pre-compile in variant pre-compile, default-value=false  # Indicates if the Bus Error (BUSERR) flag is managed by the BSW. This flag is set if a bus failure is detected by the transceiver. TRUE = Supported by transceiver and managed by BSW. FALSE = Not managed by BSW.
          boolean CanTrcvPnCanIdIsExtended: set at post-build in variant post-build / pre-compile in variant pre-compile, default-value=false  # Indicates whether extended or standard ID is used. TRUE = Extended Can identifier is used. FALSE = Standard Can identifier is used.
          boolean CanTrcvPnEnabled: set at post-build in variant post-build / pre-compile in variant pre-compile, default-value=false  # Indicates whether the selective wake-up function is enabled or disabled in HW. TRUE = Selective wakeup feature is enabled in the transceiver hardware FALSE = Selective wakeup feature is disabled in the transceiver hardware
          integer CanTrcvPnFrameCanId: 0..4294967295, set at post-build in variant post-build / pre-compile in variant pre-compile  # CAN ID of the Wake-up Frame (WUF).
          integer CanTrcvPnFrameCanIdMask: 0..4294967295, set at post-build in variant post-build / pre-compile in variant pre-compile  # ID Mask for the selective activation of the transceiver. It is used to enableFrame Wake-up (WUF) on a group of IDs.
          integer CanTrcvPnFrameDlc: 0..8, set at post-build in variant post-build / pre-compile in variant pre-compile  # Data Length of the Wake-up Frame (WUF).
          boolean CanTrcvPowerOnFlag: set at post-build in variant post-build / pre-compile in variant pre-compile, default-value=false  # Description: Indicates if the Power On Reset (POR) flag is available and is managed by the transceiver. TRUE = Supported by Hardware. FALSE = Not supported by Hardware.
          integer CanTrcvSilenceTimeout: 0..3, set at pre-compile in variant pre-compile / post-build in variant post-build, origin=Vector Informatik, default-value=0  # TSilence Configuration: 0 - 750ms 1 - 1500ms 2 - 3000ms 3 - 6000ms
          container CanTrcvPnFrameDataMaskSpec [0..8]  # Defines data payload mask to be used on the received payload in order to determine if the transceiver must be woken up by the received Wake-up Frame (WUF).
            integer CanTrcvPnFrameDataMask: 0..255, set at post-build in variant post-build / pre-compile in variant pre-compile  # Defines the n byte (Byte0 = LSB) of the data payload mask to be used on the received payload in order to determine if the transceiver must be woken up by the received Wake-up Frame (WUF).
            integer CanTrcvPnFrameDataMaskIndex: 0..7, set at post-build in variant post-build / pre-compile in variant pre-compile  # holds the position n in frame of the mask-part
    container CanTrcvGeneral  # Container gives CAN transceiver driver basic information.
      boolean CanTrcvDevErrorDetect: set at pre-compile, default-value=true  # Switches development error detection and notification on and off. If switched on, #define CANTRCV_DEV _ERROR_DETECT ON shall be generated. If switched off, #define CANTRCV_DEV_ERROR _DETECT OFF shall be generated. Define shall be part of file CanTrcv_Cfg.h.
      boolean CanTrcvGetVersionInfo: set at pre-compile, default-value=false  # Switches version information API on and off. If switched off, function need not be present in compiled code.
      integer CanTrcvIndex: 0..8, set at pre-compile, default-value=0  # Specifies the InstanceId of this module instance. If only one instance is present it shall have the Id 0.
      enumeration CanTrcvWakeUpSupport: {CANTRCV_WAKEUP_BY_ISR, CANTRCV_WAKEUP_NOT_SUPPORTED, CANTRCV_WAKEUP_BY_POLLING}, set at pre-compile, default-value=CANTRCV_WAKEUP_NOT_SUPPORTED  # Informs whether wake up is supported by ISR, by polling or whether it is not supported. In case no wake up is supported by CAN transceiver hardware setting has to be always NO. Only in case wake up is supported by polling main function CanTrcv_main has to be present in source code and called by CanIf.
      string CanTrcvComponentName: set at pre-compile, origin=Vector Informatik, default-value=GenericX
      string CanTrcvDioPin [0..*]: set at pre-compile, origin=Vector Informatik, default-value=CanTrcvpin
      boolean CanTrcvDevProdDetect [0..1]: set at pre-compile, origin=Vector Informatik, default-value=true  # If Production Error Detection is enabled, production relevant errors are reported to the Diagnostics Event Manager (DEM). Disable this option, if no DEM is present in your system
      string CanTrcvUserConfigFile [0..1]: set at pre-compile, origin=Vector Informatik  # If a file path will be specified, the file is read and its contents is put at the end of this modules config file.
      string CanTrcvDEMEvent [0..*]: set at pre-compile, origin=Vector Informatik  # This container is used only by GENy to store user-defined DEM Events created for this Transceiver.
      integer CanTrcvModuleStartAdress [0..1]: 0..4294967295, set at pre-compile, origin=Vector Informatik  # Memory start address for postbuild data. RESTRICTIONS: 'CanTrcvModuleStartAdress' is only used within postbuild variant.
      boolean CanTrcvSpiSynchronous: set at pre-compile, origin=Vector Informatik, default-value=true  # Specifies if the CanTrcv driver should access the underlying hardware with synchronous or asynchronous SPI. TRUE = Sync access FALSE = Async access
      boolean CanTrcvHasSpiInterface: set at pre-compile, origin=Vector Informatik, default-value=false  # Specifies whether the underlying CanTrcv hardware is connected via SPI. TRUE = Use SPI to access the hardware FALSE = Use DIO to access the hardware
      boolean CanTrcvSupportsPartialNetworking: set at pre-compile, origin=Vector Informatik, default-value=false  # Specifies if the user implementation supports partial networking. TRUE = Support for partial networking available FALSE = Support for patial networking not available.
    container VectorCommonData  # Container gives provides support for CAN transceiver version conflict recognition.
      string BswmdVersion: configuration-class-affection=affection-kind=NO-AFFECT, set at published-information, origin=Vector Informatik, default-value=3.01.00
  module config CanTrcv_Pre: definition=CanTrcv
  module config CanTrcv_Rec: definition=CanTrcv
