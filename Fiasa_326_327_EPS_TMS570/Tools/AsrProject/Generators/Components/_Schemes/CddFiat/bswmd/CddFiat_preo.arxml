AUTOSAR XML (schema 3.0.2)
package /MICROSAR
  module config CddFiat_Pre: definition=CddFiat, implementation-config-variant=VARIANT-PRE-COMPILE
  module config CddFiat_Rec: definition=CddFiat
