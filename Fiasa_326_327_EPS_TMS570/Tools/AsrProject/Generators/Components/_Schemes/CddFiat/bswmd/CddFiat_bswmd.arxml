AUTOSAR XML (schema 3.0.2)
package /MICROSAR
  bsw implementation CddFiat_Impl: code-generator=GENy, programming-language=C, sw-major-version=1, sw-minor-version=7, sw-patch-version=0, vendor-id=30, ar-major-version=3, ar-minor-version=0, ar-patch-version=2, preconfigured-configuration=CddFiat_Pre, recommended-configuration=CddFiat_Rec, vendor-specific-module-def=CddFiat
  module definition CddFiat [0..1]: variants pre-compile  # Configuration of the CddFiat module.
    container CddFiatGlobalConfig: multiple-configuration-container=true  # This container contains the configuration (parameters) of the CddFiat module.
      boolean CddFiatDevErrorDetect: set at pre-compile, origin=Vector Informatik, default-value=true  # f &apos;Development Error Detection&apos; is enabled, development errors are reported to the Development Error Tracer (Det). The following development errors may occur within the Fiat complex device drive: - CDDFIAT_E_UNINIT - CDDFIAT_E_PARAM All development errors are reported to the Development Error Tracer. Note: In general, the development error detection is recommended during the development phase. It is not recommended to enable the development error detection in production code due to increased runtime and ROM needs.
      string CddFiatUserConfigFile [0..1]: set at pre-compile, origin=Vector Informatik  # A configuration file is generated by GENy. If you want to overwrite settings in the generated configuration file, you can specify a path to a user defined configuration file. The user defined configuration file will be included at the end of the generated file. Therefore definitions in the user defined configuration file can overwrite definitions in the generated configuration file. The content of the user defined configuration file is copied to the end of CddFiat_Cfg.h.
      reference CddFiatEcuMConfigurationRef [0..1]: set at pre-compile, origin=Vector Informatik, destination=EcuMConfiguration  # Internaly reference used by loader
      container CddFiatChannelConfig [1..*]
        symbolic name reference CddFiatComMChannelRef: set at pre-compile, origin=Vector Informatik, destination=ComMChannel  # This parameter is a reference to a Network (channel) defined in the Communication Manager.
        symbolic name reference CddFiatComIPduRef [0..1]: set at pre-compile, origin=Vector Informatik, destination=ComIPdu  # Reference to an IPdu which contains the information of the status c message. This parameter must not be configured for a ClassB channel.
        reference CddFiatComSignalRef [0..1]: set at pre-compile, origin=Vector Informatik, destination=ComSignal  # Reference one single signal out of the configured CddFiatComIPduRef. After successful transmission of the node status message the COM calls a Tx confirmation function which is generated by the CddFiat to reset the BusOff information after it was send one time. This parameter must not be configured for a ClassB channel.
    container VectorCommonData  # This configuration container contains Vector specific vendor data, which are relevant for configuration management purposes.
      string BswmdVersion: set at pre-compile, origin=Vector Informatik, default-value=1.02.00  # Bswmd version
  module config CddFiat_Rec: definition=CddFiat
  module config CddFiat_Pre: definition=CddFiat
