AUTOSAR XML (schema 3.0.1)
package /MICROSAR
  module config ComM_Pre: definition=ComM, implementation-config-variant=VARIANT-PRE-COMPILE
    ComMGeneral: ComMResetAfterForcingNoComm=false, ComMModeLimitationEnabled=false, ComMPncSupport=false
  module config ComM_Rec: definition=ComM
    ComMGeneral: ComMUseRte=true, ComMSynchronousWakeUp=false, ComMDevErrorDetect=false, ComMVersionInfoApi=false, ComMProdErrorDetect=true
