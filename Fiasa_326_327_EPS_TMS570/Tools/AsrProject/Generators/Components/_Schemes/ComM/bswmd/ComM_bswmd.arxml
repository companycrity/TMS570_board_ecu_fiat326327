AUTOSAR XML (schema 3.0.1)
# COPYRIGHT
# Copyright (c) 2013 by Vector Informatik GmbH. All rights reserved.
# This software is copyright protected and proprietary to Vector Informatik GmbH.
# Vector Informatik GmbH grants to you only those rights as set out in the license conditions.
package /MICROSAR
  bsw implementation ComM_Impl: code-generator=GENy, programming-language=C, sw-major-version=4, sw-minor-version=24, sw-patch-version=00, vendor-id=30, ar-major-version=2, ar-minor-version=0, ar-patch-version=0, preconfigured-configuration=ComM_Pre, recommended-configuration=ComM_Rec, vendor-specific-module-def=ComM
  module definition ComM [0..1]: refined-module-def=ComM, variants pre-compile/link-time/post-build  # Configuration of the ComM (Communications Manager) module.
    container ComMChannel [1..*]  # This container contains the configuration (parameters) of the bus channel(s). The channel parameters shall be harmonized within the whole communication stack.
      enumeration ComMBusType: {COMM_BUS_TYPE_CAN, COMM_BUS_TYPE_FR, COMM_BUS_TYPE_INTERNAL, COMM_BUS_TYPE_LIN, COMM_BUS_TYPE_ETH}, set at link, default-value=COMM_BUS_TYPE_CAN  # Choose the correspending bus type for the ComM channel. The bus type INTERNAL is currently not supported.
      integer ComMChannelId: 0..255, set at link, symbolic-name-value=true, default-value=0  # Channel identification number of the corresponding channel.
      float ComMMainFunctionPeriod: 0.004..0.1, set at link, default-value=0.020  # This parameter configures the cycle time of the Communication Manger main function ComM_MainFunction (in seconds).
      boolean ComMNoCom: set at link, default-value=false  # ECU is not allowed to change state of the channel to "Silent Communication" or "Full Communication". true: Enabled - Not allowed to switch to "Silent Communication mode" or "Full Communication mode" false: disabled This is the default/init value corresponding to a runtime variable that can be cahnged using ComM_LimitChannelToNoComMode(). not used parameter, this parameter is double to ComMNoFullCom Not used Parameter
      boolean ComMNoFullCom: set at link, default-value=false  # Activate/Deactivate the ComM mode limitation to 'No Communication' for this channel. Activate: the channel is limited to 'No Communication' after the initialization of the ComM Deactivate: the channel is NOT limited to 'No Communication' after the initialization of the ComM This parameter is the default/init value of a corresponding runtime variable that can be changed using ComM_LimitChannelToNoComMode(). ComMNmVariant != FULL: ComM_LimitChannelToNoComMode() can be used. ComMNmVariant = PASSIVE: ComM_LimitChannelToNoComMode() shall not be used.
      boolean ComMNoWakeup: set at link, default-value=false  # Enable/Disable the ComM wake up inhibition functionality for this channel. Activate: the prevent wake up for this channel is active after the initialization of the ComM Deactivate: the prevent wake up for this channel is NOT active after the initialization of the ComM The parameter defines the default/init value of a runtime variable that can be changed during runtime using ComM_PreventWakeUp().
      string ComMChannelWakeUpPortPrefix: set at link, origin=Vector Informatik, default-value=CW_  # Enter the prefix of the ComM_ChannelWakeUp service port. The prefix and the symbolic name of the ComM channel builds the name of the service port, e.g. Prefix = CW_ Channel Name = Channel0 Service Port Name =CW_Channel0
      string ComMChannelLimitPortPrefix: set at link, origin=Vector Informatik, default-value=CL_  # Enter the prefix of the ComM_ChannelLimitation service port. The prefix and the symbolic name of the ComM channel builds the name of the service port, e.g. Prefix = CL_ Channel Name = Channel0 Service Port Name =CL_Channel0
      enumeration ComMPncGatewayType [0..1]: {COMM_GATEWAY_TYPE_ACTIVE, COMM_GATEWAY_TYPE_PASSIVE, COMM_GATEWAY_TYPE_NONE}, set at link, origin=Vector Informatik, default-value=COMM_GATEWAY_TYPE_NONE  # Identifies the Partial Network Gateway behaviour for the corresponding ComMChannel.
      boolean ComMModeNotificationToDcm: set at link, origin=Vector Informatik, default-value=true  # Enables or disables considering the channel when ComM calculates the Communication Mode to be indicated to Dcm. If multiple channels are available on the ECU it might be intended that some channels are not used by Dcm for diagnostic communication. The parameter allows excluding those channels from calculation. ComM indicates the lowest Communication Mode of channels which have this parameter set to true. True: Communication Mode of the channel is considered for Mode Indication to Dcm. False: Communication Mode of the channel is not considered for Mode Indication to Dcm. Note if Dcm module is activated and this parameter is false for all ComM channels, there will be no Mode Indication to Dcm at all.
      symbolic name reference ComMNvmBlockDescriptor [0..1]: set at pre-compile, destination=NvmBlockDescriptor  # Reference to NVRAM block containing the none volatile data not used parameter
      container ComMNetworkManagement  # This container contains the configuration parameters of the networkmanagement.
        float ComMNmLightTimeout [0..1]: 1..255, set at link, default-value=10  # Defines the Timeout (in seconds) after the ReadySleep state of the ComM is left and the ComM starts the networkshutdown. (Only available for the Nm variant LIGHT)
        enumeration ComMNmVariant [0..1]: {FULL, LIGHT, NONE, PASSIVE, OSEK}, set at link, default-value=FULL  # Choose the ComM network management variant you are working in dependency to the used network management algorithm. Refer to the Technical_Reference _Asr_ComM.pdf for details. If Nm variant PASSIVE is selected then ComMModeLimitationEnabled and ComMNoFullCom are activated. If Nm variant OSEK is selceted then the ComMTMinFullComModeDuration is configurable and evaluated by the configurator.
        boolean ComMPncNmRequest: set at link, default-value=true  # If this parameter equals true, then every time a Full Communication is requested due to a change in the PNC state machine to COMM_PNC_REQUESTED Nm shall be called using the API Nm_NetworkRequest(), even if the channel is already in Full Communication.
      container ComMUserPerChannel [0..*]  # This container contains a list of identifiers that are needed to refer to a user in the system which is linked to a channel.
        reference ComMUserChannel: set at link, destination=ComMUser  # Defines the reference of the the communication channel reference which is handled by the corresponding user.
    container ComMGeneral  # General configuration parameters of the Communication Manager.
      boolean ComMDevErrorDetect: set at pre-compile, default-value=true  # If 'Development Error Detection' is enabled, development errors are reported to the Development Error Tracer (Det). The following development errors may occur within the Communication Manager: - CAN Interface initialization failed - invalid Communication Manager state transition - Communication Manager state transition loop check failed - communication mode is requested for an unsupported mode - communication mode is requested with an unsupported user All development errors are reported to the Development Error Tracer. Note: In general, the development error detection is recommended during the development phase. It is not recommended to enable the development error detection in production code due to increased runtime and ROM needs.
      integer ComMEcuGroupClassification: 0..255, set at link, default-value=3  # The ECU Group Classification defines if the ECU is affected by wake up inhibition or a mode limitation to COMM_NO_COMMUNICATION. 0 means the ECU is not afected by a wake up inhibition or a mode limitation to COMM_NO_COMMUNICATION. 1 means the ECU is affected by a wake up inhibition 2 means the ECU is affected by a mode limitation to COMM_NO_COMMUNCIATION 3 means the ECU is affected by a wake up inhibition and by a mode limitation to COMM_NO_COMMUNICATION. The ECU Group Classifciation can be changed during runtime via the ComM API service ComM_SetECUGroupClassification(). Forcing into "No Communication" mode shall be switched on if ComMNmVariant=PASSIVE.
      boolean ComMModeLimitationEnabled: set at link, default-value=false  # Enable/Disable the Mode limitation functionality. If Mode limitiation is enabled then the following parameter are evaluated and configurable: - ComMEcuGroupClassification - ComMNoCom - ComMResetAfterForcingNoComm - ComMWakeupInhibitionEnabled - ComMNoFullCom - ComMNoWakeup
      boolean ComMNoCom: set at link, default-value=false  # Activate/Deactivate the ECU mode limitation to 'No Communication' for the ECU during the ComM initialization. The state can be changed druing runtime via the ComM API ComM_LimitECUToNoComMode().
      boolean ComMResetAfterForcingNoComm: set at link, default-value=false  # Enable/disable ECU Reset after the ComM has entered the state 'No Communication' mode, because of an active mode limitation to 'No Communication' mode.
      boolean ComMSynchronousWakeUp: set at link, default-value=false  # Enable/Disable the wake up forwarding to all ComM networks. This means if this option is enabeld and the ComM notifies a wake up on minimum one ComM network then the ComM triggers a wake up to all other ComM networks.
      float ComMTMinFullComModeDuration: 0.001..65, set at link, default-value=5  # Minimum time duration in seconds, spent in the Full Communication mode. The time is only available if the ComMNmVariant contains the value: - LIGHT or - OSEK
      boolean ComMVersionInfoApi: set at pre-compile, default-value=false  # Enable/Disable the function ComM_GetVersionInfo() to get the publisched version information of the ComM.
      boolean ComMWakeupInhibitionEnabled: set at link, default-value=false  # Enable/Disable the ComM wake up inhibition functionality of the whole ECU during the ComM initialization.
      string ComMSoftwareComponentName: set at link, origin=Vector Informatik, default-value=ComM  # This name is used as component name (ShortName) in the generated software component template. Change this name if you try to import the ComM components of several ECUs and have problems with name clashes.
      boolean ComMProdErrorDetect: set at pre-compile, origin=Vector Informatik, default-value=true  # If 'Production Error Detection' is enabled, production relevant errors are reported to the Diagnostics Event Manager (DEM). Disable this option, if no DEM is present in your system.
      string ComMUserConfigurationFilePath [0..1]: set at link, origin=Vector Informatik  # A ComM configuration file is generated by GENy (ComM_cfg.h). If you want to overwrite settings in the generated file, you can specify a path to a user defined configuration file. The user defined configuration file will be included at the end of the generated file. Therefore definitions in the user defined configuration file can overwrite definitions in the generated configuration file.
      string ComMReqModePortPrefix: set at link, origin=Vector Informatik, default-value=UR_  # Enter the prefix of the ComM_RequestMode service port. The prefix and the symbolic name of the ComM user builds the name of the service port, e.g. Prefix = UR_ User Handle Name = RunableUser_1 Service Port Name = UR_RunableUser_1
      boolean ComMUseRte: set at link, origin=Vector Informatik, default-value=true  # Enable this option if the ECU uses an RTE. If this option is enabled, a port interface description (Software Component Template) is generated, which can be used for the RTE configuration.
      string ComMGlobalNvmBlockDescString [0..1]: set at link, origin=Vector Informatik  # Enter symbolic name of the NvM block descriptor for the ComM which is used to load and store the ComM non-volatile data. not used parameter
      string ComMCurrentModePortPrefix: set at link, origin=Vector Informatik, default-value=UM_  # Enter the prefix of the ComM_CurrentMode service port. The prefix and the symbolic name of the ComM user builds the name of the service port, e.g. Prefix = UM_ User Handle Name = RunableUser_1 Service Port Name = UM_RunableUser_1
      boolean ComMPncGatewayEnabled [0..1]: set at link, origin=Vector Informatik, default-value=false  # Enables or disables support of Partial Network Gateway. False: Partial Networking Gateway is disabled True: Partial Networking Gateway is enabled
      float ComMPncPrepareSleepTimer [0..1]: 0.0..63.0, set at link, origin=Vector Informatik, default-value=1.5  # This parameter configures the Time in seconds the PNC state machine shall wait in PNC_PREPARE_SLEEP.
      boolean ComMPncSupport: set at pre-compile, origin=Vector Informatik, default-value=false  # Enables or disables support of partial networking. False: Partial Networking is disabled True: Partial Networking is enabled
      boolean ComMAmdRuntimeMeasurement: set at pre-compile, origin=Vector Informatik, default-value=false  # This parameter defines if AMD Runtime Measurement (RTM) is enabled for this module.
      symbolic name reference ComMGlobalNvmBlockDescriptor [0..1]: set at link, destination=NvmBlockDescriptor  # Choose NvM block descriptor reference of the ComM which is used to load and store the ComM non-volatile data.
    container ComMUser [1..*]  # This container contains a list of identifiers that are needed to refer to a user in the system which is designated to request Communication modes.
      integer ComMUserIdentifier: 0.., set at link, symbolic-name-value=true  # An handle that is needed to refer to a user in the system which is designated to request/release communication modes. The identifier value (ComMUserIdentifier) is automaticaly calculated by the configuration tool (0..255)
      boolean ComMModeNotification: set at link, origin=Vector Informatik, default-value=false  # Enable/Disable the mode notification for this user.
      boolean ComMSystemUser: set at link, origin=Vector Informatik, default-value=false  # If Enabled, the user is a internal ComM system user, application is not allowed to use this system user.
    container VectorCommonData
      string BswmdVersion: set at published-information, origin=Vector Informatik, default-value=2.20.00  # Bswmd version
    container ComMConfig: multiple-configuration-container=true
      boolean ComMPncEnabled: set at post-build, origin=Vector Informatik, default-value=false  # Defines whether in this configuration set the partial networking is enabled. true: Enabled false: Disabled
      integer ComMPostBuildConfigStartAddress: 0..4294967295, set at pre-compile in variant pre-compile / link in variant link-time+post-build, origin=Vector Informatik, default-value=0  # The Modul Start Address must specify the start address of the memory area, where the generated hex-file will be mapped to. If the ECU supports selectable post-build configuration, the Modul Start Address can be any location that is accessible for the BSW module. If selectable post-build configuration is not supported by your ECU, the Modul Start Address must be the same address to which the initial configuration was mapped. Please see to your linker map file to get this address. The attribute is only evaluated and visible if the configuration variant is set to Variant 3 (Post-build configuration).
      container ComMNetworks [1..*]
        symbolic name reference ComMNetworkHandle [0..1]: set at link, origin=Vector Informatik, destination=ComMChannel
    container ComMPnc [0..*]  # This container contains the configuration of the partial network cluster (PNC).
      integer ComMPncId: 8..63, set at link, origin=Vector Informatik, symbolic-name-value=true  # Partial network cluster identification number [8..63]
      reference ComMChannelPerPnc [0..*]: set at link, origin=Vector Informatik, destination=ComMChannel  # Defines the reference of the partial network to the corresponding ComMChannel
      reference ComMUserPerPnc [0..*]: set at link, origin=Vector Informatik, destination=ComMUser  # Defines the reference of the partial network reference which is handled by the corresponding user.
      container ComMPncComSignal [0..*]  # Represents the PncComSignals which are used to communicate the EIRA and ERA status of this PNC.
        enumeration ComMPncComSignalDirection: {RX, TX}, set at link, origin=Vector Informatik  # Indicates the communication direction of this PncComSignal.
        enumeration ComMPncComSignalKind: {EIRA, ERA}, set at link, origin=Vector Informatik  # Indicates whether this PncComSignal represents EIRA or ERA PNC information.
        reference ComMPncComSignalChannelRef [0..1]: set at link, origin=Vector Informatik, destination=ComMChannel  # Reference to the ComMChannel which is used to determine whether this PncComSignal shall participate in the active or passive role (via the parameter ComMPncGatewayType of the ComMChannel).
        symbolic name reference ComMPncComSignalRef: set at link, origin=Vector Informatik, destination=ComSignal  # Reference to the ComSignal which is used to transport the partial network channel request information.
  module config ComM_Pre: definition=ComM
  module config ComM_Rec: definition=ComM
