AUTOSAR XML (schema 3.0.1)
package /MICROSAR
  module config Dem_Pre: definition=Dem, implementation-config-variant=VARIANT-PRE-COMPILE
    DemGeneral: DemTypeOfDTCSupported=1
      4 x DemOperationCycleTgt:
        DEM_IGNITION: DemOperationCycle=DEM_IGNITION
        DEM_POWER: DemOperationCycle=DEM_POWER
        DEM_OBD_DCY: DemOperationCycle=DEM_OBD_DCY
        DEM_WARMUP: DemOperationCycle=DEM_WARMUP
  module config Dem_Rec: definition=Dem, implementation-config-variant=VARIANT-PRE-COMPILE
    DemGeneral: DemMaxNumberEventEntryPrm=8
  module config Dem_Pre_Class1: definition=Dem
    DemConfigSet
      4 x DemGroupOfDTC, all with DemGroupDTCs=(unset):
        DEM_DTC_GROUP_POWERTRAIN_DTCS
        DEM_DTC_GROUP_CHASSIS_DTCS
        DEM_DTC_GROUP_BODY_DTCS
        DEM_DTC_GROUP_NETWORK_COM_DTCS
  module config Dem_VectorTemplates: definition=Dem, implementation-config-variant=VARIANT-PRE-COMPILE
    DemConfigSet
      VectorEventTemplate (DemEventParameter)
        DemEventClass
          DemPredebounceAlgorithmClass
            DemPreDebounceCounterBased: DemJumpDown=true, DemJumpUp=true
  module config Dem_Pre_Class2: definition=Dem
    DemConfigSet
      DemEventParameter
        DemEventClass
          DemPredebounceAlgorithmClass
            DemPreDebounceCounterBased: DemJumpDown=true, DemJumpUp=true
