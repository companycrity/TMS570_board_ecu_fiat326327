AUTOSAR XML (schema 3.0.1)
package /MICROSAR
  module config Dem_Pre: definition=Dem, implementation-config-variant=VARIANT-PRE-COMPILE
    DemGeneral: DemPreInitHasConfigParam=false, DemDtcStatusAvailabilityMask=255, DemSnapshotsPerDTC=2, DemEnableFailStateNotification=true
  module config Dem_Rec: definition=Dem
    DemGeneral: DemDevErrorDetect=false, DemUseRte=true, DemVersionInfoApi=false
