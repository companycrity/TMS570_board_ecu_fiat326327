AUTOSAR XML (schema 3.0.1)
package /MICROSAR
  module config Det_Pre: definition=Det, implementation-config-variant=VARIANT-PRE-COMPILE
  module config Det_Rec: definition=Det
    DetGlobalConfig: DetEnableDet=true
