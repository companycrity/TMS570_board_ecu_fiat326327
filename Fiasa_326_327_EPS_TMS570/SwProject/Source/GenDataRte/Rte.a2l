/begin MEASUREMENT Rte_CDDInterface_SrlComSvcDft_Cnt_b32 "MICROSAR RTE" ULONG NO_COMPU_METHOD 0 0 0 4294967295 ECU_ADDRESS 0 /end MEASUREMENT
/begin MEASUREMENT Rte_CDDInterface_SysCCorrMtrPosElec_Rev_f32 "MICROSAR RTE" FLOAT32_IEEE NO_COMPU_METHOD 0 0 1.175494351e-38 3.402823466e+38 ECU_ADDRESS 0 /end MEASUREMENT
/begin MEASUREMENT Rte_CDDInterface_SysCVSwitchADC_Cnt_u16 "MICROSAR RTE" UWORD NO_COMPU_METHOD 0 0 0 65535 ECU_ADDRESS 0 /end MEASUREMENT
/begin MEASUREMENT Rte_CDDInterface_ThermalDCSrlComSvcDft_Cnt_lgc "MICROSAR RTE" UBYTE RTE_CM_BOOLEAN 0 0 0 255 ECU_ADDRESS 0 /end MEASUREMENT
/begin MEASUREMENT Rte_CDDInterface_TrqRmpSrlComSvcDft_Cnt_lgc "MICROSAR RTE" UBYTE RTE_CM_BOOLEAN 0 0 0 255 ECU_ADDRESS 0 /end MEASUREMENT
/begin MEASUREMENT Rte_CDDInterface_UncorrMechMtrPos1_Rev_u0p16 "MICROSAR RTE" UWORD NO_COMPU_METHOD 0 0 0 65535 ECU_ADDRESS 0 /end MEASUREMENT
/begin MEASUREMENT Rte_CDDInterface_WhlImbRejSrlComSvcDft_Cnt_lgc "MICROSAR RTE" UBYTE RTE_CM_BOOLEAN 0 0 0 255 ECU_ADDRESS 0 /end MEASUREMENT
/begin MEASUREMENT Rte_CmMtrCurr_CurrTempOffset.CurrOffsetY1_Volts_s4p11 "MICROSAR RTE" SWORD NO_COMPU_METHOD 0 0 -32768 32767 MATRIX_DIM 16 1 1 ECU_ADDRESS 0 READ_WRITE /end MEASUREMENT
/begin MEASUREMENT Rte_CmMtrCurr_CurrTempOffset.CurrOffsetY2_Volts_s4p11 "MICROSAR RTE" SWORD NO_COMPU_METHOD 0 0 -32768 32767 MATRIX_DIM 16 1 1 ECU_ADDRESS 0 READ_WRITE /end MEASUREMENT
/begin MEASUREMENT Rte_CmMtrCurr_CurrTempOffset.CurrTempOffsetX_DegC_s10p5 "MICROSAR RTE" SWORD NO_COMPU_METHOD 0 0 -32768 32767 MATRIX_DIM 16 1 1 ECU_ADDRESS 0 READ_WRITE /end MEASUREMENT
/begin MEASUREMENT Rte_CmMtrCurr_CurrentGainSvc_Cnt_lgc "MICROSAR RTE" UBYTE RTE_CM_BOOLEAN 0 0 0 255 ECU_ADDRESS 0 /end MEASUREMENT
/begin MEASUREMENT Rte_CtrlTemp_FiltMeasTemp_DegC_f32 "MICROSAR RTE" FLOAT32_IEEE NO_COMPU_METHOD 0 0 1.175494351e-38 3.402823466e+38 ECU_ADDRESS 0 /end MEASUREMENT
/begin MEASUREMENT Rte_CurrCmd_MtrCurrAngle_Rev_f32 "MICROSAR RTE" FLOAT32_IEEE NO_COMPU_METHOD 0 0 1.175494351e-38 3.402823466e+38 ECU_ADDRESS 0 /end MEASUREMENT
/begin MEASUREMENT Rte_CmMtrCurr_ShCurrCal.EOLMtrCurr1OffsetDiff_Volts_f32 "MICROSAR RTE" FLOAT32_IEEE NO_COMPU_METHOD 0 0 1.175494351e-38 3.402823466e+38 ECU_ADDRESS 0 READ_WRITE /end MEASUREMENT
/begin MEASUREMENT Rte_CmMtrCurr_ShCurrCal.EOLMtrCurr1OffsetLo_Volts_f32 "MICROSAR RTE" FLOAT32_IEEE NO_COMPU_METHOD 0 0 1.175494351e-38 3.402823466e+38 ECU_ADDRESS 0 READ_WRITE /end MEASUREMENT
/begin MEASUREMENT Rte_CmMtrCurr_ShCurrCal.EOLMtrCurr2OffsetDiff_Volts_f32 "MICROSAR RTE" FLOAT32_IEEE NO_COMPU_METHOD 0 0 1.175494351e-38 3.402823466e+38 ECU_ADDRESS 0 READ_WRITE /end MEASUREMENT
/begin MEASUREMENT Rte_CmMtrCurr_ShCurrCal.EOLMtrCurr2OffsetLo_Volts_f32 "MICROSAR RTE" FLOAT32_IEEE NO_COMPU_METHOD 0 0 1.175494351e-38 3.402823466e+38 ECU_ADDRESS 0 READ_WRITE /end MEASUREMENT
/begin MEASUREMENT Rte_CmMtrCurr_ShCurrCal.EOLMtrCurrVcalCmd_VoltCnts_f32 "MICROSAR RTE" FLOAT32_IEEE NO_COMPU_METHOD 0 0 1.175494351e-38 3.402823466e+38 ECU_ADDRESS 0 READ_WRITE /end MEASUREMENT
/begin MEASUREMENT Rte_CmMtrCurr_ShCurrCal.EOLPhscurr1Gain_AmpspVolt_f32 "MICROSAR RTE" FLOAT32_IEEE NO_COMPU_METHOD 0 0 1.175494351e-38 3.402823466e+38 ECU_ADDRESS 0 READ_WRITE /end MEASUREMENT
/begin MEASUREMENT Rte_CmMtrCurr_ShCurrCal.EOLPhscurr2Gain_AmpspVolt_f32 "MICROSAR RTE" FLOAT32_IEEE NO_COMPU_METHOD 0 0 1.175494351e-38 3.402823466e+38 ECU_ADDRESS 0 READ_WRITE /end MEASUREMENT
/begin MEASUREMENT Rte_CtrlTemp_AmbTemp_DegC_f32 "MICROSAR RTE" FLOAT32_IEEE NO_COMPU_METHOD 0 0 1.175494351e-38 3.402823466e+38 ECU_ADDRESS 0 /end MEASUREMENT
/begin MEASUREMENT Rte_DiagMgr10_DiagStsDefTemp_Cnt_lgc "MICROSAR RTE" UBYTE RTE_CM_BOOLEAN 0 0 0 255 ECU_ADDRESS 0 /end MEASUREMENT
/begin MEASUREMENT Rte_IoHwAbstractionUsr_TemperatureADC_Volt_f32 "This signal is intended to communicate any type voltage signal measured by the ecu.  This signal has a lower limit of 0 which reequires users of the signal to provide divide by 0 protection if it is used as a denominator in a calculation.  See Vecu port p" FLOAT32_IEEE NO_COMPU_METHOD 0 0 1.175494351e-38 3.402823466e+38 ECU_ADDRESS 0 /end MEASUREMENT
/begin MEASUREMENT Rte_Polarity_AssistAssyPolarity_Cnt_s08 "MICROSAR RTE" SBYTE NO_COMPU_METHOD 0 0 -128 127 ECU_ADDRESS 0 /end MEASUREMENT
/begin MEASUREMENT Rte_MtrVel_MotorVelCRF_MtrRadpS_f32 "MICROSAR RTE" FLOAT32_IEEE NO_COMPU_METHOD 0 0 1.175494351e-38 3.402823466e+38 ECU_ADDRESS 0 /end MEASUREMENT
/begin MEASUREMENT Rte_CtrldDisShtdn_CntDisMtrTrqCmdMRF_MtrNm_f32 "MICROSAR RTE" FLOAT32_IEEE NO_COMPU_METHOD 0 0 1.175494351e-38 3.402823466e+38 ECU_ADDRESS 0 /end MEASUREMENT
/begin MEASUREMENT Rte_CtrldDisShtdn_CtrldDmpStsCmp_Cnt_lgc "MICROSAR RTE" UBYTE RTE_CM_BOOLEAN 0 0 0 255 ECU_ADDRESS 0 /end MEASUREMENT
/begin MEASUREMENT Rte_DiagMgr10_DiagStsCtrldDisRmpPres_Cnt_lgc "MICROSAR RTE" UBYTE RTE_CM_BOOLEAN 0 0 0 255 ECU_ADDRESS 0 /end MEASUREMENT
/begin MEASUREMENT Rte_Sweep2_OutputMtrTrq_MtrNm_f32 "MICROSAR RTE" FLOAT32_IEEE NO_COMPU_METHOD 0 0 1.175494351e-38 3.402823466e+38 ECU_ADDRESS 0 /end MEASUREMENT
/begin MEASUREMENT Rte_CtrldDisShtdn_SysC_CRFMtrTrqCmd_MtrNm_f32 "MICROSAR RTE" FLOAT32_IEEE NO_COMPU_METHOD 0 0 1.175494351e-38 3.402823466e+38 ECU_ADDRESS 0 /end MEASUREMENT
/begin MEASUREMENT Rte_CtrldDisShtdn_SysC_MRFMtrTrqCmd_MtrNm_f32 "MICROSAR RTE" FLOAT32_IEEE NO_COMPU_METHOD 0 0 1.175494351e-38 3.402823466e+38 ECU_ADDRESS 0 /end MEASUREMENT
/begin MEASUREMENT Rte_CurrParamComp_EstKe_VpRadpS_f32 "MICROSAR RTE" FLOAT32_IEEE NO_COMPU_METHOD 0 0 1.175494351e-38 3.402823466e+38 ECU_ADDRESS 0 /end MEASUREMENT
/begin MEASUREMENT Rte_CurrParamComp_EstLd_Henry_f32 "MICROSAR RTE" FLOAT32_IEEE NO_COMPU_METHOD 0 0 1.175494351e-38 3.402823466e+38 ECU_ADDRESS 0 /end MEASUREMENT
/begin MEASUREMENT Rte_CurrParamComp_EstLq_Henry_f32 "MICROSAR RTE" FLOAT32_IEEE NO_COMPU_METHOD 0 0 1.175494351e-38 3.402823466e+38 ECU_ADDRESS 0 /end MEASUREMENT
/begin MEASUREMENT Rte_CurrParamComp_EstR_Ohm_f32 "MICROSAR RTE" FLOAT32_IEEE NO_COMPU_METHOD 0 0 1.175494351e-38 3.402823466e+38 ECU_ADDRESS 0 /end MEASUREMENT
/begin MEASUREMENT Rte_CurrCmd_IvtrLoaMtgtnEn_Cnt_lgc "MICROSAR RTE" UBYTE RTE_CM_BOOLEAN 0 0 0 255 ECU_ADDRESS 0 /end MEASUREMENT
/begin MEASUREMENT Rte_TrqCmdScl_MRFMtrTrqCmdScl_MtrNm_f32 "MICROSAR RTE" FLOAT32_IEEE NO_COMPU_METHOD 0 0 1.175494351e-38 3.402823466e+38 ECU_ADDRESS 0 /end MEASUREMENT
/begin MEASUREMENT Rte_CurrCmd_MotCurrLoaMtgtnEn_Cnt_lgc "MICROSAR RTE" UBYTE RTE_CM_BOOLEAN 0 0 0 255 ECU_ADDRESS 0 /end MEASUREMENT
/begin MEASUREMENT Rte_CurrCmd_MtrCurrDaxRef_Amp_f32 "MICROSAR RTE" FLOAT32_IEEE NO_COMPU_METHOD 0 0 1.175494351e-38 3.402823466e+38 ECU_ADDRESS 0 /end MEASUREMENT
/begin MEASUREMENT Rte_CurrCmd_MtrCurrQaxRef_Amp_f32 "MICROSAR RTE" FLOAT32_IEEE NO_COMPU_METHOD 0 0 1.175494351e-38 3.402823466e+38 ECU_ADDRESS 0 /end MEASUREMENT
/begin MEASUREMENT Rte_QuadDet_MtrQuad_Cnt_u08 "MICROSAR RTE" UBYTE NO_COMPU_METHOD 0 0 0 255 ECU_ADDRESS 0 /end MEASUREMENT
/begin MEASUREMENT Rte_MtrTempEst_CuTempEst_DegC_f32 "MICROSAR RTE" FLOAT32_IEEE NO_COMPU_METHOD 0 0 1.175494351e-38 3.402823466e+38 ECU_ADDRESS 0 /end MEASUREMENT
/begin MEASUREMENT Rte_CurrParamComp_EOLNomMtrParam.NomKe_VpRadpS_f32 "MICROSAR RTE" FLOAT32_IEEE NO_COMPU_METHOD 0 0 1.175494351e-38 3.402823466e+38 ECU_ADDRESS 0 READ_WRITE /end MEASUREMENT
/begin MEASUREMENT Rte_CurrParamComp_EOLNomMtrParam.NomRmtr_Ohm_f32 "MICROSAR RTE" FLOAT32_IEEE NO_COMPU_METHOD 0 0 1.175494351e-38 3.402823466e+38 ECU_ADDRESS 0 READ_WRITE /end MEASUREMENT
/begin MEASUREMENT Rte_MtrTempEst_MagTempEst_DegC_f32 "MICROSAR RTE" FLOAT32_IEEE NO_COMPU_METHOD 0 0 1.175494351e-38 3.402823466e+38 ECU_ADDRESS 0 /end MEASUREMENT
/begin MEASUREMENT Rte_MtrTempEst_SiTempEst_DegC_f32 "MICROSAR RTE" FLOAT32_IEEE NO_COMPU_METHOD 0 0 1.175494351e-38 3.402823466e+38 ECU_ADDRESS 0 /end MEASUREMENT
/begin MEASUREMENT Rte_Damping_CustomDamp_MtrNm_f32 "MICROSAR RTE" FLOAT32_IEEE NO_COMPU_METHOD 0 0 1.175494351e-38 3.402823466e+38 ECU_ADDRESS 0 /end MEASUREMENT
/begin MEASUREMENT Rte_Damping_DampingCmd_MtrNm_f32 "MICROSAR RTE" FLOAT32_IEEE NO_COMPU_METHOD 0 0 1.175494351e-38 3.402823466e+38 ECU_ADDRESS 0 /end MEASUREMENT
/begin MEASUREMENT Rte_Damping_DampingDDFactor_Uls_f32 "MICROSAR RTE" FLOAT32_IEEE NO_COMPU_METHOD 0 0 1.175494351e-38 3.402823466e+38 ECU_ADDRESS 0 /end MEASUREMENT
/begin MEASUREMENT Rte_FrqDepDmpnInrtCmp_FrqDepDmpnInrtCmp_MtrNm_f32 "MICROSAR RTE" FLOAT32_IEEE NO_COMPU_METHOD 0 0 1.175494351e-38 3.402823466e+38 ECU_ADDRESS 0 /end MEASUREMENT
/begin MEASUREMENT Rte_DampingFirewall_VehicleLonAccel_KphpS_f32 "MICROSAR RTE" FLOAT32_IEEE NO_COMPU_METHOD 0 0 1.175494351e-38 3.402823466e+38 ECU_ADDRESS 0 /end MEASUREMENT
/begin MEASUREMENT Rte_DampingFirewall_WIRCmdAmpBlnd_MtrNm_f32 "MICROSAR RTE" FLOAT32_IEEE NO_COMPU_METHOD 0 0 1.175494351e-38 3.402823466e+38 ECU_ADDRESS 0 /end MEASUREMENT
/begin MEASUREMENT Rte_DiagMgr10_DiagRampRate_XpmS_f32 "MICROSAR RTE" FLOAT32_IEEE NO_COMPU_METHOD 0 0 1.175494351e-38 3.402823466e+38 ECU_ADDRESS 0 /end MEASUREMENT
/begin MEASUREMENT Rte_DiagMgr10_DiagRampValue_Uls_f32 "MICROSAR RTE" FLOAT32_IEEE NO_COMPU_METHOD 0 0 1.175494351e-38 3.402823466e+38 ECU_ADDRESS 0 /end MEASUREMENT
/begin MEASUREMENT Rte_DiagMgr10_DiagRmpToZeroActive_Cnt_lgc "MICROSAR RTE" UBYTE RTE_CM_BOOLEAN 0 0 0 255 ECU_ADDRESS 0 /end MEASUREMENT
/begin MEASUREMENT Rte_DiagMgr10_DiagStsDefVehSpd_Cnt_lgc "MICROSAR RTE" UBYTE RTE_CM_BOOLEAN 0 0 0 255 ECU_ADDRESS 0 /end MEASUREMENT
/begin MEASUREMENT Rte_DiagMgr10_DiagStsNonRecRmpToZeroFltPres_Cnt_lgc "MICROSAR RTE" UBYTE RTE_CM_BOOLEAN 0 0 0 255 ECU_ADDRESS 0 /end MEASUREMENT
/begin MEASUREMENT Rte_DiagMgr10_DiagStsRecRmpToZeroFltPres_Cnt_lgc "MICROSAR RTE" UBYTE RTE_CM_BOOLEAN 0 0 0 255 ECU_ADDRESS 0 /end MEASUREMENT
/begin MEASUREMENT Rte_DiagMgr10_DiagStsScomHWANotValid_Cnt_lgc "MICROSAR RTE" UBYTE RTE_CM_BOOLEAN 0 0 0 255 ECU_ADDRESS 0 /end MEASUREMENT
/begin MEASUREMENT Rte_DiagMgr10_DiagStsWIRDisable_Cnt_lgc "MICROSAR RTE" UBYTE RTE_CM_BOOLEAN 0 0 0 255 ECU_ADDRESS 0 /end MEASUREMENT
/begin MEASUREMENT Rte_ModeMachine_StaMd8_SystemState8_Mode "MICROSAR RTE" UBYTE RTE_CM_ENUM_StaMd_Mode 0 0 0 255 ECU_ADDRESS 0 /end MEASUREMENT
/begin MEASUREMENT Rte_DiagSvc_AppSwFingerPrintData "MICROSAR RTE" UBYTE NO_COMPU_METHOD 0 0 0 255 MATRIX_DIM 14 1 1 ECU_ADDRESS 0 READ_WRITE /end MEASUREMENT
/begin MEASUREMENT Rte_DiagSvc_BootSwFingerPrintData "MICROSAR RTE" UBYTE NO_COMPU_METHOD 0 0 0 255 MATRIX_DIM 14 1 1 ECU_ADDRESS 0 READ_WRITE /end MEASUREMENT
/begin MEASUREMENT Rte_DiagSvc_CalSwFingerPrintData "MICROSAR RTE" UBYTE NO_COMPU_METHOD 0 0 0 255 MATRIX_DIM 14 1 1 ECU_ADDRESS 0 READ_WRITE /end MEASUREMENT
/begin MEASUREMENT Rte_DiagSvc_ECULifeTimeMinsData "MICROSAR RTE" ULONG NO_COMPU_METHOD 0 0 0 4294967295 ECU_ADDRESS 0 READ_WRITE /end MEASUREMENT
/begin MEASUREMENT Rte_DiagSvc_ECUSerialNumberData "MICROSAR RTE" UBYTE NO_COMPU_METHOD 0 0 0 255 MATRIX_DIM 16 1 1 ECU_ADDRESS 0 READ_WRITE /end MEASUREMENT
/begin MEASUREMENT Rte_DiagSvc_ECUSparePartNoData "MICROSAR RTE" UBYTE NO_COMPU_METHOD 0 0 0 255 MATRIX_DIM 11 1 1 ECU_ADDRESS 0 READ_WRITE /end MEASUREMENT
/begin MEASUREMENT Rte_DiagSvc_EOLConfigurationData "MICROSAR RTE" UBYTE NO_COMPU_METHOD 0 0 0 255 MATRIX_DIM 9 1 1 ECU_ADDRESS 0 READ_WRITE /end MEASUREMENT
/begin MEASUREMENT Rte_DiagSvc_EraseRoutineStatusData "MICROSAR RTE" UBYTE NO_COMPU_METHOD 0 0 0 255 MATRIX_DIM 1 1 1 ECU_ADDRESS 0 READ_WRITE /end MEASUREMENT
/begin MEASUREMENT Rte_DiagSvc_FirstDTCDetectMinsData "MICROSAR RTE" ULONG NO_COMPU_METHOD 0 0 0 4294967295 ECU_ADDRESS 0 READ_WRITE /end MEASUREMENT
/begin MEASUREMENT Rte_DiagSvc_FirstDTCDetectSecsData "MICROSAR RTE" UWORD NO_COMPU_METHOD 0 0 0 65535 ECU_ADDRESS 0 READ_WRITE /end MEASUREMENT
/begin MEASUREMENT Rte_DiagSvc_IgnitionPreStart_Cnt_lgc "MICROSAR RTE" UBYTE RTE_CM_BOOLEAN 0 0 0 255 ECU_ADDRESS 0 /end MEASUREMENT
/begin MEASUREMENT Rte_DiagSvc_OdometerFlashProgData "MICROSAR RTE" UWORD NO_COMPU_METHOD 0 0 0 65535 ECU_ADDRESS 0 READ_WRITE /end MEASUREMENT
/begin MEASUREMENT Rte_DiagSvc_ProgrammingAttemptCounterData "MICROSAR RTE" UBYTE NO_COMPU_METHOD 0 0 0 255 MATRIX_DIM 8 1 1 ECU_ADDRESS 0 READ_WRITE /end MEASUREMENT
/begin MEASUREMENT Rte_DiagSvc_ProgrammingStatusData "MICROSAR RTE" UBYTE NO_COMPU_METHOD 0 0 0 255 MATRIX_DIM 1 1 1 ECU_ADDRESS 0 READ_WRITE /end MEASUREMENT
/begin MEASUREMENT Rte_DiagSvc_ProxiConfigurationData "MICROSAR RTE" UBYTE NO_COMPU_METHOD 0 0 0 255 MATRIX_DIM 255 1 1 ECU_ADDRESS 0 READ_WRITE /end MEASUREMENT
/begin MEASUREMENT Rte_DiagSvc_ProxiCounterData "MICROSAR RTE" UBYTE NO_COMPU_METHOD 0 0 0 255 MATRIX_DIM 1 1 1 ECU_ADDRESS 0 READ_WRITE /end MEASUREMENT
/begin MEASUREMENT Rte_DiagSvc_TotalOdometerData "MICROSAR RTE" UWORD NO_COMPU_METHOD 0 0 0 65535 ECU_ADDRESS 0 READ_WRITE /end MEASUREMENT
/begin MEASUREMENT Rte_DiagSvc_TuningSetSelectData "MICROSAR RTE" UWORD NO_COMPU_METHOD 0 0 0 65535 ECU_ADDRESS 0 READ_WRITE /end MEASUREMENT
/begin MEASUREMENT Rte_DiagSvc_VINCurrentData "MICROSAR RTE" UBYTE NO_COMPU_METHOD 0 0 0 255 MATRIX_DIM 17 1 1 ECU_ADDRESS 0 READ_WRITE /end MEASUREMENT
/begin MEASUREMENT Rte_DiagSvc_VINOriginalData "MICROSAR RTE" UBYTE NO_COMPU_METHOD 0 0 0 255 MATRIX_DIM 17 1 1 ECU_ADDRESS 0 READ_WRITE /end MEASUREMENT
/begin MEASUREMENT Rte_DigHwTrqSENT_DigTrqTrim.k_EOLHwTrqTrimPerformed_Cnt_Lgc "MICROSAR RTE" UBYTE RTE_CM_BOOLEAN 0 0 0 255 ECU_ADDRESS 0 READ_WRITE /end MEASUREMENT
/begin MEASUREMENT Rte_DigHwTrqSENT_DigTrqTrim.k_EOLHwTrqTrim_HwNm_f32 "MICROSAR RTE" FLOAT32_IEEE NO_COMPU_METHOD 0 0 1.175494351e-38 3.402823466e+38 ECU_ADDRESS 0 READ_WRITE /end MEASUREMENT
/begin MEASUREMENT Rte_DigHwTrqSENT_HwTorque_HwNm_f32 "MICROSAR RTE" FLOAT32_IEEE NO_COMPU_METHOD 0 0 1.175494351e-38 3.402823466e+38 ECU_ADDRESS 0 /end MEASUREMENT
/begin MEASUREMENT Rte_DigHwTrqSENT_SrlComHwTrq_HwNm_f32 "MICROSAR RTE" FLOAT32_IEEE NO_COMPU_METHOD 0 0 1.175494351e-38 3.402823466e+38 ECU_ADDRESS 0 /end MEASUREMENT
/begin MEASUREMENT Rte_DigHwTrqSENT_SrlComHwTrqValid_Cnt_lgc "MICROSAR RTE" UBYTE RTE_CM_BOOLEAN 0 0 0 255 ECU_ADDRESS 0 /end MEASUREMENT
/begin MEASUREMENT Rte_DigHwTrqSENT_SysCHwTorque_HwNm_f32 "MICROSAR RTE" FLOAT32_IEEE NO_COMPU_METHOD 0 0 1.175494351e-38 3.402823466e+38 ECU_ADDRESS 0 /end MEASUREMENT
/begin MEASUREMENT Rte_Nhet1_DigHwTrqT1_HwNm_f32 "MICROSAR RTE" FLOAT32_IEEE NO_COMPU_METHOD 0 0 1.175494351e-38 3.402823466e+38 ECU_ADDRESS 0 /end MEASUREMENT
/begin MEASUREMENT Rte_Nhet1_DigHwTrqT2_HwNm_f32 "MICROSAR RTE" FLOAT32_IEEE NO_COMPU_METHOD 0 0 1.175494351e-38 3.402823466e+38 ECU_ADDRESS 0 /end MEASUREMENT
/begin MEASUREMENT Rte_DigMSB_AlignedCumMechMtrPosMRF_Deg_f32 "MICROSAR RTE" FLOAT32_IEEE NO_COMPU_METHOD 0 0 1.175494351e-38 3.402823466e+38 ECU_ADDRESS 0 /end MEASUREMENT
/begin MEASUREMENT Rte_DigMSB_CumMechMtrPosMRF_Deg_f32 "MICROSAR RTE" FLOAT32_IEEE NO_COMPU_METHOD 0 0 1.175494351e-38 3.402823466e+38 ECU_ADDRESS 0 /end MEASUREMENT
/begin MEASUREMENT Rte_DigMSB_CumMechMtrPosStatus_Cnt_u08 "MICROSAR RTE" UBYTE NO_COMPU_METHOD 0 0 0 255 ECU_ADDRESS 0 /end MEASUREMENT
/begin MEASUREMENT Rte_DigMSB_DigMSBEOLData.CRC_Cnt_u16 "MICROSAR RTE" UWORD NO_COMPU_METHOD 0 0 0 65535 ECU_ADDRESS 0 READ_WRITE /end MEASUREMENT
/begin MEASUREMENT Rte_DigMSB_DigMSBEOLData.MtrPos1HarCompTbl_Rev_s2p13 "MICROSAR RTE" SWORD NO_COMPU_METHOD 0 0 -32768 32767 MATRIX_DIM 1024 1 1 ECU_ADDRESS 0 READ_WRITE /end MEASUREMENT
/begin MEASUREMENT Rte_DigMSB_DigMSBEOLData.MtrPos2HarCompTbl_Rev_s2p13 "MICROSAR RTE" SWORD NO_COMPU_METHOD 0 0 -32768 32767 MATRIX_DIM 1024 1 1 ECU_ADDRESS 0 READ_WRITE /end MEASUREMENT
/begin MEASUREMENT Rte_DigMSB_DigMSBEOLData.MtrPosBEMFRedundant_Rev_u0p16 "MICROSAR RTE" UWORD NO_COMPU_METHOD 0 0 0 65535 ECU_ADDRESS 0 READ_WRITE /end MEASUREMENT
/begin MEASUREMENT Rte_DigMSB_DigMSBEOLData.MtrPosBEMF_Rev_u0p16 "MICROSAR RTE" UWORD NO_COMPU_METHOD 0 0 0 65535 ECU_ADDRESS 0 READ_WRITE /end MEASUREMENT
/begin MEASUREMENT Rte_DigMSB_MechMtrPos2_Rev_u0p16 "MICROSAR RTE" UWORD NO_COMPU_METHOD 0 0 0 65535 ECU_ADDRESS 0 /end MEASUREMENT
/begin MEASUREMENT Rte_DigMSB_SysCCumMechMtrPosMRF_Deg_f32 "MICROSAR RTE" FLOAT32_IEEE NO_COMPU_METHOD 0 0 1.175494351e-38 3.402823466e+38 ECU_ADDRESS 0 /end MEASUREMENT
/begin MEASUREMENT Rte_MtrDrvDiag_GateDriveResetActive_Cnt_lgc "MICROSAR RTE" UBYTE RTE_CM_BOOLEAN 0 0 0 255 ECU_ADDRESS 0 /end MEASUREMENT
/begin MEASUREMENT Rte_DigPhsReasDiag_PDActivateTest_Cnt_lgc "MICROSAR RTE" UBYTE RTE_CM_BOOLEAN 0 0 0 255 ECU_ADDRESS 0 /end MEASUREMENT
/begin MEASUREMENT Rte_EOTActuatorMng_AssistEOTDamping_MtrNm_f32 "MICROSAR RTE" FLOAT32_IEEE NO_COMPU_METHOD 0 0 1.175494351e-38 3.402823466e+38 ECU_ADDRESS 0 /end MEASUREMENT
/begin MEASUREMENT Rte_EOTActuatorMng_AssistEOTGain_Uls_f32 "MICROSAR RTE" FLOAT32_IEEE NO_COMPU_METHOD 0 0 1.175494351e-38 3.402823466e+38 ECU_ADDRESS 0 /end MEASUREMENT
/begin MEASUREMENT Rte_EOTActuatorMng_AssistEOTLimit_MtrNm_f32 "MICROSAR RTE" FLOAT32_IEEE NO_COMPU_METHOD 0 0 1.175494351e-38 3.402823466e+38 ECU_ADDRESS 0 /end MEASUREMENT
/begin MEASUREMENT Rte_LrnEOT_CCWPosition_HwDeg_f32 "MICROSAR RTE" FLOAT32_IEEE NO_COMPU_METHOD 0 0 1.175494351e-38 3.402823466e+38 ECU_ADDRESS 0 /end MEASUREMENT
/begin MEASUREMENT Rte_LrnEOT_CCWFound_Cnt_lgc "MICROSAR RTE" UBYTE RTE_CM_BOOLEAN 0 0 0 255 ECU_ADDRESS 0 /end MEASUREMENT
/begin MEASUREMENT Rte_LrnEOT_CWPosition_HwDeg_f32 "MICROSAR RTE" FLOAT32_IEEE NO_COMPU_METHOD 0 0 1.175494351e-38 3.402823466e+38 ECU_ADDRESS 0 /end MEASUREMENT
/begin MEASUREMENT Rte_LrnEOT_CWFound_Cnt_lgc "MICROSAR RTE" UBYTE RTE_CM_BOOLEAN 0 0 0 255 ECU_ADDRESS 0 /end MEASUREMENT
/begin MEASUREMENT Rte_ElePwr_ElectricPower_Watt_f32 "MICROSAR RTE" FLOAT32_IEEE NO_COMPU_METHOD 0 0 1.175494351e-38 3.402823466e+38 ECU_ADDRESS 0 /end MEASUREMENT
/begin MEASUREMENT Rte_ElePwr_SupplyCurrent_Amp_f32 "MICROSAR RTE" FLOAT32_IEEE NO_COMPU_METHOD 0 0 1.175494351e-38 3.402823466e+38 ECU_ADDRESS 0 /end MEASUREMENT
/begin MEASUREMENT Rte_FrqDepDmpnInrtCmp_VehicleLonAccel_KphpS_f32 "MICROSAR RTE" FLOAT32_IEEE NO_COMPU_METHOD 0 0 1.175494351e-38 3.402823466e+38 ECU_ADDRESS 0 /end MEASUREMENT
/begin MEASUREMENT Rte_FrqDepDmpnInrtCmp_WIRCmdAmpBlnd_MtrNm_f32 "MICROSAR RTE" FLOAT32_IEEE NO_COMPU_METHOD 0 0 1.175494351e-38 3.402823466e+38 ECU_ADDRESS 0 /end MEASUREMENT
/begin MEASUREMENT Rte_Polarity_SysC_MtrElecMechPolarity_Cnt_s32 "MICROSAR RTE" SLONG NO_COMPU_METHOD 0 0 -2147483648 2147483647 ECU_ADDRESS 0 /end MEASUREMENT
/begin MEASUREMENT Rte_HiLoadStall_AssistStallLimit_MtrNm_f32 "MICROSAR RTE" FLOAT32_IEEE NO_COMPU_METHOD 0 0 1.175494351e-38 3.402823466e+38 ECU_ADDRESS 0 /end MEASUREMENT
/begin MEASUREMENT Rte_HighFreqAssist_WIRCmdAmpBlnd_MtrNm_f32 "MICROSAR RTE" FLOAT32_IEEE NO_COMPU_METHOD 0 0 1.175494351e-38 3.402823466e+38 ECU_ADDRESS 0 /end MEASUREMENT
/begin MEASUREMENT Rte_MtrDrvDiag_MtrDrvrInitComplete_Cnt_lgc "MICROSAR RTE" UBYTE RTE_CM_BOOLEAN 0 0 0 255 ECU_ADDRESS 0 /end MEASUREMENT
/begin MEASUREMENT Rte_HwPwUp_MtrDrvrInitStart_Cnt_lgc "MICROSAR RTE" UBYTE RTE_CM_BOOLEAN 0 0 0 255 ECU_ADDRESS 0 /end MEASUREMENT
/begin MEASUREMENT Rte_TmprlMon_TMFTestComplete_Cnt_lgc "MICROSAR RTE" UBYTE RTE_CM_BOOLEAN 0 0 0 255 ECU_ADDRESS 0 /end MEASUREMENT
/begin MEASUREMENT Rte_HwPwUp_TMFTestStart_Cnt_lgc "MICROSAR RTE" UBYTE RTE_CM_BOOLEAN 0 0 0 255 ECU_ADDRESS 0 /end MEASUREMENT
/begin GROUP CDDInterface.SenderPorts "MICROSAR RTE"
 /begin SUB_GROUP CDDInterface.ADCMtrCurr1.Volts_f32 CDDInterface.ADCMtrCurr2.Volts_f32 CDDInterface.CorrMtrCurrPosition.Rev_f32 CDDInterface.CorrMtrPosElec.Rev_f32 CDDInterface.CorrectedElecMtrPos.Rev_u0p16 CDDInterface.CumMechMtrPos.Rev_f32 CDDInterface.DampingSrlComSvcDft.Cnt_lgc CDDInterface.DftAsstTbl.Cnt_lgc CDDInterface.Die1RxError.Cnt_u16 CDDInterface.Die1RxMtrPos.Cnt_u16 CDDInterface.Die1RxRevCtr.Cnt_u16 CDDInterface.Die1UnderVoltgFltAccum.Cnt_u16 CDDInterface.Die2RxError.Cnt_u16 CDDInterface.Die2RxMtrPos.Cnt_u16 CDDInterface.Die2RxRevCtr.Cnt_u16 CDDInterface.DrivingDynSrlComSvcDft.Cnt_lgc CDDInterface.DwnldAsstGain.Uls_f32 CDDInterface.EOTImpactSrlComSvcDft.Cnt_lgc CDDInterface.EOTThermalSrlComSvcDft.Cnt_lgc CDDInterface.EngONSrlComSvcDft.Cnt_lgc CDDInterface.ExpectedOnTimeA.Cnt_u32 CDDInterface.ExpectedOnTimeB.Cnt_u32 CDDInterface.ExpectedOnTimeC.Cnt_u32 CDDInterface.FreqDepDmpSrlComSvcDft.Cnt_lgc CDDInterface.FricLrnSrlComSvcDft.Cnt_lgc CDDInterface.HysAddSrlComSvcDft.Cnt_lgc CDDInterface.HystCompSrlComSvcDft.Cnt_lgc CDDInterface.IgnCnt.Cnt_u16 CDDInterface.KinIntDiagSrlComSvcDft.Cnt_lgc CDDInterface.LRPRPhaseadvanceCaptured.Cnt_s16 CDDInterface.LimitSrlComSvcDft.Cnt_lgc CDDInterface.MEC.Cnt_enum CDDInterface.MeasuredOnTimeA.Cnt_u32 CDDInterface.MeasuredOnTimeB.Cnt_u32 CDDInterface.MeasuredOnTimeC.Cnt_u32 CDDInterface.MechMtrPos1.Rev_f32 CDDInterface.MechMtrPos1TimeStamp.USec_u32 CDDInterface.MechMtrPos2TimeStamp.USec_u32 CDDInterface.MfgDiagInhibit.Cnt_lgc CDDInterface.ModIdxFinal.Uls_f32 CDDInterface.ModIdxSrlComSvcDft.Cnt_lgc CDDInterface.MtrCurrDax.Amp_f32 CDDInterface.MtrCurrK1.Amp_f32 CDDInterface.MtrCurrK2.Amp_f32 CDDInterface.MtrCurrQax.Amp_f32 CDDInterface.MtrCurrQaxFinalRef.Amp_f32 CDDInterface.MtrParmNrmLrnSrlComSvcDft.Cnt_lgc CDDInterface.MtrVelNrmLrnSrlComSvcDft.Cnt_lgc CDDInterface.MtrVoltDax.Volt_f32 CDDInterface.MtrVoltQax.Volt_f32 CDDInterface.MultIgnSrlComSvcDft.Cnt_lgc CDDInterface.ParkAstSrlComSvcDft.Cnt_lgc CDDInterface.PullCompSrlComSvcDft.Cnt_lgc CDDInterface.ReturnSrlComSvcDft.Cnt_lgc CDDInterface.RxMsgsSrlComSvcDft.Cnt_lgc CDDInterface.RxMtrPosParityAccum.Cnt_u16 CDDInterface.SrlComSvcDft.Cnt_b32 CDDInterface.SysCCorrMtrPosElec.Rev_f32 CDDInterface.SysCVSwitchADC.Cnt_u16 CDDInterface.ThermalDCSrlComSvcDft.Cnt_lgc CDDInterface.TrqRmpSrlComSvcDft.Cnt_lgc CDDInterface.UncorrMechMtrPos1.Rev_u0p16 CDDInterface.WhlImbRejSrlComSvcDft.Cnt_lgc /end SUB_GROUP
 /begin FUNCTION_LIST /end FUNCTION_LIST
 /begin REF_CHARACTERISTIC /end REF_CHARACTERISTIC
 /begin REF_MEASUREMENT /end REF_MEASUREMENT
/end GROUP
/begin GROUP CDDInterface.SrlComSvcDft.Cnt_b32 "MICROSAR RTE" /begin SUB_GROUP /end SUB_GROUP /begin FUNCTION_LIST /end FUNCTION_LIST /begin REF_CHARACTERISTIC /end REF_CHARACTERISTIC /begin REF_MEASUREMENT Rte_CDDInterface_SrlComSvcDft_Cnt_b32 /end REF_MEASUREMENT /end GROUP
/begin GROUP CDDInterface.SysCCorrMtrPosElec.Rev_f32 "MICROSAR RTE" /begin SUB_GROUP /end SUB_GROUP /begin FUNCTION_LIST /end FUNCTION_LIST /begin REF_CHARACTERISTIC /end REF_CHARACTERISTIC /begin REF_MEASUREMENT Rte_CDDInterface_SysCCorrMtrPosElec_Rev_f32 /end REF_MEASUREMENT /end GROUP
/begin GROUP CDDInterface.SysCVSwitchADC.Cnt_u16 "MICROSAR RTE" /begin SUB_GROUP /end SUB_GROUP /begin FUNCTION_LIST /end FUNCTION_LIST /begin REF_CHARACTERISTIC /end REF_CHARACTERISTIC /begin REF_MEASUREMENT Rte_CDDInterface_SysCVSwitchADC_Cnt_u16 /end REF_MEASUREMENT /end GROUP
/begin GROUP CDDInterface.SystemState.Mode "MICROSAR RTE" /begin SUB_GROUP /end SUB_GROUP /begin FUNCTION_LIST /end FUNCTION_LIST /begin REF_CHARACTERISTIC /end REF_CHARACTERISTIC /end GROUP
/begin GROUP CDDInterface.ThermalDCSrlComSvcDft.Cnt_lgc "MICROSAR RTE" /begin SUB_GROUP /end SUB_GROUP /begin FUNCTION_LIST /end FUNCTION_LIST /begin REF_CHARACTERISTIC /end REF_CHARACTERISTIC /begin REF_MEASUREMENT Rte_CDDInterface_ThermalDCSrlComSvcDft_Cnt_lgc /end REF_MEASUREMENT /end GROUP
/begin GROUP CDDInterface.TrqRmpSrlComSvcDft.Cnt_lgc "MICROSAR RTE" /begin SUB_GROUP /end SUB_GROUP /begin FUNCTION_LIST /end FUNCTION_LIST /begin REF_CHARACTERISTIC /end REF_CHARACTERISTIC /begin REF_MEASUREMENT Rte_CDDInterface_TrqRmpSrlComSvcDft_Cnt_lgc /end REF_MEASUREMENT /end GROUP
/begin GROUP CDDInterface.UncorrMechMtrPos1.Rev_u0p16 "MICROSAR RTE" /begin SUB_GROUP /end SUB_GROUP /begin FUNCTION_LIST /end FUNCTION_LIST /begin REF_CHARACTERISTIC /end REF_CHARACTERISTIC /begin REF_MEASUREMENT Rte_CDDInterface_UncorrMechMtrPos1_Rev_u0p16 /end REF_MEASUREMENT /end GROUP
/begin GROUP CDDInterface.Vecu.Volt_f32 "MICROSAR RTE" /begin SUB_GROUP /end SUB_GROUP /begin FUNCTION_LIST /end FUNCTION_LIST /begin REF_CHARACTERISTIC /end REF_CHARACTERISTIC /end GROUP
/begin GROUP CDDInterface.WhlImbRejSrlComSvcDft.Cnt_lgc "MICROSAR RTE" /begin SUB_GROUP /end SUB_GROUP /begin FUNCTION_LIST /end FUNCTION_LIST /begin REF_CHARACTERISTIC /end REF_CHARACTERISTIC /begin REF_MEASUREMENT Rte_CDDInterface_WhlImbRejSrlComSvcDft_Cnt_lgc /end REF_MEASUREMENT /end GROUP
/begin GROUP CmMtrCurr "MICROSAR RTE"
 /begin SUB_GROUP CmMtrCurr.ModeRequirePorts CmMtrCurr.PerInstanceMemories CmMtrCurr.ReceiverPorts CmMtrCurr.SenderPorts /end SUB_GROUP
 /begin FUNCTION_LIST /end FUNCTION_LIST
 /begin REF_CHARACTERISTIC /end REF_CHARACTERISTIC
 /begin REF_MEASUREMENT /end REF_MEASUREMENT
/end GROUP
/begin GROUP CmMtrCurr.ADCMtrCurr1.Volts_f32 "MICROSAR RTE" /begin SUB_GROUP /end SUB_GROUP /begin FUNCTION_LIST /end FUNCTION_LIST /begin REF_CHARACTERISTIC /end REF_CHARACTERISTIC /end GROUP
/begin GROUP CmMtrCurr.ADCMtrCurr2.Volts_f32 "MICROSAR RTE" /begin SUB_GROUP /end SUB_GROUP /begin FUNCTION_LIST /end FUNCTION_LIST /begin REF_CHARACTERISTIC /end REF_CHARACTERISTIC /end GROUP
/begin GROUP CmMtrCurr.ComOffset.Cnt_u16 "MICROSAR RTE" /begin SUB_GROUP /end SUB_GROUP /begin FUNCTION_LIST /end FUNCTION_LIST /begin REF_CHARACTERISTIC /end REF_CHARACTERISTIC /end GROUP
/begin GROUP CmMtrCurr.CorrMtrCurrPosition.Rev_f32 "MICROSAR RTE" /begin SUB_GROUP /end SUB_GROUP /begin FUNCTION_LIST /end FUNCTION_LIST /begin REF_CHARACTERISTIC /end REF_CHARACTERISTIC /end GROUP
/begin GROUP CmMtrCurr.CurrTempOffset "MICROSAR RTE" /begin SUB_GROUP /end SUB_GROUP /begin FUNCTION_LIST /end FUNCTION_LIST /begin REF_CHARACTERISTIC /end REF_CHARACTERISTIC
 /begin REF_MEASUREMENT Rte_CmMtrCurr_CurrTempOffset.CurrOffsetY1_Volts_s4p11 Rte_CmMtrCurr_CurrTempOffset.CurrOffsetY2_Volts_s4p11 Rte_CmMtrCurr_CurrTempOffset.CurrTempOffsetX_DegC_s10p5 /end REF_MEASUREMENT
/end GROUP
/begin GROUP CmMtrCurr.CurrentGainSvc.Cnt_lgc "MICROSAR RTE" /begin SUB_GROUP /end SUB_GROUP /begin FUNCTION_LIST /end FUNCTION_LIST /begin REF_CHARACTERISTIC /end REF_CHARACTERISTIC /begin REF_MEASUREMENT Rte_CmMtrCurr_CurrentGainSvc_Cnt_lgc /end REF_MEASUREMENT /end GROUP
/begin GROUP CmMtrCurr.FiltCntrlTemp.DegC_f32 "MICROSAR RTE" /begin SUB_GROUP /end SUB_GROUP /begin FUNCTION_LIST /end FUNCTION_LIST /begin REF_CHARACTERISTIC /end REF_CHARACTERISTIC /begin REF_MEASUREMENT Rte_CtrlTemp_FiltMeasTemp_DegC_f32 /end REF_MEASUREMENT /end GROUP
/begin GROUP CmMtrCurr.MEC.Cnt_enum "MICROSAR RTE" /begin SUB_GROUP /end SUB_GROUP /begin FUNCTION_LIST /end FUNCTION_LIST /begin REF_CHARACTERISTIC /end REF_CHARACTERISTIC /end GROUP
/begin GROUP CmMtrCurr.ModeRequirePorts "MICROSAR RTE" /begin SUB_GROUP CmMtrCurr.SystemState.Mode /end SUB_GROUP /begin FUNCTION_LIST /end FUNCTION_LIST /begin REF_CHARACTERISTIC /end REF_CHARACTERISTIC /begin REF_MEASUREMENT /end REF_MEASUREMENT /end GROUP
/begin GROUP CmMtrCurr.MtrCurr1TempOffset.Volt_f32 "MICROSAR RTE" /begin SUB_GROUP /end SUB_GROUP /begin FUNCTION_LIST /end FUNCTION_LIST /begin REF_CHARACTERISTIC /end REF_CHARACTERISTIC /end GROUP
/begin GROUP CmMtrCurr.MtrCurr2TempOffset.Volt_f32 "MICROSAR RTE" /begin SUB_GROUP /end SUB_GROUP /begin FUNCTION_LIST /end FUNCTION_LIST /begin REF_CHARACTERISTIC /end REF_CHARACTERISTIC /end GROUP
/begin GROUP CmMtrCurr.MtrCurrAngle.Rev_f32 "MICROSAR RTE" /begin SUB_GROUP /end SUB_GROUP /begin FUNCTION_LIST /end FUNCTION_LIST /begin REF_CHARACTERISTIC /end REF_CHARACTERISTIC /begin REF_MEASUREMENT Rte_CurrCmd_MtrCurrAngle_Rev_f32 /end REF_MEASUREMENT /end GROUP
/begin GROUP CmMtrCurr.MtrCurrK1.Amp_f32 "MICROSAR RTE" /begin SUB_GROUP /end SUB_GROUP /begin FUNCTION_LIST /end FUNCTION_LIST /begin REF_CHARACTERISTIC /end REF_CHARACTERISTIC /end GROUP
/begin GROUP CmMtrCurr.MtrCurrK2.Amp_f32 "MICROSAR RTE" /begin SUB_GROUP /end SUB_GROUP /begin FUNCTION_LIST /end FUNCTION_LIST /begin REF_CHARACTERISTIC /end REF_CHARACTERISTIC /end GROUP
/begin GROUP CmMtrCurr.MtrVel.MtrRadpS_f32 "MICROSAR RTE" /begin SUB_GROUP /end SUB_GROUP /begin FUNCTION_LIST /end FUNCTION_LIST /begin REF_CHARACTERISTIC /end REF_CHARACTERISTIC /end GROUP
/begin GROUP CmMtrCurr.PerInstanceMemories "MICROSAR RTE" /begin SUB_GROUP CmMtrCurr.CurrTempOffset CmMtrCurr.ShCurrCal /end SUB_GROUP /begin FUNCTION_LIST /end FUNCTION_LIST /begin REF_CHARACTERISTIC /end REF_CHARACTERISTIC /begin REF_MEASUREMENT /end REF_MEASUREMENT /end GROUP
/begin GROUP CmMtrCurr.ReceiverPorts "MICROSAR RTE"
 /begin SUB_GROUP CmMtrCurr.ADCMtrCurr1.Volts_f32 CmMtrCurr.ADCMtrCurr2.Volts_f32 CmMtrCurr.CorrMtrCurrPosition.Rev_f32 CmMtrCurr.FiltCntrlTemp.DegC_f32 CmMtrCurr.MEC.Cnt_enum CmMtrCurr.MtrCurrAngle.Rev_f32 CmMtrCurr.MtrCurrK1.Amp_f32 CmMtrCurr.MtrCurrK2.Amp_f32 CmMtrCurr.MtrVel.MtrRadpS_f32 CmMtrCurr.SrlComSvcDft.Cnt_b32 CmMtrCurr.Vecu.Volt_f32 CmMtrCurr.VehSpd.Kph_f32 CmMtrCurr.VhSpdValid.Cnt_lgc /end SUB_GROUP
 /begin FUNCTION_LIST /end FUNCTION_LIST
 /begin REF_CHARACTERISTIC /end REF_CHARACTERISTIC
 /begin REF_MEASUREMENT /end REF_MEASUREMENT
/end GROUP
/begin GROUP CmMtrCurr.SenderPorts "MICROSAR RTE"
 /begin SUB_GROUP CmMtrCurr.ComOffset.Cnt_u16 CmMtrCurr.CurrentGainSvc.Cnt_lgc CmMtrCurr.MtrCurr1TempOffset.Volt_f32 CmMtrCurr.MtrCurr2TempOffset.Volt_f32 /end SUB_GROUP
 /begin FUNCTION_LIST /end FUNCTION_LIST
 /begin REF_CHARACTERISTIC /end REF_CHARACTERISTIC
 /begin REF_MEASUREMENT /end REF_MEASUREMENT
/end GROUP
/begin GROUP CmMtrCurr.ShCurrCal "MICROSAR RTE" /begin SUB_GROUP /end SUB_GROUP /begin FUNCTION_LIST /end FUNCTION_LIST /begin REF_CHARACTERISTIC /end REF_CHARACTERISTIC
 /begin REF_MEASUREMENT Rte_CmMtrCurr_ShCurrCal.EOLMtrCurr1OffsetDiff_Volts_f32 Rte_CmMtrCurr_ShCurrCal.EOLMtrCurr1OffsetLo_Volts_f32 Rte_CmMtrCurr_ShCurrCal.EOLMtrCurr2OffsetDiff_Volts_f32 Rte_CmMtrCurr_ShCurrCal.EOLMtrCurr2OffsetLo_Volts_f32 Rte_CmMtrCurr_ShCurrCal.EOLMtrCurrVcalCmd_VoltCnts_f32 Rte_CmMtrCurr_ShCurrCal.EOLPhscurr1Gain_AmpspVolt_f32 Rte_CmMtrCurr_ShCurrCal.EOLPhscurr2Gain_AmpspVolt_f32 /end REF_MEASUREMENT
/end GROUP
/begin GROUP CmMtrCurr.SrlComSvcDft.Cnt_b32 "MICROSAR RTE" /begin SUB_GROUP /end SUB_GROUP /begin FUNCTION_LIST /end FUNCTION_LIST /begin REF_CHARACTERISTIC /end REF_CHARACTERISTIC /begin REF_MEASUREMENT Rte_CDDInterface_SrlComSvcDft_Cnt_b32 /end REF_MEASUREMENT /end GROUP
/begin GROUP CmMtrCurr.SystemState.Mode "MICROSAR RTE" /begin SUB_GROUP /end SUB_GROUP /begin FUNCTION_LIST /end FUNCTION_LIST /begin REF_CHARACTERISTIC /end REF_CHARACTERISTIC /end GROUP
/begin GROUP CmMtrCurr.Vecu.Volt_f32 "MICROSAR RTE" /begin SUB_GROUP /end SUB_GROUP /begin FUNCTION_LIST /end FUNCTION_LIST /begin REF_CHARACTERISTIC /end REF_CHARACTERISTIC /end GROUP
/begin GROUP CmMtrCurr.VehSpd.Kph_f32 "MICROSAR RTE" /begin SUB_GROUP /end SUB_GROUP /begin FUNCTION_LIST /end FUNCTION_LIST /begin REF_CHARACTERISTIC /end REF_CHARACTERISTIC /end GROUP
/begin GROUP CmMtrCurr.VhSpdValid.Cnt_lgc "MICROSAR RTE" /begin SUB_GROUP /end SUB_GROUP /begin FUNCTION_LIST /end FUNCTION_LIST /begin REF_CHARACTERISTIC /end REF_CHARACTERISTIC /end GROUP
/begin GROUP ComplErr "MICROSAR RTE" /begin SUB_GROUP ComplErr.ReceiverPorts ComplErr.SenderPorts /end SUB_GROUP /begin FUNCTION_LIST /end FUNCTION_LIST /begin REF_CHARACTERISTIC /end REF_CHARACTERISTIC /begin REF_MEASUREMENT /end REF_MEASUREMENT /end GROUP
/begin GROUP ComplErr.ComplErr.HwDeg_f32 "MICROSAR RTE" /begin SUB_GROUP /end SUB_GROUP /begin FUNCTION_LIST /end FUNCTION_LIST /begin REF_CHARACTERISTIC /end REF_CHARACTERISTIC /end GROUP
/begin GROUP ComplErr.ReceiverPorts "MICROSAR RTE" /begin SUB_GROUP ComplErr.TorqueCmdCRF.MtrNm_f32 /end SUB_GROUP /begin FUNCTION_LIST /end FUNCTION_LIST /begin REF_CHARACTERISTIC /end REF_CHARACTERISTIC /begin REF_MEASUREMENT /end REF_MEASUREMENT /end GROUP
/begin GROUP ComplErr.SenderPorts "MICROSAR RTE" /begin SUB_GROUP ComplErr.ComplErr.HwDeg_f32 /end SUB_GROUP /begin FUNCTION_LIST /end FUNCTION_LIST /begin REF_CHARACTERISTIC /end REF_CHARACTERISTIC /begin REF_MEASUREMENT /end REF_MEASUREMENT /end GROUP
/begin GROUP ComplErr.TorqueCmdCRF.MtrNm_f32 "MICROSAR RTE" /begin SUB_GROUP /end SUB_GROUP /begin FUNCTION_LIST /end FUNCTION_LIST /begin REF_CHARACTERISTIC /end REF_CHARACTERISTIC /end GROUP
/begin GROUP CtrlTemp "MICROSAR RTE" /begin SUB_GROUP CtrlTemp.ReceiverPorts CtrlTemp.SenderPorts /end SUB_GROUP /begin FUNCTION_LIST /end FUNCTION_LIST /begin REF_CHARACTERISTIC /end REF_CHARACTERISTIC /begin REF_MEASUREMENT /end REF_MEASUREMENT /end GROUP
/begin GROUP CtrlTemp.AmbTemp.DegC_f32 "MICROSAR RTE" /begin SUB_GROUP /end SUB_GROUP /begin FUNCTION_LIST /end FUNCTION_LIST /begin REF_CHARACTERISTIC /end REF_CHARACTERISTIC /begin REF_MEASUREMENT Rte_CtrlTemp_AmbTemp_DegC_f32 /end REF_MEASUREMENT /end GROUP
/begin GROUP CtrlTemp.DiagStsTempRdPrf.Cnt_lgc "MICROSAR RTE" /begin SUB_GROUP /end SUB_GROUP /begin FUNCTION_LIST /end FUNCTION_LIST /begin REF_CHARACTERISTIC /end REF_CHARACTERISTIC /begin REF_MEASUREMENT Rte_DiagMgr10_DiagStsDefTemp_Cnt_lgc /end REF_MEASUREMENT /end GROUP
/begin GROUP CtrlTemp.FiltMeasTemp.DegC_f32 "MICROSAR RTE" /begin SUB_GROUP /end SUB_GROUP /begin FUNCTION_LIST /end FUNCTION_LIST /begin REF_CHARACTERISTIC /end REF_CHARACTERISTIC /begin REF_MEASUREMENT Rte_CtrlTemp_FiltMeasTemp_DegC_f32 /end REF_MEASUREMENT /end GROUP
/begin GROUP CtrlTemp.ReceiverPorts "MICROSAR RTE"
 /begin SUB_GROUP CtrlTemp.AmbTemp.DegC_f32 CtrlTemp.DiagStsTempRdPrf.Cnt_lgc CtrlTemp.TemperatureADC.Volt_f32 /end SUB_GROUP
 /begin FUNCTION_LIST /end FUNCTION_LIST
 /begin REF_CHARACTERISTIC /end REF_CHARACTERISTIC
 /begin REF_MEASUREMENT /end REF_MEASUREMENT
/end GROUP
/begin GROUP CtrlTemp.SenderPorts "MICROSAR RTE" /begin SUB_GROUP CtrlTemp.FiltMeasTemp.DegC_f32 /end SUB_GROUP /begin FUNCTION_LIST /end FUNCTION_LIST /begin REF_CHARACTERISTIC /end REF_CHARACTERISTIC /begin REF_MEASUREMENT /end REF_MEASUREMENT /end GROUP
/begin GROUP CtrlTemp.TemperatureADC.Volt_f32 "MICROSAR RTE" /begin SUB_GROUP /end SUB_GROUP /begin FUNCTION_LIST /end FUNCTION_LIST /begin REF_CHARACTERISTIC /end REF_CHARACTERISTIC /begin REF_MEASUREMENT Rte_IoHwAbstractionUsr_TemperatureADC_Volt_f32 /end REF_MEASUREMENT /end GROUP
/begin GROUP CtrldDisShtdn "MICROSAR RTE"
 /begin SUB_GROUP CtrldDisShtdn.ModeRequirePorts CtrldDisShtdn.ReceiverPorts CtrldDisShtdn.SenderPorts /end SUB_GROUP
 /begin FUNCTION_LIST /end FUNCTION_LIST
 /begin REF_CHARACTERISTIC /end REF_CHARACTERISTIC
 /begin REF_MEASUREMENT /end REF_MEASUREMENT
/end GROUP
/begin GROUP CtrldDisShtdn.AssistAssyPolarity.Cnt_s08 "MICROSAR RTE" /begin SUB_GROUP /end SUB_GROUP /begin FUNCTION_LIST /end FUNCTION_LIST /begin REF_CHARACTERISTIC /end REF_CHARACTERISTIC /begin REF_MEASUREMENT Rte_Polarity_AssistAssyPolarity_Cnt_s08 /end REF_MEASUREMENT /end GROUP
/begin GROUP CtrldDisShtdn.CRFMtrVel.MtrRadpS_f32 "MICROSAR RTE" /begin SUB_GROUP /end SUB_GROUP /begin FUNCTION_LIST /end FUNCTION_LIST /begin REF_CHARACTERISTIC /end REF_CHARACTERISTIC /begin REF_MEASUREMENT Rte_MtrVel_MotorVelCRF_MtrRadpS_f32 /end REF_MEASUREMENT /end GROUP
/begin GROUP CtrldDisShtdn.CntDisMtrTrqCmdCRF.MtrNm_f32 "MICROSAR RTE" /begin SUB_GROUP /end SUB_GROUP /begin FUNCTION_LIST /end FUNCTION_LIST /begin REF_CHARACTERISTIC /end REF_CHARACTERISTIC /end GROUP
/begin GROUP CtrldDisShtdn.CntDisMtrTrqCmdMRF.MtrNm_f32 "MICROSAR RTE" /begin SUB_GROUP /end SUB_GROUP /begin FUNCTION_LIST /end FUNCTION_LIST /begin REF_CHARACTERISTIC /end REF_CHARACTERISTIC /begin REF_MEASUREMENT Rte_CtrldDisShtdn_CntDisMtrTrqCmdMRF_MtrNm_f32 /end REF_MEASUREMENT /end GROUP
/begin GROUP CtrldDisShtdn.CtrldDmpStsCmp.Cnt_lgc "MICROSAR RTE" /begin SUB_GROUP /end SUB_GROUP /begin FUNCTION_LIST /end FUNCTION_LIST /begin REF_CHARACTERISTIC /end REF_CHARACTERISTIC /begin REF_MEASUREMENT Rte_CtrldDisShtdn_CtrldDmpStsCmp_Cnt_lgc /end REF_MEASUREMENT /end GROUP
/begin GROUP CtrldDisShtdn.DiagStsF2Active.Cnt_lgc "MICROSAR RTE" /begin SUB_GROUP /end SUB_GROUP /begin FUNCTION_LIST /end FUNCTION_LIST /begin REF_CHARACTERISTIC /end REF_CHARACTERISTIC /begin REF_MEASUREMENT Rte_DiagMgr10_DiagStsCtrldDisRmpPres_Cnt_lgc /end REF_MEASUREMENT /end GROUP
/begin GROUP CtrldDisShtdn.ModeRequirePorts "MICROSAR RTE" /begin SUB_GROUP CtrldDisShtdn.SystemState.Mode /end SUB_GROUP /begin FUNCTION_LIST /end FUNCTION_LIST /begin REF_CHARACTERISTIC /end REF_CHARACTERISTIC /begin REF_MEASUREMENT /end REF_MEASUREMENT /end GROUP
/begin GROUP CtrldDisShtdn.ReceiverPorts "MICROSAR RTE"
 /begin SUB_GROUP CtrldDisShtdn.AssistAssyPolarity.Cnt_s08 CtrldDisShtdn.CRFMtrVel.MtrRadpS_f32 CtrldDisShtdn.DiagStsF2Active.Cnt_lgc CtrldDisShtdn.SumLimTrqCmd.MtrNm_f32 /end SUB_GROUP
 /begin FUNCTION_LIST /end FUNCTION_LIST
 /begin REF_CHARACTERISTIC /end REF_CHARACTERISTIC
 /begin REF_MEASUREMENT /end REF_MEASUREMENT
/end GROUP
/begin GROUP CtrldDisShtdn.SenderPorts "MICROSAR RTE"
 /begin SUB_GROUP CtrldDisShtdn.CntDisMtrTrqCmdCRF.MtrNm_f32 CtrldDisShtdn.CntDisMtrTrqCmdMRF.MtrNm_f32 CtrldDisShtdn.CtrldDmpStsCmp.Cnt_lgc CtrldDisShtdn.SysC_CRFMtrTrqCmd.MtrNm_f32 CtrldDisShtdn.SysC_MRFMtrTrqCmd.MtrNm_f32 /end SUB_GROUP
 /begin FUNCTION_LIST /end FUNCTION_LIST
 /begin REF_CHARACTERISTIC /end REF_CHARACTERISTIC
 /begin REF_MEASUREMENT /end REF_MEASUREMENT
/end GROUP
/begin GROUP CtrldDisShtdn.SumLimTrqCmd.MtrNm_f32 "MICROSAR RTE" /begin SUB_GROUP /end SUB_GROUP /begin FUNCTION_LIST /end FUNCTION_LIST /begin REF_CHARACTERISTIC /end REF_CHARACTERISTIC /begin REF_MEASUREMENT Rte_Sweep2_OutputMtrTrq_MtrNm_f32 /end REF_MEASUREMENT /end GROUP
/begin GROUP CtrldDisShtdn.SysC_CRFMtrTrqCmd.MtrNm_f32 "MICROSAR RTE" /begin SUB_GROUP /end SUB_GROUP /begin FUNCTION_LIST /end FUNCTION_LIST /begin REF_CHARACTERISTIC /end REF_CHARACTERISTIC /begin REF_MEASUREMENT Rte_CtrldDisShtdn_SysC_CRFMtrTrqCmd_MtrNm_f32 /end REF_MEASUREMENT /end GROUP
/begin GROUP CtrldDisShtdn.SysC_MRFMtrTrqCmd.MtrNm_f32 "MICROSAR RTE" /begin SUB_GROUP /end SUB_GROUP /begin FUNCTION_LIST /end FUNCTION_LIST /begin REF_CHARACTERISTIC /end REF_CHARACTERISTIC /begin REF_MEASUREMENT Rte_CtrldDisShtdn_SysC_MRFMtrTrqCmd_MtrNm_f32 /end REF_MEASUREMENT /end GROUP
/begin GROUP CtrldDisShtdn.SystemState.Mode "MICROSAR RTE" /begin SUB_GROUP /end SUB_GROUP /begin FUNCTION_LIST /end FUNCTION_LIST /begin REF_CHARACTERISTIC /end REF_CHARACTERISTIC /end GROUP
/begin GROUP CurrCmd "MICROSAR RTE" /begin SUB_GROUP CurrCmd.ReceiverPorts CurrCmd.SenderPorts /end SUB_GROUP /begin FUNCTION_LIST /end FUNCTION_LIST /begin REF_CHARACTERISTIC /end REF_CHARACTERISTIC /begin REF_MEASUREMENT /end REF_MEASUREMENT /end GROUP
/begin GROUP CurrCmd.CurrentGainSvc.Cnt_lgc "MICROSAR RTE" /begin SUB_GROUP /end SUB_GROUP /begin FUNCTION_LIST /end FUNCTION_LIST /begin REF_CHARACTERISTIC /end REF_CHARACTERISTIC /begin REF_MEASUREMENT Rte_CmMtrCurr_CurrentGainSvc_Cnt_lgc /end REF_MEASUREMENT /end GROUP
/begin GROUP CurrCmd.EstKe.VpRadpS_f32 "MICROSAR RTE" /begin SUB_GROUP /end SUB_GROUP /begin FUNCTION_LIST /end FUNCTION_LIST /begin REF_CHARACTERISTIC /end REF_CHARACTERISTIC /begin REF_MEASUREMENT Rte_CurrParamComp_EstKe_VpRadpS_f32 /end REF_MEASUREMENT /end GROUP
/begin GROUP CurrCmd.EstLd.Henry_f32 "MICROSAR RTE" /begin SUB_GROUP /end SUB_GROUP /begin FUNCTION_LIST /end FUNCTION_LIST /begin REF_CHARACTERISTIC /end REF_CHARACTERISTIC /begin REF_MEASUREMENT Rte_CurrParamComp_EstLd_Henry_f32 /end REF_MEASUREMENT /end GROUP
/begin GROUP CurrCmd.EstLq.Henry_f32 "MICROSAR RTE" /begin SUB_GROUP /end SUB_GROUP /begin FUNCTION_LIST /end FUNCTION_LIST /begin REF_CHARACTERISTIC /end REF_CHARACTERISTIC /begin REF_MEASUREMENT Rte_CurrParamComp_EstLq_Henry_f32 /end REF_MEASUREMENT /end GROUP
/begin GROUP CurrCmd.EstR.Ohm_f32 "MICROSAR RTE" /begin SUB_GROUP /end SUB_GROUP /begin FUNCTION_LIST /end FUNCTION_LIST /begin REF_CHARACTERISTIC /end REF_CHARACTERISTIC /begin REF_MEASUREMENT Rte_CurrParamComp_EstR_Ohm_f32 /end REF_MEASUREMENT /end GROUP
/begin GROUP CurrCmd.IvtrLoaMtgtnEn.Cnt_lgc "MICROSAR RTE" /begin SUB_GROUP /end SUB_GROUP /begin FUNCTION_LIST /end FUNCTION_LIST /begin REF_CHARACTERISTIC /end REF_CHARACTERISTIC /begin REF_MEASUREMENT Rte_CurrCmd_IvtrLoaMtgtnEn_Cnt_lgc /end REF_MEASUREMENT /end GROUP
/begin GROUP CurrCmd.MRFMtrVel.MtrRadpS_f32 "MICROSAR RTE" /begin SUB_GROUP /end SUB_GROUP /begin FUNCTION_LIST /end FUNCTION_LIST /begin REF_CHARACTERISTIC /end REF_CHARACTERISTIC /end GROUP
/begin GROUP CurrCmd.MRFTrqCmdScl.MtrNm_f32 "MICROSAR RTE" /begin SUB_GROUP /end SUB_GROUP /begin FUNCTION_LIST /end FUNCTION_LIST /begin REF_CHARACTERISTIC /end REF_CHARACTERISTIC /begin REF_MEASUREMENT Rte_TrqCmdScl_MRFMtrTrqCmdScl_MtrNm_f32 /end REF_MEASUREMENT /end GROUP
/begin GROUP CurrCmd.MotCurrLoaMtgtnEn.Cnt_lgc "MICROSAR RTE" /begin SUB_GROUP /end SUB_GROUP /begin FUNCTION_LIST /end FUNCTION_LIST /begin REF_CHARACTERISTIC /end REF_CHARACTERISTIC /begin REF_MEASUREMENT Rte_CurrCmd_MotCurrLoaMtgtnEn_Cnt_lgc /end REF_MEASUREMENT /end GROUP
/begin GROUP CurrCmd.MtrCurrAngle.Rev_f32 "MICROSAR RTE" /begin SUB_GROUP /end SUB_GROUP /begin FUNCTION_LIST /end FUNCTION_LIST /begin REF_CHARACTERISTIC /end REF_CHARACTERISTIC /begin REF_MEASUREMENT Rte_CurrCmd_MtrCurrAngle_Rev_f32 /end REF_MEASUREMENT /end GROUP
/begin GROUP CurrCmd.MtrCurrDaxRef.Amp_f32 "MICROSAR RTE" /begin SUB_GROUP /end SUB_GROUP /begin FUNCTION_LIST /end FUNCTION_LIST /begin REF_CHARACTERISTIC /end REF_CHARACTERISTIC /begin REF_MEASUREMENT Rte_CurrCmd_MtrCurrDaxRef_Amp_f32 /end REF_MEASUREMENT /end GROUP
/begin GROUP CurrCmd.MtrCurrQaxRef.Amp_f32 "MICROSAR RTE" /begin SUB_GROUP /end SUB_GROUP /begin FUNCTION_LIST /end FUNCTION_LIST /begin REF_CHARACTERISTIC /end REF_CHARACTERISTIC /begin REF_MEASUREMENT Rte_CurrCmd_MtrCurrQaxRef_Amp_f32 /end REF_MEASUREMENT /end GROUP
/begin GROUP CurrCmd.MtrQuad.Cnt_u08 "MICROSAR RTE" /begin SUB_GROUP /end SUB_GROUP /begin FUNCTION_LIST /end FUNCTION_LIST /begin REF_CHARACTERISTIC /end REF_CHARACTERISTIC /begin REF_MEASUREMENT Rte_QuadDet_MtrQuad_Cnt_u08 /end REF_MEASUREMENT /end GROUP
/begin GROUP CurrCmd.ReceiverPorts "MICROSAR RTE"
 /begin SUB_GROUP CurrCmd.CurrentGainSvc.Cnt_lgc CurrCmd.EstKe.VpRadpS_f32 CurrCmd.EstLd.Henry_f32 CurrCmd.EstLq.Henry_f32 CurrCmd.EstR.Ohm_f32 CurrCmd.IvtrLoaMtgtnEn.Cnt_lgc CurrCmd.MRFMtrVel.MtrRadpS_f32 CurrCmd.MRFTrqCmdScl.MtrNm_f32 CurrCmd.MotCurrLoaMtgtnEn.Cnt_lgc CurrCmd.MtrQuad.Cnt_u08 CurrCmd.Vecu.Volt_f32 CurrCmd.VehSpd.Kph_f32 /end SUB_GROUP
 /begin FUNCTION_LIST /end FUNCTION_LIST
 /begin REF_CHARACTERISTIC /end REF_CHARACTERISTIC
 /begin REF_MEASUREMENT /end REF_MEASUREMENT
/end GROUP
/begin GROUP CurrCmd.SenderPorts "MICROSAR RTE"
 /begin SUB_GROUP CurrCmd.MtrCurrAngle.Rev_f32 CurrCmd.MtrCurrDaxRef.Amp_f32 CurrCmd.MtrCurrQaxRef.Amp_f32 /end SUB_GROUP
 /begin FUNCTION_LIST /end FUNCTION_LIST
 /begin REF_CHARACTERISTIC /end REF_CHARACTERISTIC
 /begin REF_MEASUREMENT /end REF_MEASUREMENT
/end GROUP
/begin GROUP CurrCmd.Vecu.Volt_f32 "MICROSAR RTE" /begin SUB_GROUP /end SUB_GROUP /begin FUNCTION_LIST /end FUNCTION_LIST /begin REF_CHARACTERISTIC /end REF_CHARACTERISTIC /end GROUP
/begin GROUP CurrCmd.VehSpd.Kph_f32 "MICROSAR RTE" /begin SUB_GROUP /end SUB_GROUP /begin FUNCTION_LIST /end FUNCTION_LIST /begin REF_CHARACTERISTIC /end REF_CHARACTERISTIC /end GROUP
/begin GROUP CurrParamComp "MICROSAR RTE"
 /begin SUB_GROUP CurrParamComp.PerInstanceMemories CurrParamComp.ReceiverPorts CurrParamComp.SenderPorts /end SUB_GROUP
 /begin FUNCTION_LIST /end FUNCTION_LIST
 /begin REF_CHARACTERISTIC /end REF_CHARACTERISTIC
 /begin REF_MEASUREMENT /end REF_MEASUREMENT
/end GROUP
/begin GROUP CurrParamComp.CuTempEst.DegC_f32 "MICROSAR RTE" /begin SUB_GROUP /end SUB_GROUP /begin FUNCTION_LIST /end FUNCTION_LIST /begin REF_CHARACTERISTIC /end REF_CHARACTERISTIC /begin REF_MEASUREMENT Rte_MtrTempEst_CuTempEst_DegC_f32 /end REF_MEASUREMENT /end GROUP
/begin GROUP CurrParamComp.EOLNomMtrParam "MICROSAR RTE" /begin SUB_GROUP /end SUB_GROUP /begin FUNCTION_LIST /end FUNCTION_LIST /begin REF_CHARACTERISTIC /end REF_CHARACTERISTIC
 /begin REF_MEASUREMENT Rte_CurrParamComp_EOLNomMtrParam.NomKe_VpRadpS_f32 Rte_CurrParamComp_EOLNomMtrParam.NomRmtr_Ohm_f32 /end REF_MEASUREMENT
/end GROUP
/begin GROUP CurrParamComp.EstKe.VpRadpS_f32 "MICROSAR RTE" /begin SUB_GROUP /end SUB_GROUP /begin FUNCTION_LIST /end FUNCTION_LIST /begin REF_CHARACTERISTIC /end REF_CHARACTERISTIC /begin REF_MEASUREMENT Rte_CurrParamComp_EstKe_VpRadpS_f32 /end REF_MEASUREMENT /end GROUP
/begin GROUP CurrParamComp.EstLd.Henry_f32 "MICROSAR RTE" /begin SUB_GROUP /end SUB_GROUP /begin FUNCTION_LIST /end FUNCTION_LIST /begin REF_CHARACTERISTIC /end REF_CHARACTERISTIC /begin REF_MEASUREMENT Rte_CurrParamComp_EstLd_Henry_f32 /end REF_MEASUREMENT /end GROUP
/begin GROUP CurrParamComp.EstLq.Henry_f32 "MICROSAR RTE" /begin SUB_GROUP /end SUB_GROUP /begin FUNCTION_LIST /end FUNCTION_LIST /begin REF_CHARACTERISTIC /end REF_CHARACTERISTIC /begin REF_MEASUREMENT Rte_CurrParamComp_EstLq_Henry_f32 /end REF_MEASUREMENT /end GROUP
/begin GROUP CurrParamComp.EstR.Ohm_f32 "MICROSAR RTE" /begin SUB_GROUP /end SUB_GROUP /begin FUNCTION_LIST /end FUNCTION_LIST /begin REF_CHARACTERISTIC /end REF_CHARACTERISTIC /begin REF_MEASUREMENT Rte_CurrParamComp_EstR_Ohm_f32 /end REF_MEASUREMENT /end GROUP
/begin GROUP CurrParamComp.MagTempEst.DegC_f32 "MICROSAR RTE" /begin SUB_GROUP /end SUB_GROUP /begin FUNCTION_LIST /end FUNCTION_LIST /begin REF_CHARACTERISTIC /end REF_CHARACTERISTIC /begin REF_MEASUREMENT Rte_MtrTempEst_MagTempEst_DegC_f32 /end REF_MEASUREMENT /end GROUP
/begin GROUP CurrParamComp.MtrCurrDaxRef.Amp_f32 "MICROSAR RTE" /begin SUB_GROUP /end SUB_GROUP /begin FUNCTION_LIST /end FUNCTION_LIST /begin REF_CHARACTERISTIC /end REF_CHARACTERISTIC /begin REF_MEASUREMENT Rte_CurrCmd_MtrCurrDaxRef_Amp_f32 /end REF_MEASUREMENT /end GROUP
/begin GROUP CurrParamComp.MtrCurrQaxRef.Amp_f32 "MICROSAR RTE" /begin SUB_GROUP /end SUB_GROUP /begin FUNCTION_LIST /end FUNCTION_LIST /begin REF_CHARACTERISTIC /end REF_CHARACTERISTIC /begin REF_MEASUREMENT Rte_CurrCmd_MtrCurrQaxRef_Amp_f32 /end REF_MEASUREMENT /end GROUP
/begin GROUP CurrParamComp.PerInstanceMemories "MICROSAR RTE" /begin SUB_GROUP CurrParamComp.EOLNomMtrParam /end SUB_GROUP /begin FUNCTION_LIST /end FUNCTION_LIST /begin REF_CHARACTERISTIC /end REF_CHARACTERISTIC /begin REF_MEASUREMENT /end REF_MEASUREMENT /end GROUP
/begin GROUP CurrParamComp.ReceiverPorts "MICROSAR RTE"
 /begin SUB_GROUP CurrParamComp.CuTempEst.DegC_f32 CurrParamComp.MagTempEst.DegC_f32 CurrParamComp.MtrCurrDaxRef.Amp_f32 CurrParamComp.MtrCurrQaxRef.Amp_f32 CurrParamComp.SiTempEst.DegC_f32 /end SUB_GROUP
 /begin FUNCTION_LIST /end FUNCTION_LIST
 /begin REF_CHARACTERISTIC /end REF_CHARACTERISTIC
 /begin REF_MEASUREMENT /end REF_MEASUREMENT
/end GROUP
/begin GROUP CurrParamComp.SenderPorts "MICROSAR RTE"
 /begin SUB_GROUP CurrParamComp.EstKe.VpRadpS_f32 CurrParamComp.EstLd.Henry_f32 CurrParamComp.EstLq.Henry_f32 CurrParamComp.EstR.Ohm_f32 /end SUB_GROUP
 /begin FUNCTION_LIST /end FUNCTION_LIST
 /begin REF_CHARACTERISTIC /end REF_CHARACTERISTIC
 /begin REF_MEASUREMENT /end REF_MEASUREMENT
/end GROUP
/begin GROUP CurrParamComp.SiTempEst.DegC_f32 "MICROSAR RTE" /begin SUB_GROUP /end SUB_GROUP /begin FUNCTION_LIST /end FUNCTION_LIST /begin REF_CHARACTERISTIC /end REF_CHARACTERISTIC /begin REF_MEASUREMENT Rte_MtrTempEst_SiTempEst_DegC_f32 /end REF_MEASUREMENT /end GROUP
/begin GROUP Damping "MICROSAR RTE" /begin SUB_GROUP Damping.ReceiverPorts Damping.SenderPorts /end SUB_GROUP /begin FUNCTION_LIST /end FUNCTION_LIST /begin REF_CHARACTERISTIC /end REF_CHARACTERISTIC /begin REF_MEASUREMENT /end REF_MEASUREMENT /end GROUP
/begin GROUP Damping.AssistCmd.MtrNm_f32 "MICROSAR RTE" /begin SUB_GROUP /end SUB_GROUP /begin FUNCTION_LIST /end FUNCTION_LIST /begin REF_CHARACTERISTIC /end REF_CHARACTERISTIC /end GROUP
/begin GROUP Damping.AssistMechTempEst.DegC_f32 "MICROSAR RTE" /begin SUB_GROUP /end SUB_GROUP /begin FUNCTION_LIST /end FUNCTION_LIST /begin REF_CHARACTERISTIC /end REF_CHARACTERISTIC /end GROUP
/begin GROUP Damping.CustomDamp.MtrNm_f32 "MICROSAR RTE" /begin SUB_GROUP /end SUB_GROUP /begin FUNCTION_LIST /end FUNCTION_LIST /begin REF_CHARACTERISTIC /end REF_CHARACTERISTIC /begin REF_MEASUREMENT Rte_Damping_CustomDamp_MtrNm_f32 /end REF_MEASUREMENT /end GROUP
/begin GROUP Damping.DampingCmd.MtrNm_f32 "MICROSAR RTE" /begin SUB_GROUP /end SUB_GROUP /begin FUNCTION_LIST /end FUNCTION_LIST /begin REF_CHARACTERISTIC /end REF_CHARACTERISTIC /begin REF_MEASUREMENT Rte_Damping_DampingCmd_MtrNm_f32 /end REF_MEASUREMENT /end GROUP
/begin GROUP Damping.DampingDDFactor.Uls_f32 "MICROSAR RTE" /begin SUB_GROUP /end SUB_GROUP /begin FUNCTION_LIST /end FUNCTION_LIST /begin REF_CHARACTERISTIC /end REF_CHARACTERISTIC /begin REF_MEASUREMENT Rte_Damping_DampingDDFactor_Uls_f32 /end REF_MEASUREMENT /end GROUP
/begin GROUP Damping.DefeatDampingSvc.Cnt_lgc "MICROSAR RTE" /begin SUB_GROUP /end SUB_GROUP /begin FUNCTION_LIST /end FUNCTION_LIST /begin REF_CHARACTERISTIC /end REF_CHARACTERISTIC /end GROUP
/begin GROUP Damping.HwTorque.HwNm_f32 "MICROSAR RTE" /begin SUB_GROUP /end SUB_GROUP /begin FUNCTION_LIST /end FUNCTION_LIST /begin REF_CHARACTERISTIC /end REF_CHARACTERISTIC /end GROUP
/begin GROUP Damping.MotorVelCRF.MtrRadpS_f32 "MICROSAR RTE" /begin SUB_GROUP /end SUB_GROUP /begin FUNCTION_LIST /end FUNCTION_LIST /begin REF_CHARACTERISTIC /end REF_CHARACTERISTIC /begin REF_MEASUREMENT Rte_MtrVel_MotorVelCRF_MtrRadpS_f32 /end REF_MEASUREMENT /end GROUP
/begin GROUP Damping.ReceiverPorts "MICROSAR RTE"
 /begin SUB_GROUP Damping.AssistCmd.MtrNm_f32 Damping.AssistMechTempEst.DegC_f32 Damping.CustomDamp.MtrNm_f32 Damping.DampingDDFactor.Uls_f32 Damping.DefeatDampingSvc.Cnt_lgc Damping.HwTorque.HwNm_f32 Damping.MotorVelCRF.MtrRadpS_f32 Damping.VehicleSpeed.Kph_f32 /end SUB_GROUP
 /begin FUNCTION_LIST /end FUNCTION_LIST
 /begin REF_CHARACTERISTIC /end REF_CHARACTERISTIC
 /begin REF_MEASUREMENT /end REF_MEASUREMENT
/end GROUP
/begin GROUP Damping.SenderPorts "MICROSAR RTE" /begin SUB_GROUP Damping.DampingCmd.MtrNm_f32 /end SUB_GROUP /begin FUNCTION_LIST /end FUNCTION_LIST /begin REF_CHARACTERISTIC /end REF_CHARACTERISTIC /begin REF_MEASUREMENT /end REF_MEASUREMENT /end GROUP
/begin GROUP Damping.VehicleSpeed.Kph_f32 "MICROSAR RTE" /begin SUB_GROUP /end SUB_GROUP /begin FUNCTION_LIST /end FUNCTION_LIST /begin REF_CHARACTERISTIC /end REF_CHARACTERISTIC /end GROUP
/begin GROUP DampingFirewall "MICROSAR RTE"
 /begin SUB_GROUP DampingFirewall.ModeRequirePorts DampingFirewall.ReceiverPorts DampingFirewall.SenderPorts /end SUB_GROUP
 /begin FUNCTION_LIST /end FUNCTION_LIST
 /begin REF_CHARACTERISTIC /end REF_CHARACTERISTIC
 /begin REF_MEASUREMENT /end REF_MEASUREMENT
/end GROUP
/begin GROUP DampingFirewall.AsstFirewallActive.Uls_f32 "MICROSAR RTE" /begin SUB_GROUP /end SUB_GROUP /begin FUNCTION_LIST /end FUNCTION_LIST /begin REF_CHARACTERISTIC /end REF_CHARACTERISTIC /end GROUP
/begin GROUP DampingFirewall.BaseAssistCmd.MtrNm_f32 "MICROSAR RTE" /begin SUB_GROUP /end SUB_GROUP /begin FUNCTION_LIST /end FUNCTION_LIST /begin REF_CHARACTERISTIC /end REF_CHARACTERISTIC /end GROUP
/begin GROUP DampingFirewall.CombinedDamping.MtrNm_f32 "MICROSAR RTE" /begin SUB_GROUP /end SUB_GROUP /begin FUNCTION_LIST /end FUNCTION_LIST /begin REF_CHARACTERISTIC /end REF_CHARACTERISTIC /end GROUP
/begin GROUP DampingFirewall.DampingCmd.MtrNm_f32 "MICROSAR RTE" /begin SUB_GROUP /end SUB_GROUP /begin FUNCTION_LIST /end FUNCTION_LIST /begin REF_CHARACTERISTIC /end REF_CHARACTERISTIC /begin REF_MEASUREMENT Rte_Damping_DampingCmd_MtrNm_f32 /end REF_MEASUREMENT /end GROUP
/begin GROUP DampingFirewall.Defeat_Damping_Svc.Cnt_lgc "MICROSAR RTE" /begin SUB_GROUP /end SUB_GROUP /begin FUNCTION_LIST /end FUNCTION_LIST /begin REF_CHARACTERISTIC /end REF_CHARACTERISTIC /end GROUP
/begin GROUP DampingFirewall.FreqDepDmpSrlComSvcDft.Cnt_lgc "MICROSAR RTE" /begin SUB_GROUP /end SUB_GROUP /begin FUNCTION_LIST /end FUNCTION_LIST /begin REF_CHARACTERISTIC /end REF_CHARACTERISTIC /end GROUP
/begin GROUP DampingFirewall.HwTorque.HwNm_f32 "MICROSAR RTE" /begin SUB_GROUP /end SUB_GROUP /begin FUNCTION_LIST /end FUNCTION_LIST /begin REF_CHARACTERISTIC /end REF_CHARACTERISTIC /end GROUP
/begin GROUP DampingFirewall.InertiaComp.MtrNm_f32 "MICROSAR RTE" /begin SUB_GROUP /end SUB_GROUP /begin FUNCTION_LIST /end FUNCTION_LIST /begin REF_CHARACTERISTIC /end REF_CHARACTERISTIC /begin REF_MEASUREMENT Rte_FrqDepDmpnInrtCmp_FrqDepDmpnInrtCmp_MtrNm_f32 /end REF_MEASUREMENT /end GROUP
/begin GROUP DampingFirewall.MEC_Counter.Cnt_enum "MICROSAR RTE" /begin SUB_GROUP /end SUB_GROUP /begin FUNCTION_LIST /end FUNCTION_LIST /begin REF_CHARACTERISTIC /end REF_CHARACTERISTIC /end GROUP
/begin GROUP DampingFirewall.ModeRequirePorts "MICROSAR RTE" /begin SUB_GROUP DampingFirewall.SystemState.Mode /end SUB_GROUP /begin FUNCTION_LIST /end FUNCTION_LIST /begin REF_CHARACTERISTIC /end REF_CHARACTERISTIC /begin REF_MEASUREMENT /end REF_MEASUREMENT /end GROUP
/begin GROUP DampingFirewall.MtrVelCRF.MtrRadpS_f32 "MICROSAR RTE" /begin SUB_GROUP /end SUB_GROUP /begin FUNCTION_LIST /end FUNCTION_LIST /begin REF_CHARACTERISTIC /end REF_CHARACTERISTIC /begin REF_MEASUREMENT Rte_MtrVel_MotorVelCRF_MtrRadpS_f32 /end REF_MEASUREMENT /end GROUP
/begin GROUP DampingFirewall.ReceiverPorts "MICROSAR RTE"
 /begin SUB_GROUP DampingFirewall.AsstFirewallActive.Uls_f32 DampingFirewall.BaseAssistCmd.MtrNm_f32 DampingFirewall.DampingCmd.MtrNm_f32 DampingFirewall.Defeat_Damping_Svc.Cnt_lgc DampingFirewall.FreqDepDmpSrlComSvcDft.Cnt_lgc DampingFirewall.HwTorque.HwNm_f32 DampingFirewall.InertiaComp.MtrNm_f32 DampingFirewall.MEC_Counter.Cnt_enum DampingFirewall.MtrVelCRF.MtrRadpS_f32 DampingFirewall.VehicleLonAccel.KphpS_f32 DampingFirewall.VehicleSpeed.Kph_f32 DampingFirewall.WIRCmdAmpBlnd.MtrNm_f32 /end SUB_GROUP
 /begin FUNCTION_LIST /end FUNCTION_LIST
 /begin REF_CHARACTERISTIC /end REF_CHARACTERISTIC
 /begin REF_MEASUREMENT /end REF_MEASUREMENT
/end GROUP
/begin GROUP DampingFirewall.SenderPorts "MICROSAR RTE" /begin SUB_GROUP DampingFirewall.CombinedDamping.MtrNm_f32 /end SUB_GROUP /begin FUNCTION_LIST /end FUNCTION_LIST /begin REF_CHARACTERISTIC /end REF_CHARACTERISTIC /begin REF_MEASUREMENT /end REF_MEASUREMENT /end GROUP
/begin GROUP DampingFirewall.SystemState.Mode "MICROSAR RTE" /begin SUB_GROUP /end SUB_GROUP /begin FUNCTION_LIST /end FUNCTION_LIST /begin REF_CHARACTERISTIC /end REF_CHARACTERISTIC /end GROUP
/begin GROUP DampingFirewall.VehicleLonAccel.KphpS_f32 "MICROSAR RTE" /begin SUB_GROUP /end SUB_GROUP /begin FUNCTION_LIST /end FUNCTION_LIST /begin REF_CHARACTERISTIC /end REF_CHARACTERISTIC /begin REF_MEASUREMENT Rte_DampingFirewall_VehicleLonAccel_KphpS_f32 /end REF_MEASUREMENT /end GROUP
/begin GROUP DampingFirewall.VehicleSpeed.Kph_f32 "MICROSAR RTE" /begin SUB_GROUP /end SUB_GROUP /begin FUNCTION_LIST /end FUNCTION_LIST /begin REF_CHARACTERISTIC /end REF_CHARACTERISTIC /end GROUP
/begin GROUP DampingFirewall.WIRCmdAmpBlnd.MtrNm_f32 "MICROSAR RTE" /begin SUB_GROUP /end SUB_GROUP /begin FUNCTION_LIST /end FUNCTION_LIST /begin REF_CHARACTERISTIC /end REF_CHARACTERISTIC /begin REF_MEASUREMENT Rte_DampingFirewall_WIRCmdAmpBlnd_MtrNm_f32 /end REF_MEASUREMENT /end GROUP
/begin GROUP DiagMgr10 "MICROSAR RTE"
 /begin SUB_GROUP DiagMgr10.ModeRequirePorts DiagMgr10.ReceiverPorts DiagMgr10.SenderPorts /end SUB_GROUP
 /begin FUNCTION_LIST /end FUNCTION_LIST
 /begin REF_CHARACTERISTIC /end REF_CHARACTERISTIC
 /begin REF_MEASUREMENT /end REF_MEASUREMENT
/end GROUP
/begin GROUP DiagMgr10.DiagRampRate.XpmS_f32 "MICROSAR RTE" /begin SUB_GROUP /end SUB_GROUP /begin FUNCTION_LIST /end FUNCTION_LIST /begin REF_CHARACTERISTIC /end REF_CHARACTERISTIC /begin REF_MEASUREMENT Rte_DiagMgr10_DiagRampRate_XpmS_f32 /end REF_MEASUREMENT /end GROUP
/begin GROUP DiagMgr10.DiagRampValue.Uls_f32 "MICROSAR RTE" /begin SUB_GROUP /end SUB_GROUP /begin FUNCTION_LIST /end FUNCTION_LIST /begin REF_CHARACTERISTIC /end REF_CHARACTERISTIC /begin REF_MEASUREMENT Rte_DiagMgr10_DiagRampValue_Uls_f32 /end REF_MEASUREMENT /end GROUP
/begin GROUP DiagMgr10.DiagRmpToZeroActive.Cnt_lgc "MICROSAR RTE" /begin SUB_GROUP /end SUB_GROUP /begin FUNCTION_LIST /end FUNCTION_LIST /begin REF_CHARACTERISTIC /end REF_CHARACTERISTIC /begin REF_MEASUREMENT Rte_DiagMgr10_DiagRmpToZeroActive_Cnt_lgc /end REF_MEASUREMENT /end GROUP
/begin GROUP DiagMgr10.DiagStsCtrldDisRmpPres.Cnt_lgc "MICROSAR RTE" /begin SUB_GROUP /end SUB_GROUP /begin FUNCTION_LIST /end FUNCTION_LIST /begin REF_CHARACTERISTIC /end REF_CHARACTERISTIC /begin REF_MEASUREMENT Rte_DiagMgr10_DiagStsCtrldDisRmpPres_Cnt_lgc /end REF_MEASUREMENT /end GROUP
/begin GROUP DiagMgr10.DiagStsDefTemp.Cnt_lgc "MICROSAR RTE" /begin SUB_GROUP /end SUB_GROUP /begin FUNCTION_LIST /end FUNCTION_LIST /begin REF_CHARACTERISTIC /end REF_CHARACTERISTIC /begin REF_MEASUREMENT Rte_DiagMgr10_DiagStsDefTemp_Cnt_lgc /end REF_MEASUREMENT /end GROUP
/begin GROUP DiagMgr10.DiagStsDefVehSpd.Cnt_lgc "MICROSAR RTE" /begin SUB_GROUP /end SUB_GROUP /begin FUNCTION_LIST /end FUNCTION_LIST /begin REF_CHARACTERISTIC /end REF_CHARACTERISTIC /begin REF_MEASUREMENT Rte_DiagMgr10_DiagStsDefVehSpd_Cnt_lgc /end REF_MEASUREMENT /end GROUP
/begin GROUP DiagMgr10.DiagStsHWASbSystmFltPres.Cnt_lgc "MICROSAR RTE" /begin SUB_GROUP /end SUB_GROUP /begin FUNCTION_LIST /end FUNCTION_LIST /begin REF_CHARACTERISTIC /end REF_CHARACTERISTIC /end GROUP
/begin GROUP DiagMgr10.DiagStsNonRecRmpToZeroFltPres.Cnt_lgc "MICROSAR RTE" /begin SUB_GROUP /end SUB_GROUP /begin FUNCTION_LIST /end FUNCTION_LIST /begin REF_CHARACTERISTIC /end REF_CHARACTERISTIC /begin REF_MEASUREMENT Rte_DiagMgr10_DiagStsNonRecRmpToZeroFltPres_Cnt_lgc /end REF_MEASUREMENT /end GROUP
/begin GROUP DiagMgr10.DiagStsRecRmpToZeroFltPres.Cnt_lgc "MICROSAR RTE" /begin SUB_GROUP /end SUB_GROUP /begin FUNCTION_LIST /end FUNCTION_LIST /begin REF_CHARACTERISTIC /end REF_CHARACTERISTIC /begin REF_MEASUREMENT Rte_DiagMgr10_DiagStsRecRmpToZeroFltPres_Cnt_lgc /end REF_MEASUREMENT /end GROUP
/begin GROUP DiagMgr10.DiagStsScomHWANotValid.Cnt_lgc "MICROSAR RTE" /begin SUB_GROUP /end SUB_GROUP /begin FUNCTION_LIST /end FUNCTION_LIST /begin REF_CHARACTERISTIC /end REF_CHARACTERISTIC /begin REF_MEASUREMENT Rte_DiagMgr10_DiagStsScomHWANotValid_Cnt_lgc /end REF_MEASUREMENT /end GROUP
/begin GROUP DiagMgr10.DiagStsWIRDisable.Cnt_lgc "MICROSAR RTE" /begin SUB_GROUP /end SUB_GROUP /begin FUNCTION_LIST /end FUNCTION_LIST /begin REF_CHARACTERISTIC /end REF_CHARACTERISTIC /begin REF_MEASUREMENT Rte_DiagMgr10_DiagStsWIRDisable_Cnt_lgc /end REF_MEASUREMENT /end GROUP
/begin GROUP DiagMgr10.HwTrq.HwNm_f32 "MICROSAR RTE" /begin SUB_GROUP /end SUB_GROUP /begin FUNCTION_LIST /end FUNCTION_LIST /begin REF_CHARACTERISTIC /end REF_CHARACTERISTIC /end GROUP
/begin GROUP DiagMgr10.IgnCnt.Cnt_u16 "MICROSAR RTE" /begin SUB_GROUP /end SUB_GROUP /begin FUNCTION_LIST /end FUNCTION_LIST /begin REF_CHARACTERISTIC /end REF_CHARACTERISTIC /end GROUP
/begin GROUP DiagMgr10.MEC.Cnt_enum "MICROSAR RTE" /begin SUB_GROUP /end SUB_GROUP /begin FUNCTION_LIST /end FUNCTION_LIST /begin REF_CHARACTERISTIC /end REF_CHARACTERISTIC /end GROUP
/begin GROUP DiagMgr10.MfgDiagInhibit.Cnt_lgc "MICROSAR RTE" /begin SUB_GROUP /end SUB_GROUP /begin FUNCTION_LIST /end FUNCTION_LIST /begin REF_CHARACTERISTIC /end REF_CHARACTERISTIC /end GROUP
/begin GROUP DiagMgr10.ModeRequirePorts "MICROSAR RTE" /begin SUB_GROUP DiagMgr10.SystemState.Mode /end SUB_GROUP /begin FUNCTION_LIST /end FUNCTION_LIST /begin REF_CHARACTERISTIC /end REF_CHARACTERISTIC /begin REF_MEASUREMENT /end REF_MEASUREMENT /end GROUP
/begin GROUP DiagMgr10.MtrTrq.MtrNm_f32 "MICROSAR RTE" /begin SUB_GROUP /end SUB_GROUP /begin FUNCTION_LIST /end FUNCTION_LIST /begin REF_CHARACTERISTIC /end REF_CHARACTERISTIC /begin REF_MEASUREMENT Rte_CtrldDisShtdn_CntDisMtrTrqCmdMRF_MtrNm_f32 /end REF_MEASUREMENT /end GROUP
/begin GROUP DiagMgr10.ReceiverPorts "MICROSAR RTE"
 /begin SUB_GROUP DiagMgr10.HwTrq.HwNm_f32 DiagMgr10.IgnCnt.Cnt_u16 DiagMgr10.MEC.Cnt_enum DiagMgr10.MfgDiagInhibit.Cnt_lgc DiagMgr10.MtrTrq.MtrNm_f32 DiagMgr10.VehSpd.Kph_f32 /end SUB_GROUP
 /begin FUNCTION_LIST /end FUNCTION_LIST
 /begin REF_CHARACTERISTIC /end REF_CHARACTERISTIC
 /begin REF_MEASUREMENT /end REF_MEASUREMENT
/end GROUP
/begin GROUP DiagMgr10.SenderPorts "MICROSAR RTE"
 /begin SUB_GROUP DiagMgr10.DiagRampRate.XpmS_f32 DiagMgr10.DiagRampValue.Uls_f32 DiagMgr10.DiagRmpToZeroActive.Cnt_lgc DiagMgr10.DiagStsCtrldDisRmpPres.Cnt_lgc DiagMgr10.DiagStsDefTemp.Cnt_lgc DiagMgr10.DiagStsDefVehSpd.Cnt_lgc DiagMgr10.DiagStsHWASbSystmFltPres.Cnt_lgc DiagMgr10.DiagStsNonRecRmpToZeroFltPres.Cnt_lgc DiagMgr10.DiagStsRecRmpToZeroFltPres.Cnt_lgc DiagMgr10.DiagStsScomHWANotValid.Cnt_lgc DiagMgr10.DiagStsWIRDisable.Cnt_lgc /end SUB_GROUP
 /begin FUNCTION_LIST /end FUNCTION_LIST
 /begin REF_CHARACTERISTIC /end REF_CHARACTERISTIC
 /begin REF_MEASUREMENT /end REF_MEASUREMENT
/end GROUP
/begin GROUP DiagMgr10.SystemState.Mode "MICROSAR RTE" /begin SUB_GROUP /end SUB_GROUP /begin FUNCTION_LIST /end FUNCTION_LIST /begin REF_CHARACTERISTIC /end REF_CHARACTERISTIC /end GROUP
/begin GROUP DiagMgr10.VehSpd.Kph_f32 "MICROSAR RTE" /begin SUB_GROUP /end SUB_GROUP /begin FUNCTION_LIST /end FUNCTION_LIST /begin REF_CHARACTERISTIC /end REF_CHARACTERISTIC /end GROUP
/begin GROUP DiagMgr8 "MICROSAR RTE" /begin SUB_GROUP DiagMgr8.ModeRequirePorts DiagMgr8.ReceiverPorts /end SUB_GROUP /begin FUNCTION_LIST /end FUNCTION_LIST /begin REF_CHARACTERISTIC /end REF_CHARACTERISTIC /begin REF_MEASUREMENT /end REF_MEASUREMENT /end GROUP
/begin GROUP DiagMgr8.HwTrq.HwNm_f32 "MICROSAR RTE" /begin SUB_GROUP /end SUB_GROUP /begin FUNCTION_LIST /end FUNCTION_LIST /begin REF_CHARACTERISTIC /end REF_CHARACTERISTIC /end GROUP
/begin GROUP DiagMgr8.IgnCnt.Cnt_u16 "MICROSAR RTE" /begin SUB_GROUP /end SUB_GROUP /begin FUNCTION_LIST /end FUNCTION_LIST /begin REF_CHARACTERISTIC /end REF_CHARACTERISTIC /end GROUP
/begin GROUP DiagMgr8.MEC.Cnt_enum "MICROSAR RTE" /begin SUB_GROUP /end SUB_GROUP /begin FUNCTION_LIST /end FUNCTION_LIST /begin REF_CHARACTERISTIC /end REF_CHARACTERISTIC /end GROUP
/begin GROUP DiagMgr8.MfgDiagInhibit.Cnt_lgc "MICROSAR RTE" /begin SUB_GROUP /end SUB_GROUP /begin FUNCTION_LIST /end FUNCTION_LIST /begin REF_CHARACTERISTIC /end REF_CHARACTERISTIC /end GROUP
/begin GROUP DiagMgr8.ModeRequirePorts "MICROSAR RTE" /begin SUB_GROUP DiagMgr8.SystemState.Mode /end SUB_GROUP /begin FUNCTION_LIST /end FUNCTION_LIST /begin REF_CHARACTERISTIC /end REF_CHARACTERISTIC /begin REF_MEASUREMENT /end REF_MEASUREMENT /end GROUP
/begin GROUP DiagMgr8.MtrTrq.MtrNm_f32 "MICROSAR RTE" /begin SUB_GROUP /end SUB_GROUP /begin FUNCTION_LIST /end FUNCTION_LIST /begin REF_CHARACTERISTIC /end REF_CHARACTERISTIC /begin REF_MEASUREMENT Rte_CtrldDisShtdn_CntDisMtrTrqCmdMRF_MtrNm_f32 /end REF_MEASUREMENT /end GROUP
/begin GROUP DiagMgr8.ReceiverPorts "MICROSAR RTE"
 /begin SUB_GROUP DiagMgr8.HwTrq.HwNm_f32 DiagMgr8.IgnCnt.Cnt_u16 DiagMgr8.MEC.Cnt_enum DiagMgr8.MfgDiagInhibit.Cnt_lgc DiagMgr8.MtrTrq.MtrNm_f32 DiagMgr8.VehSpd.Kph_f32 /end SUB_GROUP
 /begin FUNCTION_LIST /end FUNCTION_LIST
 /begin REF_CHARACTERISTIC /end REF_CHARACTERISTIC
 /begin REF_MEASUREMENT /end REF_MEASUREMENT
/end GROUP
/begin GROUP DiagMgr8.SystemState.Mode "MICROSAR RTE" /begin SUB_GROUP /end SUB_GROUP /begin FUNCTION_LIST /end FUNCTION_LIST /begin REF_CHARACTERISTIC /end REF_CHARACTERISTIC /begin REF_MEASUREMENT Rte_ModeMachine_StaMd8_SystemState8_Mode /end REF_MEASUREMENT /end GROUP
/begin GROUP DiagMgr8.VehSpd.Kph_f32 "MICROSAR RTE" /begin SUB_GROUP /end SUB_GROUP /begin FUNCTION_LIST /end FUNCTION_LIST /begin REF_CHARACTERISTIC /end REF_CHARACTERISTIC /end GROUP
/begin GROUP DiagMgr9 "MICROSAR RTE" /begin SUB_GROUP DiagMgr9.ModeRequirePorts DiagMgr9.ReceiverPorts /end SUB_GROUP /begin FUNCTION_LIST /end FUNCTION_LIST /begin REF_CHARACTERISTIC /end REF_CHARACTERISTIC /begin REF_MEASUREMENT /end REF_MEASUREMENT /end GROUP
/begin GROUP DiagMgr9.HwTrq.HwNm_f32 "MICROSAR RTE" /begin SUB_GROUP /end SUB_GROUP /begin FUNCTION_LIST /end FUNCTION_LIST /begin REF_CHARACTERISTIC /end REF_CHARACTERISTIC /end GROUP
/begin GROUP DiagMgr9.IgnCnt.Cnt_u16 "MICROSAR RTE" /begin SUB_GROUP /end SUB_GROUP /begin FUNCTION_LIST /end FUNCTION_LIST /begin REF_CHARACTERISTIC /end REF_CHARACTERISTIC /end GROUP
/begin GROUP DiagMgr9.MEC.Cnt_enum "MICROSAR RTE" /begin SUB_GROUP /end SUB_GROUP /begin FUNCTION_LIST /end FUNCTION_LIST /begin REF_CHARACTERISTIC /end REF_CHARACTERISTIC /end GROUP
/begin GROUP DiagMgr9.MfgDiagInhibit.Cnt_lgc "MICROSAR RTE" /begin SUB_GROUP /end SUB_GROUP /begin FUNCTION_LIST /end FUNCTION_LIST /begin REF_CHARACTERISTIC /end REF_CHARACTERISTIC /end GROUP
/begin GROUP DiagMgr9.ModeRequirePorts "MICROSAR RTE" /begin SUB_GROUP DiagMgr9.SystemState.Mode /end SUB_GROUP /begin FUNCTION_LIST /end FUNCTION_LIST /begin REF_CHARACTERISTIC /end REF_CHARACTERISTIC /begin REF_MEASUREMENT /end REF_MEASUREMENT /end GROUP
/begin GROUP DiagMgr9.MtrTrq.MtrNm_f32 "MICROSAR RTE" /begin SUB_GROUP /end SUB_GROUP /begin FUNCTION_LIST /end FUNCTION_LIST /begin REF_CHARACTERISTIC /end REF_CHARACTERISTIC /begin REF_MEASUREMENT Rte_CtrldDisShtdn_CntDisMtrTrqCmdMRF_MtrNm_f32 /end REF_MEASUREMENT /end GROUP
/begin GROUP DiagMgr9.ReceiverPorts "MICROSAR RTE"
 /begin SUB_GROUP DiagMgr9.HwTrq.HwNm_f32 DiagMgr9.IgnCnt.Cnt_u16 DiagMgr9.MEC.Cnt_enum DiagMgr9.MfgDiagInhibit.Cnt_lgc DiagMgr9.MtrTrq.MtrNm_f32 DiagMgr9.VehSpd.Kph_f32 /end SUB_GROUP
 /begin FUNCTION_LIST /end FUNCTION_LIST
 /begin REF_CHARACTERISTIC /end REF_CHARACTERISTIC
 /begin REF_MEASUREMENT /end REF_MEASUREMENT
/end GROUP
/begin GROUP DiagMgr9.SystemState.Mode "MICROSAR RTE" /begin SUB_GROUP /end SUB_GROUP /begin FUNCTION_LIST /end FUNCTION_LIST /begin REF_CHARACTERISTIC /end REF_CHARACTERISTIC /end GROUP
/begin GROUP DiagMgr9.VehSpd.Kph_f32 "MICROSAR RTE" /begin SUB_GROUP /end SUB_GROUP /begin FUNCTION_LIST /end FUNCTION_LIST /begin REF_CHARACTERISTIC /end REF_CHARACTERISTIC /end GROUP
/begin GROUP DiagSvc "MICROSAR RTE"
 /begin SUB_GROUP DiagSvc.ModeRequirePorts DiagSvc.PerInstanceMemories DiagSvc.ReceiverPorts DiagSvc.SenderPorts /end SUB_GROUP
 /begin FUNCTION_LIST /end FUNCTION_LIST
 /begin REF_CHARACTERISTIC /end REF_CHARACTERISTIC
 /begin REF_MEASUREMENT /end REF_MEASUREMENT
/end GROUP
/begin GROUP DiagSvc.AppSwFingerPrintData "MICROSAR RTE" /begin SUB_GROUP /end SUB_GROUP /begin FUNCTION_LIST /end FUNCTION_LIST /begin REF_CHARACTERISTIC /end REF_CHARACTERISTIC /begin REF_MEASUREMENT Rte_DiagSvc_AppSwFingerPrintData /end REF_MEASUREMENT /end GROUP
/begin GROUP DiagSvc.BootSwFingerPrintData "MICROSAR RTE" /begin SUB_GROUP /end SUB_GROUP /begin FUNCTION_LIST /end FUNCTION_LIST /begin REF_CHARACTERISTIC /end REF_CHARACTERISTIC /begin REF_MEASUREMENT Rte_DiagSvc_BootSwFingerPrintData /end REF_MEASUREMENT /end GROUP
/begin GROUP DiagSvc.CalSwFingerPrintData "MICROSAR RTE" /begin SUB_GROUP /end SUB_GROUP /begin FUNCTION_LIST /end FUNCTION_LIST /begin REF_CHARACTERISTIC /end REF_CHARACTERISTIC /begin REF_MEASUREMENT Rte_DiagSvc_CalSwFingerPrintData /end REF_MEASUREMENT /end GROUP
/begin GROUP DiagSvc.DesiredTunSet.Cnt_u16 "MICROSAR RTE" /begin SUB_GROUP /end SUB_GROUP /begin FUNCTION_LIST /end FUNCTION_LIST /begin REF_CHARACTERISTIC /end REF_CHARACTERISTIC /end GROUP
/begin GROUP DiagSvc.ECULifeTimeMinsData "MICROSAR RTE" /begin SUB_GROUP /end SUB_GROUP /begin FUNCTION_LIST /end FUNCTION_LIST /begin REF_CHARACTERISTIC /end REF_CHARACTERISTIC /begin REF_MEASUREMENT Rte_DiagSvc_ECULifeTimeMinsData /end REF_MEASUREMENT /end GROUP
/begin GROUP DiagSvc.ECUSerialNumberData "MICROSAR RTE" /begin SUB_GROUP /end SUB_GROUP /begin FUNCTION_LIST /end FUNCTION_LIST /begin REF_CHARACTERISTIC /end REF_CHARACTERISTIC /begin REF_MEASUREMENT Rte_DiagSvc_ECUSerialNumberData /end REF_MEASUREMENT /end GROUP
/begin GROUP DiagSvc.ECUSparePartNoData "MICROSAR RTE" /begin SUB_GROUP /end SUB_GROUP /begin FUNCTION_LIST /end FUNCTION_LIST /begin REF_CHARACTERISTIC /end REF_CHARACTERISTIC /begin REF_MEASUREMENT Rte_DiagSvc_ECUSparePartNoData /end REF_MEASUREMENT /end GROUP
/begin GROUP DiagSvc.EOLConfigurationData "MICROSAR RTE" /begin SUB_GROUP /end SUB_GROUP /begin FUNCTION_LIST /end FUNCTION_LIST /begin REF_CHARACTERISTIC /end REF_CHARACTERISTIC /begin REF_MEASUREMENT Rte_DiagSvc_EOLConfigurationData /end REF_MEASUREMENT /end GROUP
/begin GROUP DiagSvc.EraseRoutineStatusData "MICROSAR RTE" /begin SUB_GROUP /end SUB_GROUP /begin FUNCTION_LIST /end FUNCTION_LIST /begin REF_CHARACTERISTIC /end REF_CHARACTERISTIC /begin REF_MEASUREMENT Rte_DiagSvc_EraseRoutineStatusData /end REF_MEASUREMENT /end GROUP
/begin GROUP DiagSvc.FirstDTCDetectMinsData "MICROSAR RTE" /begin SUB_GROUP /end SUB_GROUP /begin FUNCTION_LIST /end FUNCTION_LIST /begin REF_CHARACTERISTIC /end REF_CHARACTERISTIC /begin REF_MEASUREMENT Rte_DiagSvc_FirstDTCDetectMinsData /end REF_MEASUREMENT /end GROUP
/begin GROUP DiagSvc.FirstDTCDetectSecsData "MICROSAR RTE" /begin SUB_GROUP /end SUB_GROUP /begin FUNCTION_LIST /end FUNCTION_LIST /begin REF_CHARACTERISTIC /end REF_CHARACTERISTIC /begin REF_MEASUREMENT Rte_DiagSvc_FirstDTCDetectSecsData /end REF_MEASUREMENT /end GROUP
/begin GROUP DiagSvc.HwPos.HwDeg_f32 "MICROSAR RTE" /begin SUB_GROUP /end SUB_GROUP /begin FUNCTION_LIST /end FUNCTION_LIST /begin REF_CHARACTERISTIC /end REF_CHARACTERISTIC /end GROUP
/begin GROUP DiagSvc.HwTrq.HwNm_f32 "MICROSAR RTE" /begin SUB_GROUP /end SUB_GROUP /begin FUNCTION_LIST /end FUNCTION_LIST /begin REF_CHARACTERISTIC /end REF_CHARACTERISTIC /end GROUP
/begin GROUP DiagSvc.IgnitionPreStart.Cnt_lgc "MICROSAR RTE" /begin SUB_GROUP /end SUB_GROUP /begin FUNCTION_LIST /end FUNCTION_LIST /begin REF_CHARACTERISTIC /end REF_CHARACTERISTIC /begin REF_MEASUREMENT Rte_DiagSvc_IgnitionPreStart_Cnt_lgc /end REF_MEASUREMENT /end GROUP
/begin GROUP DiagSvc.MEC.Cnt_enum "MICROSAR RTE" /begin SUB_GROUP /end SUB_GROUP /begin FUNCTION_LIST /end FUNCTION_LIST /begin REF_CHARACTERISTIC /end REF_CHARACTERISTIC /end GROUP
/begin GROUP DiagSvc.ModeRequirePorts "MICROSAR RTE" /begin SUB_GROUP DiagSvc.SystemState.Mode /end SUB_GROUP /begin FUNCTION_LIST /end FUNCTION_LIST /begin REF_CHARACTERISTIC /end REF_CHARACTERISTIC /begin REF_MEASUREMENT /end REF_MEASUREMENT /end GROUP
/begin GROUP DiagSvc.OdometerFlashProgData "MICROSAR RTE" /begin SUB_GROUP /end SUB_GROUP /begin FUNCTION_LIST /end FUNCTION_LIST /begin REF_CHARACTERISTIC /end REF_CHARACTERISTIC /begin REF_MEASUREMENT Rte_DiagSvc_OdometerFlashProgData /end REF_MEASUREMENT /end GROUP
/begin GROUP DiagSvc.PerInstanceMemories "MICROSAR RTE"
 /begin SUB_GROUP DiagSvc.AppSwFingerPrintData DiagSvc.BootSwFingerPrintData DiagSvc.CalSwFingerPrintData DiagSvc.ECULifeTimeMinsData DiagSvc.ECUSerialNumberData DiagSvc.ECUSparePartNoData DiagSvc.EOLConfigurationData DiagSvc.EraseRoutineStatusData DiagSvc.FirstDTCDetectMinsData DiagSvc.FirstDTCDetectSecsData DiagSvc.OdometerFlashProgData DiagSvc.ProgrammingAttemptCounterData DiagSvc.ProgrammingStatusData DiagSvc.ProxiConfigurationData DiagSvc.ProxiCounterData DiagSvc.TotalOdometerData DiagSvc.TuningSetSelectData DiagSvc.VINCurrentData DiagSvc.VINOriginalData /end SUB_GROUP
 /begin FUNCTION_LIST /end FUNCTION_LIST
 /begin REF_CHARACTERISTIC /end REF_CHARACTERISTIC
 /begin REF_MEASUREMENT /end REF_MEASUREMENT
/end GROUP
/begin GROUP DiagSvc.ProgrammingAttemptCounterData "MICROSAR RTE" /begin SUB_GROUP /end SUB_GROUP /begin FUNCTION_LIST /end FUNCTION_LIST /begin REF_CHARACTERISTIC /end REF_CHARACTERISTIC /begin REF_MEASUREMENT Rte_DiagSvc_ProgrammingAttemptCounterData /end REF_MEASUREMENT /end GROUP
/begin GROUP DiagSvc.ProgrammingStatusData "MICROSAR RTE" /begin SUB_GROUP /end SUB_GROUP /begin FUNCTION_LIST /end FUNCTION_LIST /begin REF_CHARACTERISTIC /end REF_CHARACTERISTIC /begin REF_MEASUREMENT Rte_DiagSvc_ProgrammingStatusData /end REF_MEASUREMENT /end GROUP
/begin GROUP DiagSvc.ProxiConfigurationData "MICROSAR RTE" /begin SUB_GROUP /end SUB_GROUP /begin FUNCTION_LIST /end FUNCTION_LIST /begin REF_CHARACTERISTIC /end REF_CHARACTERISTIC /begin REF_MEASUREMENT Rte_DiagSvc_ProxiConfigurationData /end REF_MEASUREMENT /end GROUP
/begin GROUP DiagSvc.ProxiCounterData "MICROSAR RTE" /begin SUB_GROUP /end SUB_GROUP /begin FUNCTION_LIST /end FUNCTION_LIST /begin REF_CHARACTERISTIC /end REF_CHARACTERISTIC /begin REF_MEASUREMENT Rte_DiagSvc_ProxiCounterData /end REF_MEASUREMENT /end GROUP
/begin GROUP DiagSvc.ReceiverPorts "MICROSAR RTE"
 /begin SUB_GROUP DiagSvc.HwPos.HwDeg_f32 DiagSvc.HwTrq.HwNm_f32 DiagSvc.MEC.Cnt_enum DiagSvc.Temperature_DegC_f32.DegC_f32 DiagSvc.Vecu_Volt_f32.Volt_f32 DiagSvc.VehSpd.Kph_f32 /end SUB_GROUP
 /begin FUNCTION_LIST /end FUNCTION_LIST
 /begin REF_CHARACTERISTIC /end REF_CHARACTERISTIC
 /begin REF_MEASUREMENT /end REF_MEASUREMENT
/end GROUP
/begin GROUP DiagSvc.SenderPorts "MICROSAR RTE"
 /begin SUB_GROUP DiagSvc.DesiredTunSet.Cnt_u16 DiagSvc.IgnitionPreStart.Cnt_lgc /end SUB_GROUP
 /begin FUNCTION_LIST /end FUNCTION_LIST
 /begin REF_CHARACTERISTIC /end REF_CHARACTERISTIC
 /begin REF_MEASUREMENT /end REF_MEASUREMENT
/end GROUP
/begin GROUP DiagSvc.SystemState.Mode "MICROSAR RTE" /begin SUB_GROUP /end SUB_GROUP /begin FUNCTION_LIST /end FUNCTION_LIST /begin REF_CHARACTERISTIC /end REF_CHARACTERISTIC /end GROUP
/begin GROUP DiagSvc.Temperature_DegC_f32.DegC_f32 "MICROSAR RTE" /begin SUB_GROUP /end SUB_GROUP /begin FUNCTION_LIST /end FUNCTION_LIST /begin REF_CHARACTERISTIC /end REF_CHARACTERISTIC /begin REF_MEASUREMENT Rte_CtrlTemp_FiltMeasTemp_DegC_f32 /end REF_MEASUREMENT /end GROUP
/begin GROUP DiagSvc.TotalOdometerData "MICROSAR RTE" /begin SUB_GROUP /end SUB_GROUP /begin FUNCTION_LIST /end FUNCTION_LIST /begin REF_CHARACTERISTIC /end REF_CHARACTERISTIC /begin REF_MEASUREMENT Rte_DiagSvc_TotalOdometerData /end REF_MEASUREMENT /end GROUP
/begin GROUP DiagSvc.TuningSetSelectData "MICROSAR RTE" /begin SUB_GROUP /end SUB_GROUP /begin FUNCTION_LIST /end FUNCTION_LIST /begin REF_CHARACTERISTIC /end REF_CHARACTERISTIC /begin REF_MEASUREMENT Rte_DiagSvc_TuningSetSelectData /end REF_MEASUREMENT /end GROUP
/begin GROUP DiagSvc.VINCurrentData "MICROSAR RTE" /begin SUB_GROUP /end SUB_GROUP /begin FUNCTION_LIST /end FUNCTION_LIST /begin REF_CHARACTERISTIC /end REF_CHARACTERISTIC /begin REF_MEASUREMENT Rte_DiagSvc_VINCurrentData /end REF_MEASUREMENT /end GROUP
/begin GROUP DiagSvc.VINOriginalData "MICROSAR RTE" /begin SUB_GROUP /end SUB_GROUP /begin FUNCTION_LIST /end FUNCTION_LIST /begin REF_CHARACTERISTIC /end REF_CHARACTERISTIC /begin REF_MEASUREMENT Rte_DiagSvc_VINOriginalData /end REF_MEASUREMENT /end GROUP
/begin GROUP DiagSvc.Vecu_Volt_f32.Volt_f32 "MICROSAR RTE" /begin SUB_GROUP /end SUB_GROUP /begin FUNCTION_LIST /end FUNCTION_LIST /begin REF_CHARACTERISTIC /end REF_CHARACTERISTIC /end GROUP
/begin GROUP DiagSvc.VehSpd.Kph_f32 "MICROSAR RTE" /begin SUB_GROUP /end SUB_GROUP /begin FUNCTION_LIST /end FUNCTION_LIST /begin REF_CHARACTERISTIC /end REF_CHARACTERISTIC /end GROUP
/begin GROUP DigHwTrqSENT "MICROSAR RTE"
 /begin SUB_GROUP DigHwTrqSENT.PerInstanceMemories DigHwTrqSENT.ReceiverPorts DigHwTrqSENT.SenderPorts /end SUB_GROUP
 /begin FUNCTION_LIST /end FUNCTION_LIST
 /begin REF_CHARACTERISTIC /end REF_CHARACTERISTIC
 /begin REF_MEASUREMENT /end REF_MEASUREMENT
/end GROUP
/begin GROUP DigHwTrqSENT.DigTrqTrim "MICROSAR RTE" /begin SUB_GROUP /end SUB_GROUP /begin FUNCTION_LIST /end FUNCTION_LIST /begin REF_CHARACTERISTIC /end REF_CHARACTERISTIC
 /begin REF_MEASUREMENT Rte_DigHwTrqSENT_DigTrqTrim.k_EOLHwTrqTrimPerformed_Cnt_Lgc Rte_DigHwTrqSENT_DigTrqTrim.k_EOLHwTrqTrim_HwNm_f32 /end REF_MEASUREMENT
/end GROUP
/begin GROUP DigHwTrqSENT.HwTorque.HwNm_f32 "MICROSAR RTE" /begin SUB_GROUP /end SUB_GROUP /begin FUNCTION_LIST /end FUNCTION_LIST /begin REF_CHARACTERISTIC /end REF_CHARACTERISTIC /begin REF_MEASUREMENT Rte_DigHwTrqSENT_HwTorque_HwNm_f32 /end REF_MEASUREMENT /end GROUP
/begin GROUP DigHwTrqSENT.MECCounter.Cnt_enum "MICROSAR RTE" /begin SUB_GROUP /end SUB_GROUP /begin FUNCTION_LIST /end FUNCTION_LIST /begin REF_CHARACTERISTIC /end REF_CHARACTERISTIC /end GROUP
/begin GROUP DigHwTrqSENT.PerInstanceMemories "MICROSAR RTE" /begin SUB_GROUP DigHwTrqSENT.DigTrqTrim /end SUB_GROUP /begin FUNCTION_LIST /end FUNCTION_LIST /begin REF_CHARACTERISTIC /end REF_CHARACTERISTIC /begin REF_MEASUREMENT /end REF_MEASUREMENT /end GROUP
/begin GROUP DigHwTrqSENT.ReceiverPorts "MICROSAR RTE"
 /begin SUB_GROUP DigHwTrqSENT.MECCounter.Cnt_enum DigHwTrqSENT.T1.HwNm_f32 DigHwTrqSENT.T2.HwNm_f32 /end SUB_GROUP
 /begin FUNCTION_LIST /end FUNCTION_LIST
 /begin REF_CHARACTERISTIC /end REF_CHARACTERISTIC
 /begin REF_MEASUREMENT /end REF_MEASUREMENT
/end GROUP
/begin GROUP DigHwTrqSENT.SenderPorts "MICROSAR RTE"
 /begin SUB_GROUP DigHwTrqSENT.HwTorque.HwNm_f32 DigHwTrqSENT.SrlComHwTrq.HwNm_f32 DigHwTrqSENT.SrlComHwTrqValid.Cnt_lgc DigHwTrqSENT.SysCHwTorque.HwNm_f32 /end SUB_GROUP
 /begin FUNCTION_LIST /end FUNCTION_LIST
 /begin REF_CHARACTERISTIC /end REF_CHARACTERISTIC
 /begin REF_MEASUREMENT /end REF_MEASUREMENT
/end GROUP
/begin GROUP DigHwTrqSENT.SrlComHwTrq.HwNm_f32 "MICROSAR RTE" /begin SUB_GROUP /end SUB_GROUP /begin FUNCTION_LIST /end FUNCTION_LIST /begin REF_CHARACTERISTIC /end REF_CHARACTERISTIC /begin REF_MEASUREMENT Rte_DigHwTrqSENT_SrlComHwTrq_HwNm_f32 /end REF_MEASUREMENT /end GROUP
/begin GROUP DigHwTrqSENT.SrlComHwTrqValid.Cnt_lgc "MICROSAR RTE" /begin SUB_GROUP /end SUB_GROUP /begin FUNCTION_LIST /end FUNCTION_LIST /begin REF_CHARACTERISTIC /end REF_CHARACTERISTIC /begin REF_MEASUREMENT Rte_DigHwTrqSENT_SrlComHwTrqValid_Cnt_lgc /end REF_MEASUREMENT /end GROUP
/begin GROUP DigHwTrqSENT.SysCHwTorque.HwNm_f32 "MICROSAR RTE" /begin SUB_GROUP /end SUB_GROUP /begin FUNCTION_LIST /end FUNCTION_LIST /begin REF_CHARACTERISTIC /end REF_CHARACTERISTIC /begin REF_MEASUREMENT Rte_DigHwTrqSENT_SysCHwTorque_HwNm_f32 /end REF_MEASUREMENT /end GROUP
/begin GROUP DigHwTrqSENT.T1.HwNm_f32 "MICROSAR RTE" /begin SUB_GROUP /end SUB_GROUP /begin FUNCTION_LIST /end FUNCTION_LIST /begin REF_CHARACTERISTIC /end REF_CHARACTERISTIC /begin REF_MEASUREMENT Rte_Nhet1_DigHwTrqT1_HwNm_f32 /end REF_MEASUREMENT /end GROUP
/begin GROUP DigHwTrqSENT.T2.HwNm_f32 "MICROSAR RTE" /begin SUB_GROUP /end SUB_GROUP /begin FUNCTION_LIST /end FUNCTION_LIST /begin REF_CHARACTERISTIC /end REF_CHARACTERISTIC /begin REF_MEASUREMENT Rte_Nhet1_DigHwTrqT2_HwNm_f32 /end REF_MEASUREMENT /end GROUP
/begin GROUP DigMSB "MICROSAR RTE"
 /begin SUB_GROUP DigMSB.PerInstanceMemories DigMSB.ReceiverPorts DigMSB.SenderPorts /end SUB_GROUP
 /begin FUNCTION_LIST /end FUNCTION_LIST
 /begin REF_CHARACTERISTIC /end REF_CHARACTERISTIC
 /begin REF_MEASUREMENT /end REF_MEASUREMENT
/end GROUP
/begin GROUP DigMSB.AlignedCumMechMtrPosCRF.Deg_f32 "MICROSAR RTE" /begin SUB_GROUP /end SUB_GROUP /begin FUNCTION_LIST /end FUNCTION_LIST /begin REF_CHARACTERISTIC /end REF_CHARACTERISTIC /end GROUP
/begin GROUP DigMSB.AlignedCumMechMtrPosMRF.Deg_f32 "MICROSAR RTE" /begin SUB_GROUP /end SUB_GROUP /begin FUNCTION_LIST /end FUNCTION_LIST /begin REF_CHARACTERISTIC /end REF_CHARACTERISTIC /begin REF_MEASUREMENT Rte_DigMSB_AlignedCumMechMtrPosMRF_Deg_f32 /end REF_MEASUREMENT /end GROUP
/begin GROUP DigMSB.AlignedCumMechMtrPosStatus.Cnt_u08 "MICROSAR RTE" /begin SUB_GROUP /end SUB_GROUP /begin FUNCTION_LIST /end FUNCTION_LIST /begin REF_CHARACTERISTIC /end REF_CHARACTERISTIC /end GROUP
/begin GROUP DigMSB.AssistAssemblyPolarity.Cnt_s08 "MICROSAR RTE" /begin SUB_GROUP /end SUB_GROUP /begin FUNCTION_LIST /end FUNCTION_LIST /begin REF_CHARACTERISTIC /end REF_CHARACTERISTIC /begin REF_MEASUREMENT Rte_Polarity_AssistAssyPolarity_Cnt_s08 /end REF_MEASUREMENT /end GROUP
/begin GROUP DigMSB.CorrectedElecMtrPos.Rev_u0p16 "MICROSAR RTE" /begin SUB_GROUP /end SUB_GROUP /begin FUNCTION_LIST /end FUNCTION_LIST /begin REF_CHARACTERISTIC /end REF_CHARACTERISTIC /end GROUP
/begin GROUP DigMSB.CumMechMtrPos.Rev_f32 "MICROSAR RTE" /begin SUB_GROUP /end SUB_GROUP /begin FUNCTION_LIST /end FUNCTION_LIST /begin REF_CHARACTERISTIC /end REF_CHARACTERISTIC /end GROUP
/begin GROUP DigMSB.CumMechMtrPosCRF.Deg_f32 "MICROSAR RTE" /begin SUB_GROUP /end SUB_GROUP /begin FUNCTION_LIST /end FUNCTION_LIST /begin REF_CHARACTERISTIC /end REF_CHARACTERISTIC /end GROUP
/begin GROUP DigMSB.CumMechMtrPosMRF.Deg_f32 "MICROSAR RTE" /begin SUB_GROUP /end SUB_GROUP /begin FUNCTION_LIST /end FUNCTION_LIST /begin REF_CHARACTERISTIC /end REF_CHARACTERISTIC /begin REF_MEASUREMENT Rte_DigMSB_CumMechMtrPosMRF_Deg_f32 /end REF_MEASUREMENT /end GROUP
/begin GROUP DigMSB.CumMechMtrPosStatus.Cnt_u08 "MICROSAR RTE" /begin SUB_GROUP /end SUB_GROUP /begin FUNCTION_LIST /end FUNCTION_LIST /begin REF_CHARACTERISTIC /end REF_CHARACTERISTIC /begin REF_MEASUREMENT Rte_DigMSB_CumMechMtrPosStatus_Cnt_u08 /end REF_MEASUREMENT /end GROUP
/begin GROUP DigMSB.Die1RxError.Cnt_u16 "MICROSAR RTE" /begin SUB_GROUP /end SUB_GROUP /begin FUNCTION_LIST /end FUNCTION_LIST /begin REF_CHARACTERISTIC /end REF_CHARACTERISTIC /end GROUP
/begin GROUP DigMSB.Die1RxMtrPos.Cnt_u16 "MICROSAR RTE" /begin SUB_GROUP /end SUB_GROUP /begin FUNCTION_LIST /end FUNCTION_LIST /begin REF_CHARACTERISTIC /end REF_CHARACTERISTIC /end GROUP
/begin GROUP DigMSB.Die1RxRevCtr.Cnt_u16 "MICROSAR RTE" /begin SUB_GROUP /end SUB_GROUP /begin FUNCTION_LIST /end FUNCTION_LIST /begin REF_CHARACTERISTIC /end REF_CHARACTERISTIC /end GROUP
/begin GROUP DigMSB.Die1UnderVoltgFltAccum.Cnt_u16 "MICROSAR RTE" /begin SUB_GROUP /end SUB_GROUP /begin FUNCTION_LIST /end FUNCTION_LIST /begin REF_CHARACTERISTIC /end REF_CHARACTERISTIC /end GROUP
/begin GROUP DigMSB.Die2RxError.Cnt_u16 "MICROSAR RTE" /begin SUB_GROUP /end SUB_GROUP /begin FUNCTION_LIST /end FUNCTION_LIST /begin REF_CHARACTERISTIC /end REF_CHARACTERISTIC /end GROUP
/begin GROUP DigMSB.Die2RxMtrPos.Cnt_u16 "MICROSAR RTE" /begin SUB_GROUP /end SUB_GROUP /begin FUNCTION_LIST /end FUNCTION_LIST /begin REF_CHARACTERISTIC /end REF_CHARACTERISTIC /end GROUP
/begin GROUP DigMSB.Die2RxRevCtr.Cnt_u16 "MICROSAR RTE" /begin SUB_GROUP /end SUB_GROUP /begin FUNCTION_LIST /end FUNCTION_LIST /begin REF_CHARACTERISTIC /end REF_CHARACTERISTIC /end GROUP
/begin GROUP DigMSB.DigMSBEOLData "MICROSAR RTE" /begin SUB_GROUP /end SUB_GROUP /begin FUNCTION_LIST /end FUNCTION_LIST /begin REF_CHARACTERISTIC /end REF_CHARACTERISTIC
 /begin REF_MEASUREMENT Rte_DigMSB_DigMSBEOLData.CRC_Cnt_u16 Rte_DigMSB_DigMSBEOLData.MtrPos1HarCompTbl_Rev_s2p13 Rte_DigMSB_DigMSBEOLData.MtrPos2HarCompTbl_Rev_s2p13 Rte_DigMSB_DigMSBEOLData.MtrPosBEMFRedundant_Rev_u0p16 Rte_DigMSB_DigMSBEOLData.MtrPosBEMF_Rev_u0p16 /end REF_MEASUREMENT
/end GROUP
/begin GROUP DigMSB.MechMtrPos2.Rev_u0p16 "MICROSAR RTE" /begin SUB_GROUP /end SUB_GROUP /begin FUNCTION_LIST /end FUNCTION_LIST /begin REF_CHARACTERISTIC /end REF_CHARACTERISTIC /begin REF_MEASUREMENT Rte_DigMSB_MechMtrPos2_Rev_u0p16 /end REF_MEASUREMENT /end GROUP
/begin GROUP DigMSB.MtrPosPolarity.Cnt_s08 "MICROSAR RTE" /begin SUB_GROUP /end SUB_GROUP /begin FUNCTION_LIST /end FUNCTION_LIST /begin REF_CHARACTERISTIC /end REF_CHARACTERISTIC /end GROUP
/begin GROUP DigMSB.PerInstanceMemories "MICROSAR RTE" /begin SUB_GROUP DigMSB.DigMSBEOLData /end SUB_GROUP /begin FUNCTION_LIST /end FUNCTION_LIST /begin REF_CHARACTERISTIC /end REF_CHARACTERISTIC /begin REF_MEASUREMENT /end REF_MEASUREMENT /end GROUP
/begin GROUP DigMSB.ReceiverPorts "MICROSAR RTE"
 /begin SUB_GROUP DigMSB.AssistAssemblyPolarity.Cnt_s08 DigMSB.CorrectedElecMtrPos.Rev_u0p16 DigMSB.CumMechMtrPos.Rev_f32 DigMSB.Die1RxError.Cnt_u16 DigMSB.Die1RxMtrPos.Cnt_u16 DigMSB.Die1RxRevCtr.Cnt_u16 DigMSB.Die1UnderVoltgFltAccum.Cnt_u16 DigMSB.Die2RxError.Cnt_u16 DigMSB.Die2RxMtrPos.Cnt_u16 DigMSB.Die2RxRevCtr.Cnt_u16 DigMSB.MtrPosPolarity.Cnt_s08 DigMSB.RxMtrPosParityAccum.Cnt_u16 DigMSB.UncorrMechMtrPos1.Rev_u0p16 /end SUB_GROUP
 /begin FUNCTION_LIST /end FUNCTION_LIST
 /begin REF_CHARACTERISTIC /end REF_CHARACTERISTIC
 /begin REF_MEASUREMENT /end REF_MEASUREMENT
/end GROUP
/begin GROUP DigMSB.RxMtrPosParityAccum.Cnt_u16 "MICROSAR RTE" /begin SUB_GROUP /end SUB_GROUP /begin FUNCTION_LIST /end FUNCTION_LIST /begin REF_CHARACTERISTIC /end REF_CHARACTERISTIC /end GROUP
/begin GROUP DigMSB.SenderPorts "MICROSAR RTE"
 /begin SUB_GROUP DigMSB.AlignedCumMechMtrPosCRF.Deg_f32 DigMSB.AlignedCumMechMtrPosMRF.Deg_f32 DigMSB.AlignedCumMechMtrPosStatus.Cnt_u08 DigMSB.CumMechMtrPosCRF.Deg_f32 DigMSB.CumMechMtrPosMRF.Deg_f32 DigMSB.CumMechMtrPosStatus.Cnt_u08 DigMSB.MechMtrPos2.Rev_u0p16 DigMSB.SysCCumMechMtrPosMRF.Deg_f32 /end SUB_GROUP
 /begin FUNCTION_LIST /end FUNCTION_LIST
 /begin REF_CHARACTERISTIC /end REF_CHARACTERISTIC
 /begin REF_MEASUREMENT /end REF_MEASUREMENT
/end GROUP
/begin GROUP DigMSB.SysCCumMechMtrPosMRF.Deg_f32 "MICROSAR RTE" /begin SUB_GROUP /end SUB_GROUP /begin FUNCTION_LIST /end FUNCTION_LIST /begin REF_CHARACTERISTIC /end REF_CHARACTERISTIC /begin REF_MEASUREMENT Rte_DigMSB_SysCCumMechMtrPosMRF_Deg_f32 /end REF_MEASUREMENT /end GROUP
/begin GROUP DigMSB.UncorrMechMtrPos1.Rev_u0p16 "MICROSAR RTE" /begin SUB_GROUP /end SUB_GROUP /begin FUNCTION_LIST /end FUNCTION_LIST /begin REF_CHARACTERISTIC /end REF_CHARACTERISTIC /begin REF_MEASUREMENT Rte_CDDInterface_UncorrMechMtrPos1_Rev_u0p16 /end REF_MEASUREMENT /end GROUP
/begin GROUP DigPhsReasDiag "MICROSAR RTE"
 /begin SUB_GROUP DigPhsReasDiag.ModeRequirePorts DigPhsReasDiag.ReceiverPorts /end SUB_GROUP
 /begin FUNCTION_LIST /end FUNCTION_LIST
 /begin REF_CHARACTERISTIC /end REF_CHARACTERISTIC
 /begin REF_MEASUREMENT /end REF_MEASUREMENT
/end GROUP
/begin GROUP DigPhsReasDiag.ExpectedOnTimeA.Cnt_u32 "MICROSAR RTE" /begin SUB_GROUP /end SUB_GROUP /begin FUNCTION_LIST /end FUNCTION_LIST /begin REF_CHARACTERISTIC /end REF_CHARACTERISTIC /end GROUP
/begin GROUP DigPhsReasDiag.ExpectedOnTimeB.Cnt_u32 "MICROSAR RTE" /begin SUB_GROUP /end SUB_GROUP /begin FUNCTION_LIST /end FUNCTION_LIST /begin REF_CHARACTERISTIC /end REF_CHARACTERISTIC /end GROUP
/begin GROUP DigPhsReasDiag.ExpectedOnTimeC.Cnt_u32 "MICROSAR RTE" /begin SUB_GROUP /end SUB_GROUP /begin FUNCTION_LIST /end FUNCTION_LIST /begin REF_CHARACTERISTIC /end REF_CHARACTERISTIC /end GROUP
/begin GROUP DigPhsReasDiag.GateDriveResetActive.Cnt_lgc "MICROSAR RTE" /begin SUB_GROUP /end SUB_GROUP /begin FUNCTION_LIST /end FUNCTION_LIST /begin REF_CHARACTERISTIC /end REF_CHARACTERISTIC /begin REF_MEASUREMENT Rte_MtrDrvDiag_GateDriveResetActive_Cnt_lgc /end REF_MEASUREMENT /end GROUP
/begin GROUP DigPhsReasDiag.LRPRCorrectedMtrPosCaptured.Rev_f32 "MICROSAR RTE" /begin SUB_GROUP /end SUB_GROUP /begin FUNCTION_LIST /end FUNCTION_LIST /begin REF_CHARACTERISTIC /end REF_CHARACTERISTIC /end GROUP
/begin GROUP DigPhsReasDiag.LRPRModulationIndexCaptured.Uls_f32 "MICROSAR RTE" /begin SUB_GROUP /end SUB_GROUP /begin FUNCTION_LIST /end FUNCTION_LIST /begin REF_CHARACTERISTIC /end REF_CHARACTERISTIC /end GROUP
/begin GROUP DigPhsReasDiag.LRPRPhaseadvanceCaptured.Cnt_s16 "MICROSAR RTE" /begin SUB_GROUP /end SUB_GROUP /begin FUNCTION_LIST /end FUNCTION_LIST /begin REF_CHARACTERISTIC /end REF_CHARACTERISTIC /end GROUP
/begin GROUP DigPhsReasDiag.MeasuredOnTimeA.Cnt_u32 "MICROSAR RTE" /begin SUB_GROUP /end SUB_GROUP /begin FUNCTION_LIST /end FUNCTION_LIST /begin REF_CHARACTERISTIC /end REF_CHARACTERISTIC /end GROUP
/begin GROUP DigPhsReasDiag.MeasuredOnTimeB.Cnt_u32 "MICROSAR RTE" /begin SUB_GROUP /end SUB_GROUP /begin FUNCTION_LIST /end FUNCTION_LIST /begin REF_CHARACTERISTIC /end REF_CHARACTERISTIC /end GROUP
/begin GROUP DigPhsReasDiag.MeasuredOnTimeC.Cnt_u32 "MICROSAR RTE" /begin SUB_GROUP /end SUB_GROUP /begin FUNCTION_LIST /end FUNCTION_LIST /begin REF_CHARACTERISTIC /end REF_CHARACTERISTIC /end GROUP
/begin GROUP DigPhsReasDiag.ModeRequirePorts "MICROSAR RTE" /begin SUB_GROUP DigPhsReasDiag.SystemState.Mode /end SUB_GROUP /begin FUNCTION_LIST /end FUNCTION_LIST /begin REF_CHARACTERISTIC /end REF_CHARACTERISTIC /begin REF_MEASUREMENT /end REF_MEASUREMENT /end GROUP
/begin GROUP DigPhsReasDiag.MotorVelMRFUnfiltered.MtrRadpS_f32 "MICROSAR RTE" /begin SUB_GROUP /end SUB_GROUP /begin FUNCTION_LIST /end FUNCTION_LIST /begin REF_CHARACTERISTIC /end REF_CHARACTERISTIC /end GROUP
/begin GROUP DigPhsReasDiag.MtrElecMechPolarity.Cnt_s08 "MICROSAR RTE" /begin SUB_GROUP /end SUB_GROUP /begin FUNCTION_LIST /end FUNCTION_LIST /begin REF_CHARACTERISTIC /end REF_CHARACTERISTIC /end GROUP
/begin GROUP DigPhsReasDiag.PDActivateTest.Cnt_lgc "MICROSAR RTE" /begin SUB_GROUP /end SUB_GROUP /begin FUNCTION_LIST /end FUNCTION_LIST /begin REF_CHARACTERISTIC /end REF_CHARACTERISTIC /begin REF_MEASUREMENT Rte_DigPhsReasDiag_PDActivateTest_Cnt_lgc /end REF_MEASUREMENT /end GROUP
/begin GROUP DigPhsReasDiag.ReceiverPorts "MICROSAR RTE"
 /begin SUB_GROUP DigPhsReasDiag.ExpectedOnTimeA.Cnt_u32 DigPhsReasDiag.ExpectedOnTimeB.Cnt_u32 DigPhsReasDiag.ExpectedOnTimeC.Cnt_u32 DigPhsReasDiag.GateDriveResetActive.Cnt_lgc DigPhsReasDiag.LRPRCorrectedMtrPosCaptured.Rev_f32 DigPhsReasDiag.LRPRModulationIndexCaptured.Uls_f32 DigPhsReasDiag.LRPRPhaseadvanceCaptured.Cnt_s16 DigPhsReasDiag.MeasuredOnTimeA.Cnt_u32 DigPhsReasDiag.MeasuredOnTimeB.Cnt_u32 DigPhsReasDiag.MeasuredOnTimeC.Cnt_u32 DigPhsReasDiag.MotorVelMRFUnfiltered.MtrRadpS_f32 DigPhsReasDiag.MtrElecMechPolarity.Cnt_s08 DigPhsReasDiag.PDActivateTest.Cnt_lgc /end SUB_GROUP
 /begin FUNCTION_LIST /end FUNCTION_LIST
 /begin REF_CHARACTERISTIC /end REF_CHARACTERISTIC
 /begin REF_MEASUREMENT /end REF_MEASUREMENT
/end GROUP
/begin GROUP DigPhsReasDiag.SystemState.Mode "MICROSAR RTE" /begin SUB_GROUP /end SUB_GROUP /begin FUNCTION_LIST /end FUNCTION_LIST /begin REF_CHARACTERISTIC /end REF_CHARACTERISTIC /end GROUP
/begin GROUP EOTActuatorMng "MICROSAR RTE" /begin SUB_GROUP EOTActuatorMng.ReceiverPorts EOTActuatorMng.SenderPorts /end SUB_GROUP /begin FUNCTION_LIST /end FUNCTION_LIST /begin REF_CHARACTERISTIC /end REF_CHARACTERISTIC /begin REF_MEASUREMENT /end REF_MEASUREMENT /end GROUP
/begin GROUP EOTActuatorMng.AssistEOTDamping.MtrNm_f32 "MICROSAR RTE" /begin SUB_GROUP /end SUB_GROUP /begin FUNCTION_LIST /end FUNCTION_LIST /begin REF_CHARACTERISTIC /end REF_CHARACTERISTIC /begin REF_MEASUREMENT Rte_EOTActuatorMng_AssistEOTDamping_MtrNm_f32 /end REF_MEASUREMENT /end GROUP
/begin GROUP EOTActuatorMng.AssistEOTGain.Uls_f32 "MICROSAR RTE" /begin SUB_GROUP /end SUB_GROUP /begin FUNCTION_LIST /end FUNCTION_LIST /begin REF_CHARACTERISTIC /end REF_CHARACTERISTIC /begin REF_MEASUREMENT Rte_EOTActuatorMng_AssistEOTGain_Uls_f32 /end REF_MEASUREMENT /end GROUP
/begin GROUP EOTActuatorMng.AssistEOTLimit.MtrNm_f32 "MICROSAR RTE" /begin SUB_GROUP /end SUB_GROUP /begin FUNCTION_LIST /end FUNCTION_LIST /begin REF_CHARACTERISTIC /end REF_CHARACTERISTIC /begin REF_MEASUREMENT Rte_EOTActuatorMng_AssistEOTLimit_MtrNm_f32 /end REF_MEASUREMENT /end GROUP
/begin GROUP EOTActuatorMng.CcwEOT.HwDeg_f32 "MICROSAR RTE" /begin SUB_GROUP /end SUB_GROUP /begin FUNCTION_LIST /end FUNCTION_LIST /begin REF_CHARACTERISTIC /end REF_CHARACTERISTIC /begin REF_MEASUREMENT Rte_LrnEOT_CCWPosition_HwDeg_f32 /end REF_MEASUREMENT /end GROUP
/begin GROUP EOTActuatorMng.CcwFound.Cnt_lgc "MICROSAR RTE" /begin SUB_GROUP /end SUB_GROUP /begin FUNCTION_LIST /end FUNCTION_LIST /begin REF_CHARACTERISTIC /end REF_CHARACTERISTIC /begin REF_MEASUREMENT Rte_LrnEOT_CCWFound_Cnt_lgc /end REF_MEASUREMENT /end GROUP
/begin GROUP EOTActuatorMng.CwEOT.HwDeg_f32 "MICROSAR RTE" /begin SUB_GROUP /end SUB_GROUP /begin FUNCTION_LIST /end FUNCTION_LIST /begin REF_CHARACTERISTIC /end REF_CHARACTERISTIC /begin REF_MEASUREMENT Rte_LrnEOT_CWPosition_HwDeg_f32 /end REF_MEASUREMENT /end GROUP
/begin GROUP EOTActuatorMng.CwFound.Cnt_lgc "MICROSAR RTE" /begin SUB_GROUP /end SUB_GROUP /begin FUNCTION_LIST /end FUNCTION_LIST /begin REF_CHARACTERISTIC /end REF_CHARACTERISTIC /begin REF_MEASUREMENT Rte_LrnEOT_CWFound_Cnt_lgc /end REF_MEASUREMENT /end GROUP
/begin GROUP EOTActuatorMng.EOTDisable.Cnt_lgc "MICROSAR RTE" /begin SUB_GROUP /end SUB_GROUP /begin FUNCTION_LIST /end FUNCTION_LIST /begin REF_CHARACTERISTIC /end REF_CHARACTERISTIC /end GROUP
/begin GROUP EOTActuatorMng.HandWheelAuth.Uls_f32 "MICROSAR RTE" /begin SUB_GROUP /end SUB_GROUP /begin FUNCTION_LIST /end FUNCTION_LIST /begin REF_CHARACTERISTIC /end REF_CHARACTERISTIC /end GROUP
/begin GROUP EOTActuatorMng.HandWheelPos.HwDeg_f32 "MICROSAR RTE" /begin SUB_GROUP /end SUB_GROUP /begin FUNCTION_LIST /end FUNCTION_LIST /begin REF_CHARACTERISTIC /end REF_CHARACTERISTIC /end GROUP
/begin GROUP EOTActuatorMng.HwTorque.HwNm_f32 "MICROSAR RTE" /begin SUB_GROUP /end SUB_GROUP /begin FUNCTION_LIST /end FUNCTION_LIST /begin REF_CHARACTERISTIC /end REF_CHARACTERISTIC /end GROUP
/begin GROUP EOTActuatorMng.MotorVel.MtrRadpS_f32 "MICROSAR RTE" /begin SUB_GROUP /end SUB_GROUP /begin FUNCTION_LIST /end FUNCTION_LIST /begin REF_CHARACTERISTIC /end REF_CHARACTERISTIC /begin REF_MEASUREMENT Rte_MtrVel_MotorVelCRF_MtrRadpS_f32 /end REF_MEASUREMENT /end GROUP
/begin GROUP EOTActuatorMng.OutputRampMultLtd.Uls_f32 "MICROSAR RTE" /begin SUB_GROUP /end SUB_GROUP /begin FUNCTION_LIST /end FUNCTION_LIST /begin REF_CHARACTERISTIC /end REF_CHARACTERISTIC /end GROUP
/begin GROUP EOTActuatorMng.PreLimitTorque.MtrNm_f32 "MICROSAR RTE" /begin SUB_GROUP /end SUB_GROUP /begin FUNCTION_LIST /end FUNCTION_LIST /begin REF_CHARACTERISTIC /end REF_CHARACTERISTIC /end GROUP
/begin GROUP EOTActuatorMng.ReceiverPorts "MICROSAR RTE"
 /begin SUB_GROUP EOTActuatorMng.CcwEOT.HwDeg_f32 EOTActuatorMng.CcwFound.Cnt_lgc EOTActuatorMng.CwEOT.HwDeg_f32 EOTActuatorMng.CwFound.Cnt_lgc EOTActuatorMng.EOTDisable.Cnt_lgc EOTActuatorMng.HandWheelAuth.Uls_f32 EOTActuatorMng.HandWheelPos.HwDeg_f32 EOTActuatorMng.HwTorque.HwNm_f32 EOTActuatorMng.MotorVel.MtrRadpS_f32 EOTActuatorMng.OutputRampMultLtd.Uls_f32 EOTActuatorMng.PreLimitTorque.MtrNm_f32 EOTActuatorMng.VehicleSpeed.Kph_f32 /end SUB_GROUP
 /begin FUNCTION_LIST /end FUNCTION_LIST
 /begin REF_CHARACTERISTIC /end REF_CHARACTERISTIC
 /begin REF_MEASUREMENT /end REF_MEASUREMENT
/end GROUP
/begin GROUP EOTActuatorMng.SenderPorts "MICROSAR RTE"
 /begin SUB_GROUP EOTActuatorMng.AssistEOTDamping.MtrNm_f32 EOTActuatorMng.AssistEOTGain.Uls_f32 EOTActuatorMng.AssistEOTLimit.MtrNm_f32 /end SUB_GROUP
 /begin FUNCTION_LIST /end FUNCTION_LIST
 /begin REF_CHARACTERISTIC /end REF_CHARACTERISTIC
 /begin REF_MEASUREMENT /end REF_MEASUREMENT
/end GROUP
/begin GROUP EOTActuatorMng.VehicleSpeed.Kph_f32 "MICROSAR RTE" /begin SUB_GROUP /end SUB_GROUP /begin FUNCTION_LIST /end FUNCTION_LIST /begin REF_CHARACTERISTIC /end REF_CHARACTERISTIC /end GROUP
/begin GROUP ElePwr "MICROSAR RTE" /begin SUB_GROUP ElePwr.ReceiverPorts ElePwr.SenderPorts /end SUB_GROUP /begin FUNCTION_LIST /end FUNCTION_LIST /begin REF_CHARACTERISTIC /end REF_CHARACTERISTIC /begin REF_MEASUREMENT /end REF_MEASUREMENT /end GROUP
/begin GROUP ElePwr.ElectricPower.Watt_f32 "MICROSAR RTE" /begin SUB_GROUP /end SUB_GROUP /begin FUNCTION_LIST /end FUNCTION_LIST /begin REF_CHARACTERISTIC /end REF_CHARACTERISTIC /begin REF_MEASUREMENT Rte_ElePwr_ElectricPower_Watt_f32 /end REF_MEASUREMENT /end GROUP
/begin GROUP ElePwr.MtrCurrDax.Amp_f32 "MICROSAR RTE" /begin SUB_GROUP /end SUB_GROUP /begin FUNCTION_LIST /end FUNCTION_LIST /begin REF_CHARACTERISTIC /end REF_CHARACTERISTIC /end GROUP
/begin GROUP ElePwr.MtrCurrQax.Amp_f32 "MICROSAR RTE" /begin SUB_GROUP /end SUB_GROUP /begin FUNCTION_LIST /end FUNCTION_LIST /begin REF_CHARACTERISTIC /end REF_CHARACTERISTIC /end GROUP
/begin GROUP ElePwr.MtrVoltDax.Volt_f32 "MICROSAR RTE" /begin SUB_GROUP /end SUB_GROUP /begin FUNCTION_LIST /end FUNCTION_LIST /begin REF_CHARACTERISTIC /end REF_CHARACTERISTIC /end GROUP
/begin GROUP ElePwr.MtrVoltQax.Volt_f32 "MICROSAR RTE" /begin SUB_GROUP /end SUB_GROUP /begin FUNCTION_LIST /end FUNCTION_LIST /begin REF_CHARACTERISTIC /end REF_CHARACTERISTIC /end GROUP
/begin GROUP ElePwr.ReceiverPorts "MICROSAR RTE"
 /begin SUB_GROUP ElePwr.MtrCurrDax.Amp_f32 ElePwr.MtrCurrQax.Amp_f32 ElePwr.MtrVoltDax.Volt_f32 ElePwr.MtrVoltQax.Volt_f32 ElePwr.Vecu.Volt_f32 /end SUB_GROUP
 /begin FUNCTION_LIST /end FUNCTION_LIST
 /begin REF_CHARACTERISTIC /end REF_CHARACTERISTIC
 /begin REF_MEASUREMENT /end REF_MEASUREMENT
/end GROUP
/begin GROUP ElePwr.SenderPorts "MICROSAR RTE" /begin SUB_GROUP ElePwr.ElectricPower.Watt_f32 ElePwr.SupplyCurrent.Amp_f32 /end SUB_GROUP /begin FUNCTION_LIST /end FUNCTION_LIST /begin REF_CHARACTERISTIC /end REF_CHARACTERISTIC /begin REF_MEASUREMENT /end REF_MEASUREMENT /end GROUP
/begin GROUP ElePwr.SupplyCurrent.Amp_f32 "MICROSAR RTE" /begin SUB_GROUP /end SUB_GROUP /begin FUNCTION_LIST /end FUNCTION_LIST /begin REF_CHARACTERISTIC /end REF_CHARACTERISTIC /begin REF_MEASUREMENT Rte_ElePwr_SupplyCurrent_Amp_f32 /end REF_MEASUREMENT /end GROUP
/begin GROUP ElePwr.Vecu.Volt_f32 "MICROSAR RTE" /begin SUB_GROUP /end SUB_GROUP /begin FUNCTION_LIST /end FUNCTION_LIST /begin REF_CHARACTERISTIC /end REF_CHARACTERISTIC /end GROUP
/begin GROUP EtDmpFw "MICROSAR RTE" /begin SUB_GROUP EtDmpFw.ReceiverPorts EtDmpFw.SenderPorts /end SUB_GROUP /begin FUNCTION_LIST /end FUNCTION_LIST /begin REF_CHARACTERISTIC /end REF_CHARACTERISTIC /begin REF_MEASUREMENT /end REF_MEASUREMENT /end GROUP
/begin GROUP EtDmpFw.AssistEOTDamping.MtrNm_f32 "MICROSAR RTE" /begin SUB_GROUP /end SUB_GROUP /begin FUNCTION_LIST /end FUNCTION_LIST /begin REF_CHARACTERISTIC /end REF_CHARACTERISTIC /begin REF_MEASUREMENT Rte_EOTActuatorMng_AssistEOTDamping_MtrNm_f32 /end REF_MEASUREMENT /end GROUP
/begin GROUP EtDmpFw.CRFMtrVel.MtrRadpS_f32 "MICROSAR RTE" /begin SUB_GROUP /end SUB_GROUP /begin FUNCTION_LIST /end FUNCTION_LIST /begin REF_CHARACTERISTIC /end REF_CHARACTERISTIC /begin REF_MEASUREMENT Rte_MtrVel_MotorVelCRF_MtrRadpS_f32 /end REF_MEASUREMENT /end GROUP
/begin GROUP EtDmpFw.EOTDampingLtd.MtrNm_f32 "MICROSAR RTE" /begin SUB_GROUP /end SUB_GROUP /begin FUNCTION_LIST /end FUNCTION_LIST /begin REF_CHARACTERISTIC /end REF_CHARACTERISTIC /end GROUP
/begin GROUP EtDmpFw.EOTDisable.Cnt_lgc "MICROSAR RTE" /begin SUB_GROUP /end SUB_GROUP /begin FUNCTION_LIST /end FUNCTION_LIST /begin REF_CHARACTERISTIC /end REF_CHARACTERISTIC /end GROUP
/begin GROUP EtDmpFw.HandwheelAuthority.Uls_f32 "MICROSAR RTE" /begin SUB_GROUP /end SUB_GROUP /begin FUNCTION_LIST /end FUNCTION_LIST /begin REF_CHARACTERISTIC /end REF_CHARACTERISTIC /end GROUP
/begin GROUP EtDmpFw.HandwheelPosition.HwDeg_f32 "MICROSAR RTE" /begin SUB_GROUP /end SUB_GROUP /begin FUNCTION_LIST /end FUNCTION_LIST /begin REF_CHARACTERISTIC /end REF_CHARACTERISTIC /end GROUP
/begin GROUP EtDmpFw.MEC_Counter.Cnt_enum "MICROSAR RTE" /begin SUB_GROUP /end SUB_GROUP /begin FUNCTION_LIST /end FUNCTION_LIST /begin REF_CHARACTERISTIC /end REF_CHARACTERISTIC /end GROUP
/begin GROUP EtDmpFw.ReceiverPorts "MICROSAR RTE"
 /begin SUB_GROUP EtDmpFw.AssistEOTDamping.MtrNm_f32 EtDmpFw.CRFMtrVel.MtrRadpS_f32 EtDmpFw.EOTDisable.Cnt_lgc EtDmpFw.HandwheelAuthority.Uls_f32 EtDmpFw.HandwheelPosition.HwDeg_f32 EtDmpFw.MEC_Counter.Cnt_enum EtDmpFw.Vehicle_Speed.Kph_f32 /end SUB_GROUP
 /begin FUNCTION_LIST /end FUNCTION_LIST
 /begin REF_CHARACTERISTIC /end REF_CHARACTERISTIC
 /begin REF_MEASUREMENT /end REF_MEASUREMENT
/end GROUP
/begin GROUP EtDmpFw.SenderPorts "MICROSAR RTE" /begin SUB_GROUP EtDmpFw.EOTDampingLtd.MtrNm_f32 /end SUB_GROUP /begin FUNCTION_LIST /end FUNCTION_LIST /begin REF_CHARACTERISTIC /end REF_CHARACTERISTIC /begin REF_MEASUREMENT /end REF_MEASUREMENT /end GROUP
/begin GROUP EtDmpFw.Vehicle_Speed.Kph_f32 "MICROSAR RTE" /begin SUB_GROUP /end SUB_GROUP /begin FUNCTION_LIST /end FUNCTION_LIST /begin REF_CHARACTERISTIC /end REF_CHARACTERISTIC /end GROUP
/begin GROUP FltInjection "MICROSAR RTE" /begin SUB_GROUP FltInjection.ReceiverPorts /end SUB_GROUP /begin FUNCTION_LIST /end FUNCTION_LIST /begin REF_CHARACTERISTIC /end REF_CHARACTERISTIC /begin REF_MEASUREMENT /end REF_MEASUREMENT /end GROUP
/begin GROUP FltInjection.MotorVelCRF.MtrRadpS_f32 "MICROSAR RTE" /begin SUB_GROUP /end SUB_GROUP /begin FUNCTION_LIST /end FUNCTION_LIST /begin REF_CHARACTERISTIC /end REF_CHARACTERISTIC /begin REF_MEASUREMENT Rte_MtrVel_MotorVelCRF_MtrRadpS_f32 /end REF_MEASUREMENT /end GROUP
/begin GROUP FltInjection.ReceiverPorts "MICROSAR RTE" /begin SUB_GROUP FltInjection.MotorVelCRF.MtrRadpS_f32 /end SUB_GROUP /begin FUNCTION_LIST /end FUNCTION_LIST /begin REF_CHARACTERISTIC /end REF_CHARACTERISTIC /begin REF_MEASUREMENT /end REF_MEASUREMENT /end GROUP
/begin GROUP FrqDepDmpnInrtCmp "MICROSAR RTE"
 /begin SUB_GROUP FrqDepDmpnInrtCmp.ModeRequirePorts FrqDepDmpnInrtCmp.ReceiverPorts FrqDepDmpnInrtCmp.SenderPorts /end SUB_GROUP
 /begin FUNCTION_LIST /end FUNCTION_LIST
 /begin REF_CHARACTERISTIC /end REF_CHARACTERISTIC
 /begin REF_MEASUREMENT /end REF_MEASUREMENT
/end GROUP
/begin GROUP FrqDepDmpnInrtCmp.BaseAssistCmd.MtrNm_f32 "MICROSAR RTE" /begin SUB_GROUP /end SUB_GROUP /begin FUNCTION_LIST /end FUNCTION_LIST /begin REF_CHARACTERISTIC /end REF_CHARACTERISTIC /end GROUP
/begin GROUP FrqDepDmpnInrtCmp.CRFMotorVel.MtrRadpS_f32 "MICROSAR RTE" /begin SUB_GROUP /end SUB_GROUP /begin FUNCTION_LIST /end FUNCTION_LIST /begin REF_CHARACTERISTIC /end REF_CHARACTERISTIC /begin REF_MEASUREMENT Rte_MtrVel_MotorVelCRF_MtrRadpS_f32 /end REF_MEASUREMENT /end GROUP
/begin GROUP FrqDepDmpnInrtCmp.FreqDepDmpSrlComSvcDft.Cnt_lgc "MICROSAR RTE" /begin SUB_GROUP /end SUB_GROUP /begin FUNCTION_LIST /end FUNCTION_LIST /begin REF_CHARACTERISTIC /end REF_CHARACTERISTIC /end GROUP
/begin GROUP FrqDepDmpnInrtCmp.FrqDepDmpnInrtCmp.MtrNm_f32 "MICROSAR RTE" /begin SUB_GROUP /end SUB_GROUP /begin FUNCTION_LIST /end FUNCTION_LIST /begin REF_CHARACTERISTIC /end REF_CHARACTERISTIC /begin REF_MEASUREMENT Rte_FrqDepDmpnInrtCmp_FrqDepDmpnInrtCmp_MtrNm_f32 /end REF_MEASUREMENT /end GROUP
/begin GROUP FrqDepDmpnInrtCmp.HwTorque.HwNm_f32 "MICROSAR RTE" /begin SUB_GROUP /end SUB_GROUP /begin FUNCTION_LIST /end FUNCTION_LIST /begin REF_CHARACTERISTIC /end REF_CHARACTERISTIC /end GROUP
/begin GROUP FrqDepDmpnInrtCmp.ModeRequirePorts "MICROSAR RTE" /begin SUB_GROUP FrqDepDmpnInrtCmp.SystemState.Mode /end SUB_GROUP /begin FUNCTION_LIST /end FUNCTION_LIST /begin REF_CHARACTERISTIC /end REF_CHARACTERISTIC /begin REF_MEASUREMENT /end REF_MEASUREMENT /end GROUP
/begin GROUP FrqDepDmpnInrtCmp.ReceiverPorts "MICROSAR RTE"
 /begin SUB_GROUP FrqDepDmpnInrtCmp.BaseAssistCmd.MtrNm_f32 FrqDepDmpnInrtCmp.CRFMotorVel.MtrRadpS_f32 FrqDepDmpnInrtCmp.FreqDepDmpSrlComSvcDft.Cnt_lgc FrqDepDmpnInrtCmp.HwTorque.HwNm_f32 FrqDepDmpnInrtCmp.VehicleLonAccel.KphpS_f32 FrqDepDmpnInrtCmp.VehicleSpeed.Kph_f32 FrqDepDmpnInrtCmp.WIRCmdAmpBlnd.MtrNm_f32 /end SUB_GROUP
 /begin FUNCTION_LIST /end FUNCTION_LIST
 /begin REF_CHARACTERISTIC /end REF_CHARACTERISTIC
 /begin REF_MEASUREMENT /end REF_MEASUREMENT
/end GROUP
/begin GROUP FrqDepDmpnInrtCmp.SenderPorts "MICROSAR RTE" /begin SUB_GROUP FrqDepDmpnInrtCmp.FrqDepDmpnInrtCmp.MtrNm_f32 /end SUB_GROUP /begin FUNCTION_LIST /end FUNCTION_LIST /begin REF_CHARACTERISTIC /end REF_CHARACTERISTIC /begin REF_MEASUREMENT /end REF_MEASUREMENT /end GROUP
/begin GROUP FrqDepDmpnInrtCmp.SystemState.Mode "MICROSAR RTE" /begin SUB_GROUP /end SUB_GROUP /begin FUNCTION_LIST /end FUNCTION_LIST /begin REF_CHARACTERISTIC /end REF_CHARACTERISTIC /end GROUP
/begin GROUP FrqDepDmpnInrtCmp.VehicleLonAccel.KphpS_f32 "MICROSAR RTE" /begin SUB_GROUP /end SUB_GROUP /begin FUNCTION_LIST /end FUNCTION_LIST /begin REF_CHARACTERISTIC /end REF_CHARACTERISTIC /begin REF_MEASUREMENT Rte_FrqDepDmpnInrtCmp_VehicleLonAccel_KphpS_f32 /end REF_MEASUREMENT /end GROUP
/begin GROUP FrqDepDmpnInrtCmp.VehicleSpeed.Kph_f32 "MICROSAR RTE" /begin SUB_GROUP /end SUB_GROUP /begin FUNCTION_LIST /end FUNCTION_LIST /begin REF_CHARACTERISTIC /end REF_CHARACTERISTIC /end GROUP
/begin GROUP FrqDepDmpnInrtCmp.WIRCmdAmpBlnd.MtrNm_f32 "MICROSAR RTE" /begin SUB_GROUP /end SUB_GROUP /begin FUNCTION_LIST /end FUNCTION_LIST /begin REF_CHARACTERISTIC /end REF_CHARACTERISTIC /begin REF_MEASUREMENT Rte_FrqDepDmpnInrtCmp_WIRCmdAmpBlnd_MtrNm_f32 /end REF_MEASUREMENT /end GROUP
/begin GROUP Gsod "MICROSAR RTE" /begin SUB_GROUP Gsod.ModeRequirePorts Gsod.ReceiverPorts /end SUB_GROUP /begin FUNCTION_LIST /end FUNCTION_LIST /begin REF_CHARACTERISTIC /end REF_CHARACTERISTIC /begin REF_MEASUREMENT /end REF_MEASUREMENT /end GROUP
/begin GROUP Gsod.Ana_Hw_Torque.HwNm_f32 "MICROSAR RTE" /begin SUB_GROUP /end SUB_GROUP /begin FUNCTION_LIST /end FUNCTION_LIST /begin REF_CHARACTERISTIC /end REF_CHARACTERISTIC /begin REF_MEASUREMENT Rte_DigHwTrqSENT_HwTorque_HwNm_f32 /end REF_MEASUREMENT /end GROUP
/begin GROUP Gsod.Corrected_MtrPos.Rev_f32 "MICROSAR RTE" /begin SUB_GROUP /end SUB_GROUP /begin FUNCTION_LIST /end FUNCTION_LIST /begin REF_CHARACTERISTIC /end REF_CHARACTERISTIC /end GROUP
/begin GROUP Gsod.Cum_Mtr_Pos_CRF.Deg_f32 "MICROSAR RTE" /begin SUB_GROUP /end SUB_GROUP /begin FUNCTION_LIST /end FUNCTION_LIST /begin REF_CHARACTERISTIC /end REF_CHARACTERISTIC /begin REF_MEASUREMENT Rte_DigMSB_CumMechMtrPosMRF_Deg_f32 /end REF_MEASUREMENT /end GROUP
/begin GROUP Gsod.ModeRequirePorts "MICROSAR RTE" /begin SUB_GROUP Gsod.SystemState.Mode /end SUB_GROUP /begin FUNCTION_LIST /end FUNCTION_LIST /begin REF_CHARACTERISTIC /end REF_CHARACTERISTIC /begin REF_MEASUREMENT /end REF_MEASUREMENT /end GROUP
/begin GROUP Gsod.MtrElecMech_Polarity.Cnt_s08 "MICROSAR RTE" /begin SUB_GROUP /end SUB_GROUP /begin FUNCTION_LIST /end FUNCTION_LIST /begin REF_CHARACTERISTIC /end REF_CHARACTERISTIC /end GROUP
/begin GROUP Gsod.ReceiverPorts "MICROSAR RTE"
 /begin SUB_GROUP Gsod.Ana_Hw_Torque.HwNm_f32 Gsod.Corrected_MtrPos.Rev_f32 Gsod.Cum_Mtr_Pos_CRF.Deg_f32 Gsod.MtrElecMech_Polarity.Cnt_s08 Gsod.SysC_Ana_Hw_Torque.HwNm_f32 Gsod.SysC_Corrected_MtrPos.Rev_f32 Gsod.SysC_Cum_Mtr_Pos_CRF.Deg_f32 Gsod.SysC_MtrElecMech_Polarity.Cnt_s32 Gsod.SysC_Torque_Cmd_CRF.MtrNm_f32 Gsod.SysC_Torque_Cmd_MRF.MtrNm_f32 Gsod.SysC_Vecu.Volt_f32 Gsod.Torque_Cmd_CRF.MtrNm_f32 Gsod.Torque_Cmd_MRF.MtrNm_f32 Gsod.Vecu.Volt_f32 /end SUB_GROUP
 /begin FUNCTION_LIST /end FUNCTION_LIST
 /begin REF_CHARACTERISTIC /end REF_CHARACTERISTIC
 /begin REF_MEASUREMENT /end REF_MEASUREMENT
/end GROUP
/begin GROUP Gsod.SysC_Ana_Hw_Torque.HwNm_f32 "MICROSAR RTE" /begin SUB_GROUP /end SUB_GROUP /begin FUNCTION_LIST /end FUNCTION_LIST /begin REF_CHARACTERISTIC /end REF_CHARACTERISTIC /begin REF_MEASUREMENT Rte_DigHwTrqSENT_SysCHwTorque_HwNm_f32 /end REF_MEASUREMENT /end GROUP
/begin GROUP Gsod.SysC_Corrected_MtrPos.Rev_f32 "MICROSAR RTE" /begin SUB_GROUP /end SUB_GROUP /begin FUNCTION_LIST /end FUNCTION_LIST /begin REF_CHARACTERISTIC /end REF_CHARACTERISTIC /begin REF_MEASUREMENT Rte_CDDInterface_SysCCorrMtrPosElec_Rev_f32 /end REF_MEASUREMENT /end GROUP
/begin GROUP Gsod.SysC_Cum_Mtr_Pos_CRF.Deg_f32 "MICROSAR RTE" /begin SUB_GROUP /end SUB_GROUP /begin FUNCTION_LIST /end FUNCTION_LIST /begin REF_CHARACTERISTIC /end REF_CHARACTERISTIC /begin REF_MEASUREMENT Rte_DigMSB_SysCCumMechMtrPosMRF_Deg_f32 /end REF_MEASUREMENT /end GROUP
/begin GROUP Gsod.SysC_MtrElecMech_Polarity.Cnt_s32 "MICROSAR RTE" /begin SUB_GROUP /end SUB_GROUP /begin FUNCTION_LIST /end FUNCTION_LIST /begin REF_CHARACTERISTIC /end REF_CHARACTERISTIC /begin REF_MEASUREMENT Rte_Polarity_SysC_MtrElecMechPolarity_Cnt_s32 /end REF_MEASUREMENT /end GROUP
/begin GROUP Gsod.SysC_Torque_Cmd_CRF.MtrNm_f32 "MICROSAR RTE" /begin SUB_GROUP /end SUB_GROUP /begin FUNCTION_LIST /end FUNCTION_LIST /begin REF_CHARACTERISTIC /end REF_CHARACTERISTIC /begin REF_MEASUREMENT Rte_CtrldDisShtdn_SysC_CRFMtrTrqCmd_MtrNm_f32 /end REF_MEASUREMENT /end GROUP
/begin GROUP Gsod.SysC_Torque_Cmd_MRF.MtrNm_f32 "MICROSAR RTE" /begin SUB_GROUP /end SUB_GROUP /begin FUNCTION_LIST /end FUNCTION_LIST /begin REF_CHARACTERISTIC /end REF_CHARACTERISTIC /begin REF_MEASUREMENT Rte_CtrldDisShtdn_SysC_MRFMtrTrqCmd_MtrNm_f32 /end REF_MEASUREMENT /end GROUP
/begin GROUP Gsod.SysC_Vecu.Volt_f32 "MICROSAR RTE" /begin SUB_GROUP /end SUB_GROUP /begin FUNCTION_LIST /end FUNCTION_LIST /begin REF_CHARACTERISTIC /end REF_CHARACTERISTIC /end GROUP
/begin GROUP Gsod.SystemState.Mode "MICROSAR RTE" /begin SUB_GROUP /end SUB_GROUP /begin FUNCTION_LIST /end FUNCTION_LIST /begin REF_CHARACTERISTIC /end REF_CHARACTERISTIC /end GROUP
/begin GROUP Gsod.Torque_Cmd_CRF.MtrNm_f32 "MICROSAR RTE" /begin SUB_GROUP /end SUB_GROUP /begin FUNCTION_LIST /end FUNCTION_LIST /begin REF_CHARACTERISTIC /end REF_CHARACTERISTIC /end GROUP
/begin GROUP Gsod.Torque_Cmd_MRF.MtrNm_f32 "MICROSAR RTE" /begin SUB_GROUP /end SUB_GROUP /begin FUNCTION_LIST /end FUNCTION_LIST /begin REF_CHARACTERISTIC /end REF_CHARACTERISTIC /begin REF_MEASUREMENT Rte_CtrldDisShtdn_CntDisMtrTrqCmdMRF_MtrNm_f32 /end REF_MEASUREMENT /end GROUP
/begin GROUP Gsod.Vecu.Volt_f32 "MICROSAR RTE" /begin SUB_GROUP /end SUB_GROUP /begin FUNCTION_LIST /end FUNCTION_LIST /begin REF_CHARACTERISTIC /end REF_CHARACTERISTIC /end GROUP
/begin GROUP HiLoadStall "MICROSAR RTE" /begin SUB_GROUP HiLoadStall.ReceiverPorts HiLoadStall.SenderPorts /end SUB_GROUP /begin FUNCTION_LIST /end FUNCTION_LIST /begin REF_CHARACTERISTIC /end REF_CHARACTERISTIC /begin REF_MEASUREMENT /end REF_MEASUREMENT /end GROUP
/begin GROUP HiLoadStall.AssistStallLimit.MtrNm_f32 "MICROSAR RTE" /begin SUB_GROUP /end SUB_GROUP /begin FUNCTION_LIST /end FUNCTION_LIST /begin REF_CHARACTERISTIC /end REF_CHARACTERISTIC /begin REF_MEASUREMENT Rte_HiLoadStall_AssistStallLimit_MtrNm_f32 /end REF_MEASUREMENT /end GROUP
/begin GROUP HiLoadStall.DftStallLimit.Cnt_lgc "MICROSAR RTE" /begin SUB_GROUP /end SUB_GROUP /begin FUNCTION_LIST /end FUNCTION_LIST /begin REF_CHARACTERISTIC /end REF_CHARACTERISTIC /end GROUP
/begin GROUP HiLoadStall.MtrVelCRF.MtrRadpS_f32 "MICROSAR RTE" /begin SUB_GROUP /end SUB_GROUP /begin FUNCTION_LIST /end FUNCTION_LIST /begin REF_CHARACTERISTIC /end REF_CHARACTERISTIC /begin REF_MEASUREMENT Rte_MtrVel_MotorVelCRF_MtrRadpS_f32 /end REF_MEASUREMENT /end GROUP
/begin GROUP HiLoadStall.PreLimitForStall.MtrNm_f32 "MICROSAR RTE" /begin SUB_GROUP /end SUB_GROUP /begin FUNCTION_LIST /end FUNCTION_LIST /begin REF_CHARACTERISTIC /end REF_CHARACTERISTIC /end GROUP
/begin GROUP HiLoadStall.ReceiverPorts "MICROSAR RTE"
 /begin SUB_GROUP HiLoadStall.DftStallLimit.Cnt_lgc HiLoadStall.MtrVelCRF.MtrRadpS_f32 HiLoadStall.PreLimitForStall.MtrNm_f32 /end SUB_GROUP
 /begin FUNCTION_LIST /end FUNCTION_LIST
 /begin REF_CHARACTERISTIC /end REF_CHARACTERISTIC
 /begin REF_MEASUREMENT /end REF_MEASUREMENT
/end GROUP
/begin GROUP HiLoadStall.SenderPorts "MICROSAR RTE" /begin SUB_GROUP HiLoadStall.AssistStallLimit.MtrNm_f32 /end SUB_GROUP /begin FUNCTION_LIST /end FUNCTION_LIST /begin REF_CHARACTERISTIC /end REF_CHARACTERISTIC /begin REF_MEASUREMENT /end REF_MEASUREMENT /end GROUP
/begin GROUP HighFreqAssist "MICROSAR RTE" /begin SUB_GROUP HighFreqAssist.ReceiverPorts HighFreqAssist.SenderPorts /end SUB_GROUP /begin FUNCTION_LIST /end FUNCTION_LIST /begin REF_CHARACTERISTIC /end REF_CHARACTERISTIC /begin REF_MEASUREMENT /end REF_MEASUREMENT /end GROUP
/begin GROUP HighFreqAssist.HighFreqAssist.MtrNm_f32 "MICROSAR RTE" /begin SUB_GROUP /end SUB_GROUP /begin FUNCTION_LIST /end FUNCTION_LIST /begin REF_CHARACTERISTIC /end REF_CHARACTERISTIC /end GROUP
/begin GROUP HighFreqAssist.HwTorque.HwNm_f32 "MICROSAR RTE" /begin SUB_GROUP /end SUB_GROUP /begin FUNCTION_LIST /end FUNCTION_LIST /begin REF_CHARACTERISTIC /end REF_CHARACTERISTIC /end GROUP
/begin GROUP HighFreqAssist.ReceiverPorts "MICROSAR RTE"
 /begin SUB_GROUP HighFreqAssist.HwTorque.HwNm_f32 HighFreqAssist.VehicleSpeed.Kph_f32 HighFreqAssist.WIRCmdAmpBlnd.MtrNm_f32 /end SUB_GROUP
 /begin FUNCTION_LIST /end FUNCTION_LIST
 /begin REF_CHARACTERISTIC /end REF_CHARACTERISTIC
 /begin REF_MEASUREMENT /end REF_MEASUREMENT
/end GROUP
/begin GROUP HighFreqAssist.SenderPorts "MICROSAR RTE" /begin SUB_GROUP HighFreqAssist.HighFreqAssist.MtrNm_f32 /end SUB_GROUP /begin FUNCTION_LIST /end FUNCTION_LIST /begin REF_CHARACTERISTIC /end REF_CHARACTERISTIC /begin REF_MEASUREMENT /end REF_MEASUREMENT /end GROUP
/begin GROUP HighFreqAssist.VehicleSpeed.Kph_f32 "MICROSAR RTE" /begin SUB_GROUP /end SUB_GROUP /begin FUNCTION_LIST /end FUNCTION_LIST /begin REF_CHARACTERISTIC /end REF_CHARACTERISTIC /end GROUP
/begin GROUP HighFreqAssist.WIRCmdAmpBlnd.MtrNm_f32 "MICROSAR RTE" /begin SUB_GROUP /end SUB_GROUP /begin FUNCTION_LIST /end FUNCTION_LIST /begin REF_CHARACTERISTIC /end REF_CHARACTERISTIC /begin REF_MEASUREMENT Rte_HighFreqAssist_WIRCmdAmpBlnd_MtrNm_f32 /end REF_MEASUREMENT /end GROUP
/begin GROUP HwPwUp "MICROSAR RTE"
 /begin SUB_GROUP HwPwUp.ModeRequirePorts HwPwUp.ReceiverPorts HwPwUp.SenderPorts /end SUB_GROUP
 /begin FUNCTION_LIST /end FUNCTION_LIST
 /begin REF_CHARACTERISTIC /end REF_CHARACTERISTIC
 /begin REF_MEASUREMENT /end REF_MEASUREMENT
/end GROUP
/begin GROUP HwPwUp.ModeRequirePorts "MICROSAR RTE" /begin SUB_GROUP HwPwUp.SystemState.Mode /end SUB_GROUP /begin FUNCTION_LIST /end FUNCTION_LIST /begin REF_CHARACTERISTIC /end REF_CHARACTERISTIC /begin REF_MEASUREMENT /end REF_MEASUREMENT /end GROUP
/begin GROUP HwPwUp.MtrDrvrInitComplete.Cnt_lgc "MICROSAR RTE" /begin SUB_GROUP /end SUB_GROUP /begin FUNCTION_LIST /end FUNCTION_LIST /begin REF_CHARACTERISTIC /end REF_CHARACTERISTIC /begin REF_MEASUREMENT Rte_MtrDrvDiag_MtrDrvrInitComplete_Cnt_lgc /end REF_MEASUREMENT /end GROUP
/begin GROUP HwPwUp.MtrDrvrInitStart.Cnt_lgc "MICROSAR RTE" /begin SUB_GROUP /end SUB_GROUP /begin FUNCTION_LIST /end FUNCTION_LIST /begin REF_CHARACTERISTIC /end REF_CHARACTERISTIC /begin REF_MEASUREMENT Rte_HwPwUp_MtrDrvrInitStart_Cnt_lgc /end REF_MEASUREMENT /end GROUP
/begin GROUP HwPwUp.PwrDiscATestComplete.Cnt_lgc "MICROSAR RTE" /begin SUB_GROUP /end SUB_GROUP /begin FUNCTION_LIST /end FUNCTION_LIST /begin REF_CHARACTERISTIC /end REF_CHARACTERISTIC /end GROUP
/begin GROUP HwPwUp.PwrDiscATestStart.Cnt_lgc "MICROSAR RTE" /begin SUB_GROUP /end SUB_GROUP /begin FUNCTION_LIST /end FUNCTION_LIST /begin REF_CHARACTERISTIC /end REF_CHARACTERISTIC /end GROUP
/begin GROUP HwPwUp.PwrDiscBTestComplete.Cnt_lgc "MICROSAR RTE" /begin SUB_GROUP /end SUB_GROUP /begin FUNCTION_LIST /end FUNCTION_LIST /begin REF_CHARACTERISTIC /end REF_CHARACTERISTIC /end GROUP
/begin GROUP HwPwUp.PwrDiscBTestStart.Cnt_lgc "MICROSAR RTE" /begin SUB_GROUP /end SUB_GROUP /begin FUNCTION_LIST /end FUNCTION_LIST /begin REF_CHARACTERISTIC /end REF_CHARACTERISTIC /end GROUP
/begin GROUP HwPwUp.ReceiverPorts "MICROSAR RTE"
 /begin SUB_GROUP HwPwUp.MtrDrvrInitComplete.Cnt_lgc HwPwUp.PwrDiscATestComplete.Cnt_lgc HwPwUp.PwrDiscBTestComplete.Cnt_lgc HwPwUp.TMFTestComplete.Cnt_lgc /end SUB_GROUP
 /begin FUNCTION_LIST /end FUNCTION_LIST
 /begin REF_CHARACTERISTIC /end REF_CHARACTERISTIC
 /begin REF_MEASUREMENT /end REF_MEASUREMENT
/end GROUP
/begin GROUP HwPwUp.SenderPorts "MICROSAR RTE"
 /begin SUB_GROUP HwPwUp.MtrDrvrInitStart.Cnt_lgc HwPwUp.PwrDiscATestStart.Cnt_lgc HwPwUp.PwrDiscBTestStart.Cnt_lgc HwPwUp.TMFTestStart.Cnt_lgc /end SUB_GROUP
 /begin FUNCTION_LIST /end FUNCTION_LIST
 /begin REF_CHARACTERISTIC /end REF_CHARACTERISTIC
 /begin REF_MEASUREMENT /end REF_MEASUREMENT
/end GROUP
/begin GROUP HwPwUp.SystemState.Mode "MICROSAR RTE" /begin SUB_GROUP /end SUB_GROUP /begin FUNCTION_LIST /end FUNCTION_LIST /begin REF_CHARACTERISTIC /end REF_CHARACTERISTIC /end GROUP
/begin GROUP HwPwUp.TMFTestComplete.Cnt_lgc "MICROSAR RTE" /begin SUB_GROUP /end SUB_GROUP /begin FUNCTION_LIST /end FUNCTION_LIST /begin REF_CHARACTERISTIC /end REF_CHARACTERISTIC /begin REF_MEASUREMENT Rte_TmprlMon_TMFTestComplete_Cnt_lgc /end REF_MEASUREMENT /end GROUP
/begin GROUP HwPwUp.TMFTestStart.Cnt_lgc "MICROSAR RTE" /begin SUB_GROUP /end SUB_GROUP /begin FUNCTION_LIST /end FUNCTION_LIST /begin REF_CHARACTERISTIC /end REF_CHARACTERISTIC /begin REF_MEASUREMENT Rte_HwPwUp_TMFTestStart_Cnt_lgc /end REF_MEASUREMENT /end GROUP
/begin GROUP HystComp "MICROSAR RTE" /begin SUB_GROUP HystComp.ReceiverPorts HystComp.SenderPorts /end SUB_GROUP /begin FUNCTION_LIST /end FUNCTION_LIST /begin REF_CHARACTERISTIC /end REF_CHARACTERISTIC /begin REF_MEASUREMENT /end REF_MEASUREMENT /end GROUP
/begin GROUP HystComp.AssistMechTempEst.DegC_f32 "MICROSAR RTE" /begin SUB_GROUP /end SUB_GROUP /begin FUNCTION_LIST /end FUNCTION_LIST /begin REF_CHARACTERISTIC /end REF_CHARACTERISTIC /end GROUP
/begin GROUP IoHwAbstractionUsr.SysCVSwitchADC.Cnt_u16 "MICROSAR RTE" /begin REF_MEASUREMENT Rte_CDDInterface_SysCVSwitchADC_Cnt_u16 /end REF_MEASUREMENT /end GROUP
/begin GROUP IoHwAbstractionUsr.TemperatureADC.Volt_f32 "MICROSAR RTE" /begin REF_MEASUREMENT Rte_IoHwAbstractionUsr_TemperatureADC_Volt_f32 /end REF_MEASUREMENT /end GROUP
/begin GROUP LmtCod.AssistEOTGain.Uls_f32 "MICROSAR RTE" /begin REF_MEASUREMENT Rte_EOTActuatorMng_AssistEOTGain_Uls_f32 /end REF_MEASUREMENT /end GROUP
/begin GROUP LmtCod.AssistEOTLimit.MtrNm_f32 "MICROSAR RTE" /begin REF_MEASUREMENT Rte_EOTActuatorMng_AssistEOTLimit_MtrNm_f32 /end REF_MEASUREMENT /end GROUP
/begin GROUP LmtCod.AssistStallLimit.MtrNm_f32 "MICROSAR RTE" /begin REF_MEASUREMENT Rte_HiLoadStall_AssistStallLimit_MtrNm_f32 /end REF_MEASUREMENT /end GROUP
/begin GROUP LrnEOT.CCWFound.Cnt_lgc "MICROSAR RTE" /begin REF_MEASUREMENT Rte_LrnEOT_CCWFound_Cnt_lgc /end REF_MEASUREMENT /end GROUP
/begin GROUP LrnEOT.CCWPosition.HwDeg_f32 "MICROSAR RTE" /begin REF_MEASUREMENT Rte_LrnEOT_CCWPosition_HwDeg_f32 /end REF_MEASUREMENT /end GROUP
/begin GROUP LrnEOT.CWFound.Cnt_lgc "MICROSAR RTE" /begin REF_MEASUREMENT Rte_LrnEOT_CWFound_Cnt_lgc /end REF_MEASUREMENT /end GROUP
/begin GROUP LrnEOT.CWPosition.HwDeg_f32 "MICROSAR RTE" /begin REF_MEASUREMENT Rte_LrnEOT_CWPosition_HwDeg_f32 /end REF_MEASUREMENT /end GROUP
/begin GROUP LrnEOT.MtrVelCRF.MtrRadpS_f32 "MICROSAR RTE" /begin REF_MEASUREMENT Rte_MtrVel_MotorVelCRF_MtrRadpS_f32 /end REF_MEASUREMENT /end GROUP
/begin GROUP MtrDrvDiag.GateDriveResetActive.Cnt_lgc "MICROSAR RTE" /begin REF_MEASUREMENT Rte_MtrDrvDiag_GateDriveResetActive_Cnt_lgc /end REF_MEASUREMENT /end GROUP
/begin GROUP MtrDrvDiag.MtrDrvrInitComplete.Cnt_lgc "MICROSAR RTE" /begin REF_MEASUREMENT Rte_MtrDrvDiag_MtrDrvrInitComplete_Cnt_lgc /end REF_MEASUREMENT /end GROUP
/begin GROUP MtrDrvDiag.MtrDrvrInitStart.Cnt_lgc "MICROSAR RTE" /begin REF_MEASUREMENT Rte_HwPwUp_MtrDrvrInitStart_Cnt_lgc /end REF_MEASUREMENT /end GROUP
/begin GROUP MtrTempEst.CtrlTempFinal.DegC_f32 "MICROSAR RTE" /begin REF_MEASUREMENT Rte_CtrlTemp_FiltMeasTemp_DegC_f32 /end REF_MEASUREMENT /end GROUP
/begin GROUP MtrTempEst.CuTempEst.DegC_f32 "MICROSAR RTE" /begin REF_MEASUREMENT Rte_MtrTempEst_CuTempEst_DegC_f32 /end REF_MEASUREMENT /end GROUP
/begin GROUP MtrTempEst.MagTempEst.DegC_f32 "MICROSAR RTE" /begin REF_MEASUREMENT Rte_MtrTempEst_MagTempEst_DegC_f32 /end REF_MEASUREMENT /end GROUP
/begin GROUP MtrTempEst.SiTempEst.DegC_f32 "MICROSAR RTE" /begin REF_MEASUREMENT Rte_MtrTempEst_SiTempEst_DegC_f32 /end REF_MEASUREMENT /end GROUP
/begin GROUP MtrVel.AsstAssemblyPolarity.Cnt_s08 "MICROSAR RTE" /begin REF_MEASUREMENT Rte_Polarity_AssistAssyPolarity_Cnt_s08 /end REF_MEASUREMENT /end GROUP
/begin GROUP MtrVel.MechMtrPos2.Rev_u0p16 "MICROSAR RTE" /begin REF_MEASUREMENT Rte_DigMSB_MechMtrPos2_Rev_u0p16 /end REF_MEASUREMENT /end GROUP
/begin GROUP MtrVel.MotorVelCRF.MtrRadpS_f32 "MICROSAR RTE" /begin REF_MEASUREMENT Rte_MtrVel_MotorVelCRF_MtrRadpS_f32 /end REF_MEASUREMENT /end GROUP
/begin GROUP MtrVel2.AsstAssemblyPolarity.Cnt_s08 "MICROSAR RTE" /begin REF_MEASUREMENT Rte_Polarity_AssistAssyPolarity_Cnt_s08 /end REF_MEASUREMENT /end GROUP
/begin GROUP MtrVel2.CumMechMtrPosMRF.Deg_f32 "MICROSAR RTE" /begin REF_MEASUREMENT Rte_DigMSB_CumMechMtrPosMRF_Deg_f32 /end REF_MEASUREMENT /end GROUP
/begin GROUP Nhet1.DigHwTrqT1.HwNm_f32 "MICROSAR RTE" /begin REF_MEASUREMENT Rte_Nhet1_DigHwTrqT1_HwNm_f32 /end REF_MEASUREMENT /end GROUP
/begin GROUP Nhet1.DigHwTrqT2.HwNm_f32 "MICROSAR RTE" /begin REF_MEASUREMENT Rte_Nhet1_DigHwTrqT2_HwNm_f32 /end REF_MEASUREMENT /end GROUP
/begin GROUP PICurrCntrl.EstKe.VpRadpS_f32 "MICROSAR RTE" /begin REF_MEASUREMENT Rte_CurrParamComp_EstKe_VpRadpS_f32 /end REF_MEASUREMENT /end GROUP
/begin GROUP PICurrCntrl.EstR.Ohm_f32 "MICROSAR RTE" /begin REF_MEASUREMENT Rte_CurrParamComp_EstR_Ohm_f32 /end REF_MEASUREMENT /end GROUP
/begin GROUP PICurrCntrl.MtrCurrDaxRef.Amp_f32 "MICROSAR RTE" /begin REF_MEASUREMENT Rte_CurrCmd_MtrCurrDaxRef_Amp_f32 /end REF_MEASUREMENT /end GROUP
/begin GROUP PeakCurrEst.MtrCurrDaxRef.Amp_f32 "MICROSAR RTE" /begin REF_MEASUREMENT Rte_CurrCmd_MtrCurrDaxRef_Amp_f32 /end REF_MEASUREMENT /end GROUP
/begin GROUP PeakCurrEst.MtrCurrQaxRef.Amp_f32 "MICROSAR RTE" /begin REF_MEASUREMENT Rte_CurrCmd_MtrCurrQaxRef_Amp_f32 /end REF_MEASUREMENT /end GROUP
/begin GROUP Polarity.AssistAssyPolarity.Cnt_s08 "MICROSAR RTE" /begin REF_MEASUREMENT Rte_Polarity_AssistAssyPolarity_Cnt_s08 /end REF_MEASUREMENT /end GROUP
/begin GROUP Polarity.DiagAssistAssyPolarity.Cnt_s08 "MICROSAR RTE" /begin REF_MEASUREMENT Rte_Polarity_AssistAssyPolarity_Cnt_s08 /end REF_MEASUREMENT /end GROUP
/begin GROUP Polarity.SysC_MtrElecMechPolarity.Cnt_s32 "MICROSAR RTE" /begin REF_MEASUREMENT Rte_Polarity_SysC_MtrElecMechPolarity_Cnt_s32 /end REF_MEASUREMENT /end GROUP
/begin GROUP PwrLmtFuncCr.CntDisMtrTrqCmdMRF.MtrNm_f32 "MICROSAR RTE" /begin REF_MEASUREMENT Rte_CtrldDisShtdn_CntDisMtrTrqCmdMRF_MtrNm_f32 /end REF_MEASUREMENT /end GROUP
/begin GROUP PwrLmtFuncCr.EstKe.VpRadpS_f32 "MICROSAR RTE" /begin REF_MEASUREMENT Rte_CurrParamComp_EstKe_VpRadpS_f32 /end REF_MEASUREMENT /end GROUP
/begin GROUP QuadDet.MRFCumMtrPos.Deg_f32 "MICROSAR RTE" /begin REF_MEASUREMENT Rte_DigMSB_CumMechMtrPosMRF_Deg_f32 /end REF_MEASUREMENT /end GROUP
/begin GROUP QuadDet.MRFMtrTrqCmdScl.MtrNm_f32 "MICROSAR RTE" /begin REF_MEASUREMENT Rte_TrqCmdScl_MRFMtrTrqCmdScl_MtrNm_f32 /end REF_MEASUREMENT /end GROUP
/begin GROUP QuadDet.MtrQuad.Cnt_u08 "MICROSAR RTE" /begin REF_MEASUREMENT Rte_QuadDet_MtrQuad_Cnt_u08 /end REF_MEASUREMENT /end GROUP
/begin GROUP RteErrata8.SystemState.Mode "MICROSAR RTE" /begin REF_MEASUREMENT Rte_ModeMachine_StaMd8_SystemState8_Mode /end REF_MEASUREMENT /end GROUP
/begin GROUP SrlComInput.DefaultVehSpd.Cnt_lgc "MICROSAR RTE" /begin REF_MEASUREMENT Rte_DiagMgr10_DiagStsDefVehSpd_Cnt_lgc /end REF_MEASUREMENT /end GROUP
/begin GROUP SrlComInput.IgnitionPreStart.Cnt_lgc "MICROSAR RTE" /begin REF_MEASUREMENT Rte_DiagSvc_IgnitionPreStart_Cnt_lgc /end REF_MEASUREMENT /end GROUP
/begin GROUP SrlComOutput.SrlComHwTrq.HwNm_f32 "MICROSAR RTE" /begin REF_MEASUREMENT Rte_DigHwTrqSENT_SrlComHwTrq_HwNm_f32 /end REF_MEASUREMENT /end GROUP
/begin GROUP SrlComOutput.SrlComHwTrqValid.Cnt_lgc "MICROSAR RTE" /begin REF_MEASUREMENT Rte_DigHwTrqSENT_SrlComHwTrqValid_Cnt_lgc /end REF_MEASUREMENT /end GROUP
/begin GROUP SrlComOutput.SupplyCurrent.Amp_f32 "MICROSAR RTE" /begin REF_MEASUREMENT Rte_ElePwr_SupplyCurrent_Amp_f32 /end REF_MEASUREMENT /end GROUP
/begin GROUP StOpCtrl.DiagRampRate.XpmS_f32 "MICROSAR RTE" /begin REF_MEASUREMENT Rte_DiagMgr10_DiagRampRate_XpmS_f32 /end REF_MEASUREMENT /end GROUP
/begin GROUP StOpCtrl.DiagRampValue.Uls_f32 "MICROSAR RTE" /begin REF_MEASUREMENT Rte_DiagMgr10_DiagRampValue_Uls_f32 /end REF_MEASUREMENT /end GROUP
/begin GROUP StOpCtrl.DiagStsDiagRmpActive.Cnt_lgc "MICROSAR RTE" /begin REF_MEASUREMENT Rte_DiagMgr10_DiagRmpToZeroActive_Cnt_lgc /end REF_MEASUREMENT /end GROUP
/begin GROUP StOpCtrl.RampSrlComSvcDft.Cnt_lgc "MICROSAR RTE" /begin REF_MEASUREMENT Rte_CDDInterface_TrqRmpSrlComSvcDft_Cnt_lgc /end REF_MEASUREMENT /end GROUP
/begin GROUP StaMd.ControlledDampStatusComplete.Cnt_lgc "MICROSAR RTE" /begin REF_MEASUREMENT Rte_CtrldDisShtdn_CtrldDmpStsCmp_Cnt_lgc /end REF_MEASUREMENT /end GROUP
/begin GROUP StaMd.FTerm.Cnt_lgc "MICROSAR RTE" /begin REF_MEASUREMENT Rte_DiagMgr10_DiagRmpToZeroActive_Cnt_lgc /end REF_MEASUREMENT /end GROUP
/begin GROUP StaMd.TMFTestComplete.Cnt_lgc "MICROSAR RTE" /begin REF_MEASUREMENT Rte_TmprlMon_TMFTestComplete_Cnt_lgc /end REF_MEASUREMENT /end GROUP
/begin GROUP StaMd8.ControlledDampStatusComplete.Cnt_lgc "MICROSAR RTE" /begin REF_MEASUREMENT Rte_CtrldDisShtdn_CtrldDmpStsCmp_Cnt_lgc /end REF_MEASUREMENT /end GROUP
/begin GROUP StaMd8.FTerm.Cnt_lgc "MICROSAR RTE" /begin REF_MEASUREMENT Rte_DiagMgr10_DiagRmpToZeroActive_Cnt_lgc /end REF_MEASUREMENT /end GROUP
/begin GROUP StaMd8.SystemState8.Mode "MICROSAR RTE" /begin REF_MEASUREMENT Rte_ModeMachine_StaMd8_SystemState8_Mode /end REF_MEASUREMENT /end GROUP
/begin GROUP StaMd8.TMFTestComplete.Cnt_lgc "MICROSAR RTE" /begin REF_MEASUREMENT Rte_TmprlMon_TMFTestComplete_Cnt_lgc /end REF_MEASUREMENT /end GROUP
/begin GROUP Sweep.InputHwTrq.HwNm_f32 "MICROSAR RTE" /begin REF_MEASUREMENT Rte_DigHwTrqSENT_HwTorque_HwNm_f32 /end REF_MEASUREMENT /end GROUP
/begin GROUP Sweep2.OutputMtrTrq.MtrNm_f32 "MICROSAR RTE" /begin REF_MEASUREMENT Rte_Sweep2_OutputMtrTrq_MtrNm_f32 /end REF_MEASUREMENT /end GROUP
/begin GROUP ThrmlDutyCycle.CuTempEst.DegC_f32 "MICROSAR RTE" /begin REF_MEASUREMENT Rte_MtrTempEst_CuTempEst_DegC_f32 /end REF_MEASUREMENT /end GROUP
/begin GROUP ThrmlDutyCycle.DefeatDutySvc.Cnt_lgc "MICROSAR RTE" /begin REF_MEASUREMENT Rte_CDDInterface_ThermalDCSrlComSvcDft_Cnt_lgc /end REF_MEASUREMENT /end GROUP
/begin GROUP ThrmlDutyCycle.FiltMeasTemp.DegC_f32 "MICROSAR RTE" /begin REF_MEASUREMENT Rte_CtrlTemp_FiltMeasTemp_DegC_f32 /end REF_MEASUREMENT /end GROUP
/begin GROUP ThrmlDutyCycle.MagTempEst.DegC_f32 "MICROSAR RTE" /begin REF_MEASUREMENT Rte_MtrTempEst_MagTempEst_DegC_f32 /end REF_MEASUREMENT /end GROUP
/begin GROUP ThrmlDutyCycle.MotorVelCRF.MtrRadpS_f32 "MICROSAR RTE" /begin REF_MEASUREMENT Rte_MtrVel_MotorVelCRF_MtrRadpS_f32 /end REF_MEASUREMENT /end GROUP
/begin GROUP ThrmlDutyCycle.SiTempEst.DegC_f32 "MICROSAR RTE" /begin REF_MEASUREMENT Rte_MtrTempEst_SiTempEst_DegC_f32 /end REF_MEASUREMENT /end GROUP
/begin GROUP TmprlMon.TMFTestComplete.Cnt_lgc "MICROSAR RTE" /begin REF_MEASUREMENT Rte_TmprlMon_TMFTestComplete_Cnt_lgc /end REF_MEASUREMENT /end GROUP
/begin GROUP TmprlMon.TMFTestStart.Cnt_lgc "MICROSAR RTE" /begin REF_MEASUREMENT Rte_HwPwUp_TMFTestStart_Cnt_lgc /end REF_MEASUREMENT /end GROUP
/begin GROUP TrqCanc.EstKe.VpRadpS_f32 "MICROSAR RTE" /begin REF_MEASUREMENT Rte_CurrParamComp_EstKe_VpRadpS_f32 /end REF_MEASUREMENT /end GROUP
/begin GROUP TrqCanc.EstLd.Henry_f32 "MICROSAR RTE" /begin REF_MEASUREMENT Rte_CurrParamComp_EstLd_Henry_f32 /end REF_MEASUREMENT /end GROUP
/begin GROUP TrqCanc.EstLq.Henry_f32 "MICROSAR RTE" /begin REF_MEASUREMENT Rte_CurrParamComp_EstLq_Henry_f32 /end REF_MEASUREMENT /end GROUP
/begin GROUP TrqCanc.MtrCurrDaxRef.Amp_f32 "MICROSAR RTE" /begin REF_MEASUREMENT Rte_CurrCmd_MtrCurrDaxRef_Amp_f32 /end REF_MEASUREMENT /end GROUP
/begin GROUP TrqCanc.MtrCurrQaxRef.Amp_f32 "MICROSAR RTE" /begin REF_MEASUREMENT Rte_CurrCmd_MtrCurrQaxRef_Amp_f32 /end REF_MEASUREMENT /end GROUP
/begin GROUP TrqCanc.MtrTrqCmdMRFScl.MtrNm_f32 "MICROSAR RTE" /begin REF_MEASUREMENT Rte_TrqCmdScl_MRFMtrTrqCmdScl_MtrNm_f32 /end REF_MEASUREMENT /end GROUP
/begin GROUP TrqCmdScl.MRFMtrTrqCmdScl.MtrNm_f32 "MICROSAR RTE" /begin REF_MEASUREMENT Rte_TrqCmdScl_MRFMtrTrqCmdScl_MtrNm_f32 /end REF_MEASUREMENT /end GROUP
/begin GROUP VehDyn.CcwEOT.HwDeg_f32 "MICROSAR RTE" /begin REF_MEASUREMENT Rte_LrnEOT_CCWPosition_HwDeg_f32 /end REF_MEASUREMENT /end GROUP
/begin GROUP VehDyn.CwEOT.HwDeg_f32 "MICROSAR RTE" /begin REF_MEASUREMENT Rte_LrnEOT_CWPosition_HwDeg_f32 /end REF_MEASUREMENT /end GROUP
/begin GROUP VehDyn.MotorVelCRF.MtrRadpS_f32 "MICROSAR RTE" /begin REF_MEASUREMENT Rte_MtrVel_MotorVelCRF_MtrRadpS_f32 /end REF_MEASUREMENT /end GROUP
/begin GROUP VehSpdLmt.CCWPosition.HwDeg_f32 "MICROSAR RTE" /begin REF_MEASUREMENT Rte_LrnEOT_CCWPosition_HwDeg_f32 /end REF_MEASUREMENT /end GROUP
/begin GROUP VehSpdLmt.CWPosition.HwDeg_f32 "MICROSAR RTE" /begin REF_MEASUREMENT Rte_LrnEOT_CWPosition_HwDeg_f32 /end REF_MEASUREMENT /end GROUP
/begin GROUP ePWM2.CtrldDmpStsCmp.Cnt_lgc "MICROSAR RTE" /begin REF_MEASUREMENT Rte_CtrldDisShtdn_CtrldDmpStsCmp_Cnt_lgc /end REF_MEASUREMENT /end GROUP
/begin GROUP ePWM2.DiagStsCtrldDisRmpPres.Cnt_lgc "MICROSAR RTE" /begin REF_MEASUREMENT Rte_DiagMgr10_DiagStsCtrldDisRmpPres_Cnt_lgc /end REF_MEASUREMENT /end GROUP
/begin GROUP ePWM2.DiagStsNonRecRmpToZeroFltPres.Cnt_lgc "MICROSAR RTE" /begin REF_MEASUREMENT Rte_DiagMgr10_DiagStsNonRecRmpToZeroFltPres_Cnt_lgc /end REF_MEASUREMENT /end GROUP
/begin RECORD_LAYOUT RTE_RL_ULONG FNC_VALUES 1 ULONG ROW_DIR DIRECT /end RECORD_LAYOUT
/begin RECORD_LAYOUT RTE_RL_SBYTE FNC_VALUES 1 SBYTE ROW_DIR DIRECT /end RECORD_LAYOUT
/begin RECORD_LAYOUT RTE_RL_SWORD FNC_VALUES 1 SWORD ROW_DIR DIRECT /end RECORD_LAYOUT
/**********************************************************************************************************************
* COMPU_METHOD / COMPU_VTAB_RANGE
*********************************************************************************************************************/
/begin COMPU_METHOD RTE_CM_BOOLEAN "" TAB_VERB "%3.1" "" COMPU_TAB_REF RTE_CM_BOOLEAN /end COMPU_METHOD
/begin COMPU_VTAB_RANGE RTE_CM_BOOLEAN "" 2 0 0 "false" 1 255 "true" /end COMPU_VTAB_RANGE
/begin COMPU_METHOD RTE_CM_ENUM_StaMd_Mode "" TAB_VERB "%.1" "" COMPU_TAB_REF RTE_CM_ENUM_StaMd_Mode /end COMPU_METHOD
/begin COMPU_VTAB_RANGE RTE_CM_ENUM_StaMd_Mode "" 5 0 0 "RTE_MODE_StaMd_Mode_DISABLE" 1 1 "RTE_MODE_StaMd_Mode_OFF" 2 2 "RTE_MODE_StaMd_Mode_OPERATE" 3 3 "RTE_MODE_StaMd_Mode_WARMINIT" 4 4 "RTE_TRANSITION_StaMd_Mode" /end COMPU_VTAB_RANGE
