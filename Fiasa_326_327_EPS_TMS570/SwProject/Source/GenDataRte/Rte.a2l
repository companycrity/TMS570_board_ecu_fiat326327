/begin MEASUREMENT Rte_HystComp_WIRCmdAmpBlnd_MtrNm_f32 "MICROSAR RTE" FLOAT32_IEEE NO_COMPU_METHOD 0 0 1.175494351e-38 3.402823466e+38 ECU_ADDRESS 0 /end MEASUREMENT
/begin MEASUREMENT Rte_VehSpdLmt_AstVehSpdLimit_MtrNm_f32 "MICROSAR RTE" FLOAT32_IEEE NO_COMPU_METHOD 0 0 1.175494351e-38 3.402823466e+38 ECU_ADDRESS 0 /end MEASUREMENT
/begin MEASUREMENT Rte_LmtCod_CCLTrqRamp_Uls_f32 "MICROSAR RTE" FLOAT32_IEEE NO_COMPU_METHOD 0 0 1.175494351e-38 3.402823466e+38 ECU_ADDRESS 0 /end MEASUREMENT
/begin MEASUREMENT Rte_StOpCtrl_OutputRampMult_Uls_f32 "MICROSAR RTE" FLOAT32_IEEE NO_COMPU_METHOD 0 0 1.175494351e-38 3.402823466e+38 ECU_ADDRESS 0 /end MEASUREMENT
/begin MEASUREMENT Rte_ThrmlDutyCycle_ThermalLimit_MtrNm_f32 "MICROSAR RTE" FLOAT32_IEEE NO_COMPU_METHOD 0 0 1.175494351e-38 3.402823466e+38 ECU_ADDRESS 0 /end MEASUREMENT
/begin MEASUREMENT Rte_LrnEOT_LearnedEOT.CCWEOTFound_Cnt_lgc "MICROSAR RTE" UBYTE RTE_CM_BOOLEAN 0 0 0 255 ECU_ADDRESS 0 READ_WRITE /end MEASUREMENT
/begin MEASUREMENT Rte_LrnEOT_LearnedEOT.CCWEOTPosition_HwDeg_f32 "MICROSAR RTE" FLOAT32_IEEE NO_COMPU_METHOD 0 0 1.175494351e-38 3.402823466e+38 ECU_ADDRESS 0 READ_WRITE /end MEASUREMENT
/begin MEASUREMENT Rte_LrnEOT_LearnedEOT.CWEOTFound_Cnt_lgc "MICROSAR RTE" UBYTE RTE_CM_BOOLEAN 0 0 0 255 ECU_ADDRESS 0 READ_WRITE /end MEASUREMENT
/begin MEASUREMENT Rte_LrnEOT_LearnedEOT.CWEOTPosition_HwDeg_f32 "MICROSAR RTE" FLOAT32_IEEE NO_COMPU_METHOD 0 0 1.175494351e-38 3.402823466e+38 ECU_ADDRESS 0 READ_WRITE /end MEASUREMENT
/begin MEASUREMENT Rte_MtrDrvDiag_FETFaultPhase_Cnt_enum "MICROSAR RTE" UBYTE RTE_CM_ENUM_FETPHASETYPE_ENUM 0 0 0 255 ECU_ADDRESS 0 /end MEASUREMENT
/begin MEASUREMENT Rte_MtrDrvDiag_FETFaultType_Cnt_enum "MICROSAR RTE" UBYTE RTE_CM_ENUM_FETFAULTTYPE_ENUM 0 0 0 255 ECU_ADDRESS 0 /end MEASUREMENT
/begin MEASUREMENT Rte_MtrTempEst_AmbTemp_DegC_f32 "MICROSAR RTE" FLOAT32_IEEE NO_COMPU_METHOD 0 0 1.175494351e-38 3.402823466e+38 ECU_ADDRESS 0 /end MEASUREMENT
/begin MEASUREMENT Rte_MtrTempEst_EngTemp_DegC_f32 "MICROSAR RTE" FLOAT32_IEEE NO_COMPU_METHOD 0 0 1.175494351e-38 3.402823466e+38 ECU_ADDRESS 0 /end MEASUREMENT
/begin MEASUREMENT Rte_PeakCurrEst_EstPkCurr_AmpSq_f32 "MICROSAR RTE" FLOAT32_IEEE NO_COMPU_METHOD 0 0 1.175494351e-38 3.402823466e+38 ECU_ADDRESS 0 /end MEASUREMENT
/begin MEASUREMENT Rte_MtrTempEst_ScomAMDefeat_Cnt_lgc "MICROSAR RTE" UBYTE RTE_CM_BOOLEAN 0 0 0 255 ECU_ADDRESS 0 /end MEASUREMENT
/begin MEASUREMENT Rte_MtrTempEst_ScomTempDataRcvd_Cnt_lgc "MICROSAR RTE" UBYTE RTE_CM_BOOLEAN 0 0 0 255 ECU_ADDRESS 0 /end MEASUREMENT
/begin MEASUREMENT Rte_MtrVel_HwVelValid_Cnt_lgc "MICROSAR RTE" UBYTE RTE_CM_BOOLEAN 0 0 0 255 ECU_ADDRESS 0 /end MEASUREMENT
/begin MEASUREMENT Rte_MtrVel2_SysCDiagHwVel_HwRadpS_f32 "MICROSAR RTE" FLOAT32_IEEE NO_COMPU_METHOD 0 0 1.175494351e-38 3.402823466e+38 ECU_ADDRESS 0 /end MEASUREMENT
/begin MEASUREMENT Rte_MtrVel2_SysCDiagMtrVelMRF_MtrRadpS_f32 "MICROSAR RTE" FLOAT32_IEEE NO_COMPU_METHOD 0 0 1.175494351e-38 3.402823466e+38 ECU_ADDRESS 0 /end MEASUREMENT
/begin MEASUREMENT Rte_MtrVel_SysCHandwheelVel_HwRadpS_f32 "MICROSAR RTE" FLOAT32_IEEE NO_COMPU_METHOD 0 0 1.175494351e-38 3.402823466e+38 ECU_ADDRESS 0 /end MEASUREMENT
/begin MEASUREMENT Rte_MtrVel_SysCMotorVelMRF_MtrRadpS_f32 "MICROSAR RTE" FLOAT32_IEEE NO_COMPU_METHOD 0 0 1.175494351e-38 3.402823466e+38 ECU_ADDRESS 0 /end MEASUREMENT
/begin MEASUREMENT Rte_PICurrCntrl_DervLambdaAlphaDiag_Volt_f32 "This signal is intended to communicate any type voltage signal measured by the ecu.  This signal has a lower limit of 0 which reequires users of the signal to provide divide by 0 protection if it is used as a denominator in a calculation.  See Vecu port p" FLOAT32_IEEE NO_COMPU_METHOD 0 0 1.175494351e-38 3.402823466e+38 ECU_ADDRESS 0 /end MEASUREMENT
/begin MEASUREMENT Rte_PICurrCntrl_DervLambdaBetaDiag_Volt_f32 "This signal is intended to communicate any type voltage signal measured by the ecu.  This signal has a lower limit of 0 which reequires users of the signal to provide divide by 0 protection if it is used as a denominator in a calculation.  See Vecu port p" FLOAT32_IEEE NO_COMPU_METHOD 0 0 1.175494351e-38 3.402823466e+38 ECU_ADDRESS 0 /end MEASUREMENT
/begin MEASUREMENT Rte_PeakCurrEst_FiltEstPkCurr_AmpSq_f32 "MICROSAR RTE" FLOAT32_IEEE NO_COMPU_METHOD 0 0 1.175494351e-38 3.402823466e+38 ECU_ADDRESS 0 /end MEASUREMENT
/begin MEASUREMENT Rte_PeakCurrEst_IvtrLoaMtgtnEn_Cnt_lgc "MICROSAR RTE" UBYTE RTE_CM_BOOLEAN 0 0 0 255 ECU_ADDRESS 0 /end MEASUREMENT
/begin MEASUREMENT Rte_PeakCurrEst_MotCurrLoaMtgtnEn_Cnt_lgc "MICROSAR RTE" UBYTE RTE_CM_BOOLEAN 0 0 0 255 ECU_ADDRESS 0 /end MEASUREMENT
/begin MEASUREMENT Rte_Polarity_HwPosPolarity_Cnt_s08 "MICROSAR RTE" SBYTE NO_COMPU_METHOD 0 0 -128 127 ECU_ADDRESS 0 /end MEASUREMENT
/begin MEASUREMENT Rte_Polarity_HwTrqPolarity_Cnt_s08 "MICROSAR RTE" SBYTE NO_COMPU_METHOD 0 0 -128 127 ECU_ADDRESS 0 /end MEASUREMENT
/begin MEASUREMENT Rte_Polarity_MtrVelPolarity_Cnt_s08 "MICROSAR RTE" SBYTE NO_COMPU_METHOD 0 0 -128 127 ECU_ADDRESS 0 /end MEASUREMENT
/begin MEASUREMENT Rte_Polarity_Polarity_Cnt_Str.Polarity_Cnt_b08 "MICROSAR RTE" UBYTE NO_COMPU_METHOD 0 0 0 255 ECU_ADDRESS 0 READ_WRITE /end MEASUREMENT
/begin MEASUREMENT Rte_Polarity_Polarity_Cnt_Str.R_Polarity_Cnt_b08 "MICROSAR RTE" UBYTE NO_COMPU_METHOD 0 0 0 255 ECU_ADDRESS 0 READ_WRITE /end MEASUREMENT
/begin MEASUREMENT Rte_PwrLmtFuncCr_MRFMtrTrqCmd_MtrNm_f32 "MICROSAR RTE" FLOAT32_IEEE NO_COMPU_METHOD 0 0 1.175494351e-38 3.402823466e+38 ECU_ADDRESS 0 /end MEASUREMENT
/begin MEASUREMENT Rte_PwrLmtFuncCr_PosServEnable_Cnt_lgc "MICROSAR RTE" UBYTE RTE_CM_BOOLEAN 0 0 0 255 ECU_ADDRESS 0 /end MEASUREMENT
/begin MEASUREMENT Rte_PwrLmtFuncCr_ThresholdExceeded_Cnt_lgc "MICROSAR RTE" UBYTE RTE_CM_BOOLEAN 0 0 0 255 ECU_ADDRESS 0 /end MEASUREMENT
/begin MEASUREMENT Rte_QuadDet_InstMtrDir_Cnt_s08 "MICROSAR RTE" SBYTE NO_COMPU_METHOD 0 0 -128 127 ECU_ADDRESS 0 /end MEASUREMENT
/begin MEASUREMENT Rte_Return_PAReturnSclFct_Uls_f32 "MICROSAR RTE" FLOAT32_IEEE NO_COMPU_METHOD 0 0 1.175494351e-38 3.402823466e+38 ECU_ADDRESS 0 /end MEASUREMENT
/begin MEASUREMENT Rte_Return_ReturnCmd_MtrNm_f32 "MICROSAR RTE" FLOAT32_IEEE NO_COMPU_METHOD 0 0 1.175494351e-38 3.402823466e+38 ECU_ADDRESS 0 /end MEASUREMENT
/begin MEASUREMENT Rte_Return_ReturnDDFactor_Uls_f32 "MICROSAR RTE" FLOAT32_IEEE NO_COMPU_METHOD 0 0 1.175494351e-38 3.402823466e+38 ECU_ADDRESS 0 /end MEASUREMENT
/begin MEASUREMENT Rte_Return_ReturnOffset_HwDeg_f32 "MICROSAR RTE" FLOAT32_IEEE NO_COMPU_METHOD 0 0 1.175494351e-38 3.402823466e+38 ECU_ADDRESS 0 /end MEASUREMENT
/begin MEASUREMENT Rte_Sa_DigColPs_DigColPsEOL.ColTrim_Deg_f32 "MICROSAR RTE" FLOAT32_IEEE NO_COMPU_METHOD 0 0 1.175494351e-38 3.402823466e+38 ECU_ADDRESS 0 READ_WRITE /end MEASUREMENT
/begin MEASUREMENT Rte_Sa_DigColPs_DigColPsEOL.R_ColTrim_Cnt_u32 "MICROSAR RTE" ULONG NO_COMPU_METHOD 0 0 0 4294967295 ECU_ADDRESS 0 READ_WRITE /end MEASUREMENT
/begin MEASUREMENT Rte_Sa_DigColPs_DigColPsEOL.R_SpurTrim_Cnt_u32 "MICROSAR RTE" ULONG NO_COMPU_METHOD 0 0 0 4294967295 ECU_ADDRESS 0 READ_WRITE /end MEASUREMENT
/begin MEASUREMENT Rte_Sa_DigColPs_DigColPsEOL.R_TrimCom_Cnt_u16 "MICROSAR RTE" UWORD NO_COMPU_METHOD 0 0 0 65535 ECU_ADDRESS 0 READ_WRITE /end MEASUREMENT
/begin MEASUREMENT Rte_Sa_DigColPs_DigColPsEOL.SpurTrim_Deg_f32 "MICROSAR RTE" FLOAT32_IEEE NO_COMPU_METHOD 0 0 1.175494351e-38 3.402823466e+38 ECU_ADDRESS 0 READ_WRITE /end MEASUREMENT
/begin MEASUREMENT Rte_Sa_DigColPs_DigColPsEOL.TrimComp_Cnt_u16 "MICROSAR RTE" UWORD NO_COMPU_METHOD 0 0 0 65535 ECU_ADDRESS 0 READ_WRITE /end MEASUREMENT
/begin MEASUREMENT Rte_Sa_DigColPs_TrimComp_Cnt_lgc "MICROSAR RTE" UBYTE RTE_CM_BOOLEAN 0 0 0 255 ECU_ADDRESS 0 /end MEASUREMENT
/begin MEASUREMENT Rte_SrlComInput_SrlComVehSpd_Kph_f32 "MICROSAR RTE" FLOAT32_IEEE NO_COMPU_METHOD 0 0 1.175494351e-38 3.402823466e+38 ECU_ADDRESS 0 /end MEASUREMENT
/begin MEASUREMENT Rte_SignlCondn_SrlCom_VehicleLonAccel_KphpS_f32 "MICROSAR RTE" FLOAT32_IEEE NO_COMPU_METHOD 0 0 1.175494351e-38 3.402823466e+38 ECU_ADDRESS 0 /end MEASUREMENT
/begin MEASUREMENT Rte_SignlCondn_Vehicle_LonAccel_KphpS_f32 "MICROSAR RTE" FLOAT32_IEEE NO_COMPU_METHOD 0 0 1.175494351e-38 3.402823466e+38 ECU_ADDRESS 0 /end MEASUREMENT
/begin MEASUREMENT Rte_SrlComInput_DesiredTunPers_Cnt_u16 "MICROSAR RTE" UWORD NO_COMPU_METHOD 0 0 0 65535 ECU_ADDRESS 0 /end MEASUREMENT
/begin MEASUREMENT Rte_VehPwrMd_OperRampRate_XpmS_f32 "MICROSAR RTE" FLOAT32_IEEE NO_COMPU_METHOD 0 0 1.175494351e-38 3.402823466e+38 ECU_ADDRESS 0 /end MEASUREMENT
/begin MEASUREMENT Rte_VehPwrMd_OperRampValue_Uls_f32 "MICROSAR RTE" FLOAT32_IEEE NO_COMPU_METHOD 0 0 1.175494351e-38 3.402823466e+38 ECU_ADDRESS 0 /end MEASUREMENT
/begin MEASUREMENT Rte_StOpCtrl_RampDwnStatusComplete_Cnt_lgc "MICROSAR RTE" UBYTE RTE_CM_BOOLEAN 0 0 0 255 ECU_ADDRESS 0 /end MEASUREMENT
/begin MEASUREMENT Rte_VehPwrMd_ATermActive_Cnt_lgc "MICROSAR RTE" UBYTE RTE_CM_BOOLEAN 0 0 0 255 ECU_ADDRESS 0 /end MEASUREMENT
/begin MEASUREMENT Rte_VehPwrMd_CTermActive_Cnt_lgc "MICROSAR RTE" UBYTE RTE_CM_BOOLEAN 0 0 0 255 ECU_ADDRESS 0 /end MEASUREMENT
/begin MEASUREMENT Rte_StaMd_InitiatePwrDnFastWrite_Cnt_lgc "MICROSAR RTE" UBYTE RTE_CM_BOOLEAN 0 0 0 255 ECU_ADDRESS 0 /end MEASUREMENT
/begin MEASUREMENT Rte_StaMd_InitiatePwrDnNormalWrite_Cnt_lgc "MICROSAR RTE" UBYTE RTE_CM_BOOLEAN 0 0 0 255 ECU_ADDRESS 0 /end MEASUREMENT
/begin MEASUREMENT Rte_StaMd_PwrDnFastWriteComplete_Cnt_lgc "MICROSAR RTE" UBYTE RTE_CM_BOOLEAN 0 0 0 255 ECU_ADDRESS 0 /end MEASUREMENT
/begin MEASUREMENT Rte_StabilityComp_AssistDDFactor_Uls_f32 "MICROSAR RTE" FLOAT32_IEEE NO_COMPU_METHOD 0 0 1.175494351e-38 3.402823466e+38 ECU_ADDRESS 0 /end MEASUREMENT
/begin MEASUREMENT Rte_StabilityComp2_SysAssistCmd_MtrNm_f32 "MICROSAR RTE" FLOAT32_IEEE NO_COMPU_METHOD 0 0 1.175494351e-38 3.402823466e+38 ECU_ADDRESS 0 /end MEASUREMENT
/begin MEASUREMENT Rte_StabilityComp2_AssistDDFactor_Uls_f32 "MICROSAR RTE" FLOAT32_IEEE NO_COMPU_METHOD 0 0 1.175494351e-38 3.402823466e+38 ECU_ADDRESS 0 /end MEASUREMENT
/begin MEASUREMENT Rte_ThrmlDutyCycle_IgnTimeOff_Cnt_u32 "MICROSAR RTE" ULONG NO_COMPU_METHOD 0 0 0 4294967295 ECU_ADDRESS 0 /end MEASUREMENT
/begin MEASUREMENT Rte_ThrmlDutyCycle_ThrmlDutyCycle_FltStVal.Filt3Val_Cnt_u8 "MICROSAR RTE" UBYTE NO_COMPU_METHOD 0 0 0 255 ECU_ADDRESS 0 READ_WRITE /end MEASUREMENT
/begin MEASUREMENT Rte_ThrmlDutyCycle_ThrmlDutyCycle_FltStVal.Filt4Val_Cnt_u8 "MICROSAR RTE" UBYTE NO_COMPU_METHOD 0 0 0 255 ECU_ADDRESS 0 READ_WRITE /end MEASUREMENT
/begin MEASUREMENT Rte_ThrmlDutyCycle_ThrmlDutyCycle_FltStVal.Filt5Val_Cnt_u8 "MICROSAR RTE" UBYTE NO_COMPU_METHOD 0 0 0 255 ECU_ADDRESS 0 READ_WRITE /end MEASUREMENT
/begin MEASUREMENT Rte_ThrmlDutyCycle_ThrmlDutyCycle_FltStVal.Filt6Val_Cnt_u8 "MICROSAR RTE" UBYTE NO_COMPU_METHOD 0 0 0 255 ECU_ADDRESS 0 READ_WRITE /end MEASUREMENT
/begin MEASUREMENT Rte_ThrmlDutyCycle_VehTimeValid_Cnt_lgc "MICROSAR RTE" UBYTE RTE_CM_BOOLEAN 0 0 0 255 ECU_ADDRESS 0 /end MEASUREMENT
/begin MEASUREMENT Rte_TrqCanc_CogTrqCal "MICROSAR RTE" UWORD NO_COMPU_METHOD 0 0 0 65535 MATRIX_DIM 512 1 1 ECU_ADDRESS 0 READ_WRITE /end MEASUREMENT
/begin MEASUREMENT Rte_TrqCanc_CogTrqRplComp "MICROSAR RTE" UWORD NO_COMPU_METHOD 0 0 0 65535 MATRIX_DIM 9 1 1 ECU_ADDRESS 0 READ_WRITE /end MEASUREMENT
/begin MEASUREMENT Rte_TrqCmdScl_TorqueCmdSF_Uls_f32 "MICROSAR RTE" FLOAT32_IEEE NO_COMPU_METHOD 0 0 1.175494351e-38 3.402823466e+38 ECU_ADDRESS 0 READ_WRITE /end MEASUREMENT
/begin MEASUREMENT Rte_VehDyn_MotPosReset.NVMStoredLastPosValid_Cnt_lgc "MICROSAR RTE" UBYTE RTE_CM_BOOLEAN 0 0 0 255 ECU_ADDRESS 0 READ_WRITE /end MEASUREMENT
/begin MEASUREMENT Rte_VehDyn_MotPosReset.NVMStoredLastPos_HwDeg_f32 "MICROSAR RTE" FLOAT32_IEEE NO_COMPU_METHOD 0 0 1.175494351e-38 3.402823466e+38 ECU_ADDRESS 0 READ_WRITE /end MEASUREMENT
/begin MEASUREMENT Rte_VehDyn_SrlHwAg_HwDeg_f32 "MICROSAR RTE" FLOAT32_IEEE NO_COMPU_METHOD 0 0 1.175494351e-38 3.402823466e+38 ECU_ADDRESS 0 /end MEASUREMENT
/begin MEASUREMENT Rte_VehDyn_SrlHwAgVld_Cnt_lgc "MICROSAR RTE" UBYTE RTE_CM_BOOLEAN 0 0 0 255 ECU_ADDRESS 0 /end MEASUREMENT
/begin GROUP HystComp.BaseAssistCmd.MtrNm_f32 "MICROSAR RTE" /begin SUB_GROUP /end SUB_GROUP /begin FUNCTION_LIST /end FUNCTION_LIST /begin REF_CHARACTERISTIC /end REF_CHARACTERISTIC /end GROUP
/begin GROUP HystComp.DefeatHystService.Cnt_lgc "MICROSAR RTE" /begin SUB_GROUP /end SUB_GROUP /begin FUNCTION_LIST /end FUNCTION_LIST /begin REF_CHARACTERISTIC /end REF_CHARACTERISTIC /end GROUP
/begin GROUP HystComp.FricOffset.HwNm_f32 "MICROSAR RTE" /begin SUB_GROUP /end SUB_GROUP /begin FUNCTION_LIST /end FUNCTION_LIST /begin REF_CHARACTERISTIC /end REF_CHARACTERISTIC /end GROUP
/begin GROUP HystComp.HwTorque.HwNm_f32 "MICROSAR RTE" /begin SUB_GROUP /end SUB_GROUP /begin FUNCTION_LIST /end FUNCTION_LIST /begin REF_CHARACTERISTIC /end REF_CHARACTERISTIC /end GROUP
/begin GROUP HystComp.HysteresisComp.MtrNm_f32 "MICROSAR RTE" /begin SUB_GROUP /end SUB_GROUP /begin FUNCTION_LIST /end FUNCTION_LIST /begin REF_CHARACTERISTIC /end REF_CHARACTERISTIC /end GROUP
/begin GROUP HystComp.ReceiverPorts "MICROSAR RTE"
 /begin SUB_GROUP HystComp.AssistMechTempEst.DegC_f32 HystComp.BaseAssistCmd.MtrNm_f32 HystComp.DefeatHystService.Cnt_lgc HystComp.FricOffset.HwNm_f32 HystComp.HwTorque.HwNm_f32 HystComp.VehicleSpeed.Kph_f32 HystComp.WIRCmdAmpBlnd.MtrNm_f32 /end SUB_GROUP
 /begin FUNCTION_LIST /end FUNCTION_LIST
 /begin REF_CHARACTERISTIC /end REF_CHARACTERISTIC
 /begin REF_MEASUREMENT /end REF_MEASUREMENT
/end GROUP
/begin GROUP HystComp.SenderPorts "MICROSAR RTE" /begin SUB_GROUP HystComp.HysteresisComp.MtrNm_f32 /end SUB_GROUP /begin FUNCTION_LIST /end FUNCTION_LIST /begin REF_CHARACTERISTIC /end REF_CHARACTERISTIC /begin REF_MEASUREMENT /end REF_MEASUREMENT /end GROUP
/begin GROUP HystComp.VehicleSpeed.Kph_f32 "MICROSAR RTE" /begin SUB_GROUP /end SUB_GROUP /begin FUNCTION_LIST /end FUNCTION_LIST /begin REF_CHARACTERISTIC /end REF_CHARACTERISTIC /end GROUP
/begin GROUP HystComp.WIRCmdAmpBlnd.MtrNm_f32 "MICROSAR RTE" /begin SUB_GROUP /end SUB_GROUP /begin FUNCTION_LIST /end FUNCTION_LIST /begin REF_CHARACTERISTIC /end REF_CHARACTERISTIC /begin REF_MEASUREMENT Rte_HystComp_WIRCmdAmpBlnd_MtrNm_f32 /end REF_MEASUREMENT /end GROUP
/begin GROUP IoHwAbstractionUsr "MICROSAR RTE"
 /begin SUB_GROUP IoHwAbstractionUsr.ReceiverPorts IoHwAbstractionUsr.SenderPorts /end SUB_GROUP
 /begin FUNCTION_LIST /end FUNCTION_LIST
 /begin REF_CHARACTERISTIC /end REF_CHARACTERISTIC
 /begin REF_MEASUREMENT /end REF_MEASUREMENT
/end GROUP
/begin GROUP IoHwAbstractionUsr.Batt.Volt_f32 "MICROSAR RTE" /begin SUB_GROUP /end SUB_GROUP /begin FUNCTION_LIST /end FUNCTION_LIST /begin REF_CHARACTERISTIC /end REF_CHARACTERISTIC /end GROUP
/begin GROUP IoHwAbstractionUsr.BattSwitched.Volt_f32 "MICROSAR RTE" /begin SUB_GROUP /end SUB_GROUP /begin FUNCTION_LIST /end FUNCTION_LIST /begin REF_CHARACTERISTIC /end REF_CHARACTERISTIC /end GROUP
/begin GROUP IoHwAbstractionUsr.ReceiverPorts "MICROSAR RTE" /begin SUB_GROUP IoHwAbstractionUsr.SysCVSwitchADC.Cnt_u16 /end SUB_GROUP /begin FUNCTION_LIST /end FUNCTION_LIST /begin REF_CHARACTERISTIC /end REF_CHARACTERISTIC /begin REF_MEASUREMENT /end REF_MEASUREMENT /end GROUP
/begin GROUP IoHwAbstractionUsr.SenderPorts "MICROSAR RTE"
 /begin SUB_GROUP IoHwAbstractionUsr.Batt.Volt_f32 IoHwAbstractionUsr.BattSwitched.Volt_f32 IoHwAbstractionUsr.SysCVSwitch.Volt_f32 IoHwAbstractionUsr.TemperatureADC.Volt_f32 /end SUB_GROUP
 /begin FUNCTION_LIST /end FUNCTION_LIST
 /begin REF_CHARACTERISTIC /end REF_CHARACTERISTIC
 /begin REF_MEASUREMENT /end REF_MEASUREMENT
/end GROUP
/begin GROUP IoHwAbstractionUsr.SysCVSwitch.Volt_f32 "MICROSAR RTE" /begin SUB_GROUP /end SUB_GROUP /begin FUNCTION_LIST /end FUNCTION_LIST /begin REF_CHARACTERISTIC /end REF_CHARACTERISTIC /end GROUP
/begin GROUP IoHwAbstractionUsr.SysCVSwitchADC.Cnt_u16 "MICROSAR RTE" /begin SUB_GROUP /end SUB_GROUP /begin FUNCTION_LIST /end FUNCTION_LIST /begin REF_CHARACTERISTIC /end REF_CHARACTERISTIC /end GROUP
/begin GROUP IoHwAbstractionUsr.TemperatureADC.Volt_f32 "MICROSAR RTE" /begin SUB_GROUP /end SUB_GROUP /begin FUNCTION_LIST /end FUNCTION_LIST /begin REF_CHARACTERISTIC /end REF_CHARACTERISTIC /end GROUP
/begin GROUP LmtCod "MICROSAR RTE" /begin SUB_GROUP LmtCod.ReceiverPorts LmtCod.SenderPorts /end SUB_GROUP /begin FUNCTION_LIST /end FUNCTION_LIST /begin REF_CHARACTERISTIC /end REF_CHARACTERISTIC /begin REF_MEASUREMENT /end REF_MEASUREMENT /end GROUP
/begin GROUP LmtCod.AssistEOTGain.Uls_f32 "MICROSAR RTE" /begin SUB_GROUP /end SUB_GROUP /begin FUNCTION_LIST /end FUNCTION_LIST /begin REF_CHARACTERISTIC /end REF_CHARACTERISTIC /end GROUP
/begin GROUP LmtCod.AssistEOTLimit.MtrNm_f32 "MICROSAR RTE" /begin SUB_GROUP /end SUB_GROUP /begin FUNCTION_LIST /end FUNCTION_LIST /begin REF_CHARACTERISTIC /end REF_CHARACTERISTIC /end GROUP
/begin GROUP LmtCod.AssistStallLimit.MtrNm_f32 "MICROSAR RTE" /begin SUB_GROUP /end SUB_GROUP /begin FUNCTION_LIST /end FUNCTION_LIST /begin REF_CHARACTERISTIC /end REF_CHARACTERISTIC /end GROUP
/begin GROUP LmtCod.AssistVehSpdLimit.MtrNm_f32 "MICROSAR RTE" /begin SUB_GROUP /end SUB_GROUP /begin FUNCTION_LIST /end FUNCTION_LIST /begin REF_CHARACTERISTIC /end REF_CHARACTERISTIC /begin REF_MEASUREMENT Rte_VehSpdLmt_AstVehSpdLimit_MtrNm_f32 /end REF_MEASUREMENT /end GROUP
/begin GROUP LmtCod.CCLTrqRamp.Uls_f32 "MICROSAR RTE" /begin SUB_GROUP /end SUB_GROUP /begin FUNCTION_LIST /end FUNCTION_LIST /begin REF_CHARACTERISTIC /end REF_CHARACTERISTIC /begin REF_MEASUREMENT Rte_LmtCod_CCLTrqRamp_Uls_f32 /end REF_MEASUREMENT /end GROUP
/begin GROUP LmtCod.EOTGainLtd.Uls_f32 "MICROSAR RTE" /begin SUB_GROUP /end SUB_GROUP /begin FUNCTION_LIST /end FUNCTION_LIST /begin REF_CHARACTERISTIC /end REF_CHARACTERISTIC /end GROUP
/begin GROUP LmtCod.EOTLimitLtd.MtrNm_f32 "MICROSAR RTE" /begin SUB_GROUP /end SUB_GROUP /begin FUNCTION_LIST /end FUNCTION_LIST /begin REF_CHARACTERISTIC /end REF_CHARACTERISTIC /end GROUP
/begin GROUP LmtCod.OutputRampMult.Uls_f32 "MICROSAR RTE" /begin SUB_GROUP /end SUB_GROUP /begin FUNCTION_LIST /end FUNCTION_LIST /begin REF_CHARACTERISTIC /end REF_CHARACTERISTIC /begin REF_MEASUREMENT Rte_StOpCtrl_OutputRampMult_Uls_f32 /end REF_MEASUREMENT /end GROUP
/begin GROUP LmtCod.OutputRampMultLtd.Uls_f32 "MICROSAR RTE" /begin SUB_GROUP /end SUB_GROUP /begin FUNCTION_LIST /end FUNCTION_LIST /begin REF_CHARACTERISTIC /end REF_CHARACTERISTIC /end GROUP
/begin GROUP LmtCod.ReceiverPorts "MICROSAR RTE"
 /begin SUB_GROUP LmtCod.AssistEOTGain.Uls_f32 LmtCod.AssistEOTLimit.MtrNm_f32 LmtCod.AssistStallLimit.MtrNm_f32 LmtCod.AssistVehSpdLimit.MtrNm_f32 LmtCod.CCLTrqRamp.Uls_f32 LmtCod.OutputRampMult.Uls_f32 LmtCod.ThermalLimit.MtrNm_f32 LmtCod.VehicleSpeed.Kph_f32 /end SUB_GROUP
 /begin FUNCTION_LIST /end FUNCTION_LIST
 /begin REF_CHARACTERISTIC /end REF_CHARACTERISTIC
 /begin REF_MEASUREMENT /end REF_MEASUREMENT
/end GROUP
/begin GROUP LmtCod.SenderPorts "MICROSAR RTE"
 /begin SUB_GROUP LmtCod.EOTGainLtd.Uls_f32 LmtCod.EOTLimitLtd.MtrNm_f32 LmtCod.OutputRampMultLtd.Uls_f32 LmtCod.StallLimitLtd.MtrNm_f32 LmtCod.ThermalLimitLtd.MtrNm_f32 LmtCod.VehSpdLimitLtd.MtrNm_f32 /end SUB_GROUP
 /begin FUNCTION_LIST /end FUNCTION_LIST
 /begin REF_CHARACTERISTIC /end REF_CHARACTERISTIC
 /begin REF_MEASUREMENT /end REF_MEASUREMENT
/end GROUP
/begin GROUP LmtCod.StallLimitLtd.MtrNm_f32 "MICROSAR RTE" /begin SUB_GROUP /end SUB_GROUP /begin FUNCTION_LIST /end FUNCTION_LIST /begin REF_CHARACTERISTIC /end REF_CHARACTERISTIC /end GROUP
/begin GROUP LmtCod.ThermalLimit.MtrNm_f32 "MICROSAR RTE" /begin SUB_GROUP /end SUB_GROUP /begin FUNCTION_LIST /end FUNCTION_LIST /begin REF_CHARACTERISTIC /end REF_CHARACTERISTIC /begin REF_MEASUREMENT Rte_ThrmlDutyCycle_ThermalLimit_MtrNm_f32 /end REF_MEASUREMENT /end GROUP
/begin GROUP LmtCod.ThermalLimitLtd.MtrNm_f32 "MICROSAR RTE" /begin SUB_GROUP /end SUB_GROUP /begin FUNCTION_LIST /end FUNCTION_LIST /begin REF_CHARACTERISTIC /end REF_CHARACTERISTIC /end GROUP
/begin GROUP LmtCod.VehSpdLimitLtd.MtrNm_f32 "MICROSAR RTE" /begin SUB_GROUP /end SUB_GROUP /begin FUNCTION_LIST /end FUNCTION_LIST /begin REF_CHARACTERISTIC /end REF_CHARACTERISTIC /end GROUP
/begin GROUP LmtCod.VehicleSpeed.Kph_f32 "MICROSAR RTE" /begin SUB_GROUP /end SUB_GROUP /begin FUNCTION_LIST /end FUNCTION_LIST /begin REF_CHARACTERISTIC /end REF_CHARACTERISTIC /end GROUP
/begin GROUP LrnEOT "MICROSAR RTE"
 /begin SUB_GROUP LrnEOT.PerInstanceMemories LrnEOT.ReceiverPorts LrnEOT.SenderPorts /end SUB_GROUP
 /begin FUNCTION_LIST /end FUNCTION_LIST
 /begin REF_CHARACTERISTIC /end REF_CHARACTERISTIC
 /begin REF_MEASUREMENT /end REF_MEASUREMENT
/end GROUP
/begin GROUP LrnEOT.CCWFound.Cnt_lgc "MICROSAR RTE" /begin SUB_GROUP /end SUB_GROUP /begin FUNCTION_LIST /end FUNCTION_LIST /begin REF_CHARACTERISTIC /end REF_CHARACTERISTIC /end GROUP
/begin GROUP LrnEOT.CCWPosition.HwDeg_f32 "MICROSAR RTE" /begin SUB_GROUP /end SUB_GROUP /begin FUNCTION_LIST /end FUNCTION_LIST /begin REF_CHARACTERISTIC /end REF_CHARACTERISTIC /end GROUP
/begin GROUP LrnEOT.CWFound.Cnt_lgc "MICROSAR RTE" /begin SUB_GROUP /end SUB_GROUP /begin FUNCTION_LIST /end FUNCTION_LIST /begin REF_CHARACTERISTIC /end REF_CHARACTERISTIC /end GROUP
/begin GROUP LrnEOT.CWPosition.HwDeg_f32 "MICROSAR RTE" /begin SUB_GROUP /end SUB_GROUP /begin FUNCTION_LIST /end FUNCTION_LIST /begin REF_CHARACTERISTIC /end REF_CHARACTERISTIC /end GROUP
/begin GROUP LrnEOT.DiagStsHwPosDis.Cnt_lgc "MICROSAR RTE" /begin SUB_GROUP /end SUB_GROUP /begin FUNCTION_LIST /end FUNCTION_LIST /begin REF_CHARACTERISTIC /end REF_CHARACTERISTIC /end GROUP
/begin GROUP LrnEOT.HandwheelAuthority.Uls_f32 "MICROSAR RTE" /begin SUB_GROUP /end SUB_GROUP /begin FUNCTION_LIST /end FUNCTION_LIST /begin REF_CHARACTERISTIC /end REF_CHARACTERISTIC /end GROUP
/begin GROUP LrnEOT.HandwheelPosition.HwDeg_f32 "MICROSAR RTE" /begin SUB_GROUP /end SUB_GROUP /begin FUNCTION_LIST /end FUNCTION_LIST /begin REF_CHARACTERISTIC /end REF_CHARACTERISTIC /end GROUP
/begin GROUP LrnEOT.HwTorque.HwNm_f32 "MICROSAR RTE" /begin SUB_GROUP /end SUB_GROUP /begin FUNCTION_LIST /end FUNCTION_LIST /begin REF_CHARACTERISTIC /end REF_CHARACTERISTIC /end GROUP
/begin GROUP LrnEOT.LearnedEOT "MICROSAR RTE" /begin SUB_GROUP /end SUB_GROUP /begin FUNCTION_LIST /end FUNCTION_LIST /begin REF_CHARACTERISTIC /end REF_CHARACTERISTIC
 /begin REF_MEASUREMENT Rte_LrnEOT_LearnedEOT.CCWEOTFound_Cnt_lgc Rte_LrnEOT_LearnedEOT.CCWEOTPosition_HwDeg_f32 Rte_LrnEOT_LearnedEOT.CWEOTFound_Cnt_lgc Rte_LrnEOT_LearnedEOT.CWEOTPosition_HwDeg_f32 /end REF_MEASUREMENT
/end GROUP
/begin GROUP LrnEOT.MtrVelCRF.MtrRadpS_f32 "MICROSAR RTE" /begin SUB_GROUP /end SUB_GROUP /begin FUNCTION_LIST /end FUNCTION_LIST /begin REF_CHARACTERISTIC /end REF_CHARACTERISTIC /end GROUP
/begin GROUP LrnEOT.PerInstanceMemories "MICROSAR RTE" /begin SUB_GROUP LrnEOT.LearnedEOT /end SUB_GROUP /begin FUNCTION_LIST /end FUNCTION_LIST /begin REF_CHARACTERISTIC /end REF_CHARACTERISTIC /begin REF_MEASUREMENT /end REF_MEASUREMENT /end GROUP
/begin GROUP LrnEOT.ReceiverPorts "MICROSAR RTE"
 /begin SUB_GROUP LrnEOT.DiagStsHwPosDis.Cnt_lgc LrnEOT.HandwheelAuthority.Uls_f32 LrnEOT.HandwheelPosition.HwDeg_f32 LrnEOT.HwTorque.HwNm_f32 LrnEOT.MtrVelCRF.MtrRadpS_f32 /end SUB_GROUP
 /begin FUNCTION_LIST /end FUNCTION_LIST
 /begin REF_CHARACTERISTIC /end REF_CHARACTERISTIC
 /begin REF_MEASUREMENT /end REF_MEASUREMENT
/end GROUP
/begin GROUP LrnEOT.SenderPorts "MICROSAR RTE"
 /begin SUB_GROUP LrnEOT.CCWFound.Cnt_lgc LrnEOT.CCWPosition.HwDeg_f32 LrnEOT.CWFound.Cnt_lgc LrnEOT.CWPosition.HwDeg_f32 /end SUB_GROUP
 /begin FUNCTION_LIST /end FUNCTION_LIST
 /begin REF_CHARACTERISTIC /end REF_CHARACTERISTIC
 /begin REF_MEASUREMENT /end REF_MEASUREMENT
/end GROUP
/begin GROUP MtrDrvDiag "MICROSAR RTE"
 /begin SUB_GROUP MtrDrvDiag.ModeRequirePorts MtrDrvDiag.ReceiverPorts MtrDrvDiag.SenderPorts /end SUB_GROUP
 /begin FUNCTION_LIST /end FUNCTION_LIST
 /begin REF_CHARACTERISTIC /end REF_CHARACTERISTIC
 /begin REF_MEASUREMENT /end REF_MEASUREMENT
/end GROUP
/begin GROUP MtrDrvDiag.FETFaultPhase.Cnt_enum "MICROSAR RTE" /begin SUB_GROUP /end SUB_GROUP /begin FUNCTION_LIST /end FUNCTION_LIST /begin REF_CHARACTERISTIC /end REF_CHARACTERISTIC /begin REF_MEASUREMENT Rte_MtrDrvDiag_FETFaultPhase_Cnt_enum /end REF_MEASUREMENT /end GROUP
/begin GROUP MtrDrvDiag.FETFaultType.Cnt_enum "MICROSAR RTE" /begin SUB_GROUP /end SUB_GROUP /begin FUNCTION_LIST /end FUNCTION_LIST /begin REF_CHARACTERISTIC /end REF_CHARACTERISTIC /begin REF_MEASUREMENT Rte_MtrDrvDiag_FETFaultType_Cnt_enum /end REF_MEASUREMENT /end GROUP
/begin GROUP MtrDrvDiag.GateDriveResetActive.Cnt_lgc "MICROSAR RTE" /begin SUB_GROUP /end SUB_GROUP /begin FUNCTION_LIST /end FUNCTION_LIST /begin REF_CHARACTERISTIC /end REF_CHARACTERISTIC /end GROUP
/begin GROUP MtrDrvDiag.ModeRequirePorts "MICROSAR RTE" /begin SUB_GROUP MtrDrvDiag.SystemState.Mode /end SUB_GROUP /begin FUNCTION_LIST /end FUNCTION_LIST /begin REF_CHARACTERISTIC /end REF_CHARACTERISTIC /begin REF_MEASUREMENT /end REF_MEASUREMENT /end GROUP
/begin GROUP MtrDrvDiag.MtrDrvrInitComplete.Cnt_lgc "MICROSAR RTE" /begin SUB_GROUP /end SUB_GROUP /begin FUNCTION_LIST /end FUNCTION_LIST /begin REF_CHARACTERISTIC /end REF_CHARACTERISTIC /end GROUP
/begin GROUP MtrDrvDiag.MtrDrvrInitStart.Cnt_lgc "MICROSAR RTE" /begin SUB_GROUP /end SUB_GROUP /begin FUNCTION_LIST /end FUNCTION_LIST /begin REF_CHARACTERISTIC /end REF_CHARACTERISTIC /end GROUP
/begin GROUP MtrDrvDiag.ReceiverPorts "MICROSAR RTE" /begin SUB_GROUP MtrDrvDiag.MtrDrvrInitStart.Cnt_lgc /end SUB_GROUP /begin FUNCTION_LIST /end FUNCTION_LIST /begin REF_CHARACTERISTIC /end REF_CHARACTERISTIC /begin REF_MEASUREMENT /end REF_MEASUREMENT /end GROUP
/begin GROUP MtrDrvDiag.SenderPorts "MICROSAR RTE"
 /begin SUB_GROUP MtrDrvDiag.FETFaultPhase.Cnt_enum MtrDrvDiag.FETFaultType.Cnt_enum MtrDrvDiag.GateDriveResetActive.Cnt_lgc MtrDrvDiag.MtrDrvrInitComplete.Cnt_lgc /end SUB_GROUP
 /begin FUNCTION_LIST /end FUNCTION_LIST
 /begin REF_CHARACTERISTIC /end REF_CHARACTERISTIC
 /begin REF_MEASUREMENT /end REF_MEASUREMENT
/end GROUP
/begin GROUP MtrDrvDiag.SystemState.Mode "MICROSAR RTE" /begin SUB_GROUP /end SUB_GROUP /begin FUNCTION_LIST /end FUNCTION_LIST /begin REF_CHARACTERISTIC /end REF_CHARACTERISTIC /end GROUP
/begin GROUP MtrTempEst "MICROSAR RTE" /begin SUB_GROUP MtrTempEst.ReceiverPorts MtrTempEst.SenderPorts /end SUB_GROUP /begin FUNCTION_LIST /end FUNCTION_LIST /begin REF_CHARACTERISTIC /end REF_CHARACTERISTIC /begin REF_MEASUREMENT /end REF_MEASUREMENT /end GROUP
/begin GROUP MtrTempEst.AmbTemp.DegC_f32 "MICROSAR RTE" /begin SUB_GROUP /end SUB_GROUP /begin FUNCTION_LIST /end FUNCTION_LIST /begin REF_CHARACTERISTIC /end REF_CHARACTERISTIC /begin REF_MEASUREMENT Rte_MtrTempEst_AmbTemp_DegC_f32 /end REF_MEASUREMENT /end GROUP
/begin GROUP MtrTempEst.AssistMechTempEst.DegC_f32 "MICROSAR RTE" /begin SUB_GROUP /end SUB_GROUP /begin FUNCTION_LIST /end FUNCTION_LIST /begin REF_CHARACTERISTIC /end REF_CHARACTERISTIC /end GROUP
/begin GROUP MtrTempEst.CtrlTempFinal.DegC_f32 "MICROSAR RTE" /begin SUB_GROUP /end SUB_GROUP /begin FUNCTION_LIST /end FUNCTION_LIST /begin REF_CHARACTERISTIC /end REF_CHARACTERISTIC /end GROUP
/begin GROUP MtrTempEst.CuTempEst.DegC_f32 "MICROSAR RTE" /begin SUB_GROUP /end SUB_GROUP /begin FUNCTION_LIST /end FUNCTION_LIST /begin REF_CHARACTERISTIC /end REF_CHARACTERISTIC /end GROUP
/begin GROUP MtrTempEst.EngTemp.DegC_f32 "MICROSAR RTE" /begin SUB_GROUP /end SUB_GROUP /begin FUNCTION_LIST /end FUNCTION_LIST /begin REF_CHARACTERISTIC /end REF_CHARACTERISTIC /begin REF_MEASUREMENT Rte_MtrTempEst_EngTemp_DegC_f32 /end REF_MEASUREMENT /end GROUP
/begin GROUP MtrTempEst.EstPkCurr.AmpSq_f32 "MICROSAR RTE" /begin SUB_GROUP /end SUB_GROUP /begin FUNCTION_LIST /end FUNCTION_LIST /begin REF_CHARACTERISTIC /end REF_CHARACTERISTIC /begin REF_MEASUREMENT Rte_PeakCurrEst_EstPkCurr_AmpSq_f32 /end REF_MEASUREMENT /end GROUP
/begin GROUP MtrTempEst.HwVel.HwRadpS_f32 "MICROSAR RTE" /begin SUB_GROUP /end SUB_GROUP /begin FUNCTION_LIST /end FUNCTION_LIST /begin REF_CHARACTERISTIC /end REF_CHARACTERISTIC /end GROUP
/begin GROUP MtrTempEst.MagTempEst.DegC_f32 "MICROSAR RTE" /begin SUB_GROUP /end SUB_GROUP /begin FUNCTION_LIST /end FUNCTION_LIST /begin REF_CHARACTERISTIC /end REF_CHARACTERISTIC /end GROUP
/begin GROUP MtrTempEst.ReceiverPorts "MICROSAR RTE"
 /begin SUB_GROUP MtrTempEst.AmbTemp.DegC_f32 MtrTempEst.CtrlTempFinal.DegC_f32 MtrTempEst.EngTemp.DegC_f32 MtrTempEst.EstPkCurr.AmpSq_f32 MtrTempEst.HwVel.HwRadpS_f32 MtrTempEst.ScomAMDefeat.Cnt_lgc MtrTempEst.ScomTempDataRcvd.Cnt_lgc /end SUB_GROUP
 /begin FUNCTION_LIST /end FUNCTION_LIST
 /begin REF_CHARACTERISTIC /end REF_CHARACTERISTIC
 /begin REF_MEASUREMENT /end REF_MEASUREMENT
/end GROUP
/begin GROUP MtrTempEst.ScomAMDefeat.Cnt_lgc "MICROSAR RTE" /begin SUB_GROUP /end SUB_GROUP /begin FUNCTION_LIST /end FUNCTION_LIST /begin REF_CHARACTERISTIC /end REF_CHARACTERISTIC /begin REF_MEASUREMENT Rte_MtrTempEst_ScomAMDefeat_Cnt_lgc /end REF_MEASUREMENT /end GROUP
/begin GROUP MtrTempEst.ScomTempDataRcvd.Cnt_lgc "MICROSAR RTE" /begin SUB_GROUP /end SUB_GROUP /begin FUNCTION_LIST /end FUNCTION_LIST /begin REF_CHARACTERISTIC /end REF_CHARACTERISTIC /begin REF_MEASUREMENT Rte_MtrTempEst_ScomTempDataRcvd_Cnt_lgc /end REF_MEASUREMENT /end GROUP
/begin GROUP MtrTempEst.SenderPorts "MICROSAR RTE"
 /begin SUB_GROUP MtrTempEst.AssistMechTempEst.DegC_f32 MtrTempEst.CuTempEst.DegC_f32 MtrTempEst.MagTempEst.DegC_f32 MtrTempEst.SiTempEst.DegC_f32 /end SUB_GROUP
 /begin FUNCTION_LIST /end FUNCTION_LIST
 /begin REF_CHARACTERISTIC /end REF_CHARACTERISTIC
 /begin REF_MEASUREMENT /end REF_MEASUREMENT
/end GROUP
/begin GROUP MtrTempEst.SiTempEst.DegC_f32 "MICROSAR RTE" /begin SUB_GROUP /end SUB_GROUP /begin FUNCTION_LIST /end FUNCTION_LIST /begin REF_CHARACTERISTIC /end REF_CHARACTERISTIC /end GROUP
/begin GROUP MtrVel "MICROSAR RTE" /begin SUB_GROUP MtrVel.ReceiverPorts MtrVel.SenderPorts /end SUB_GROUP /begin FUNCTION_LIST /end FUNCTION_LIST /begin REF_CHARACTERISTIC /end REF_CHARACTERISTIC /begin REF_MEASUREMENT /end REF_MEASUREMENT /end GROUP
/begin GROUP MtrVel.AsstAssemblyPolarity.Cnt_s08 "MICROSAR RTE" /begin SUB_GROUP /end SUB_GROUP /begin FUNCTION_LIST /end FUNCTION_LIST /begin REF_CHARACTERISTIC /end REF_CHARACTERISTIC /end GROUP
/begin GROUP MtrVel.HandwheelVel.HwRadpS_f32 "MICROSAR RTE" /begin SUB_GROUP /end SUB_GROUP /begin FUNCTION_LIST /end FUNCTION_LIST /begin REF_CHARACTERISTIC /end REF_CHARACTERISTIC /end GROUP
/begin GROUP MtrVel.HwVelValid.Cnt_lgc "MICROSAR RTE" /begin SUB_GROUP /end SUB_GROUP /begin FUNCTION_LIST /end FUNCTION_LIST /begin REF_CHARACTERISTIC /end REF_CHARACTERISTIC /begin REF_MEASUREMENT Rte_MtrVel_HwVelValid_Cnt_lgc /end REF_MEASUREMENT /end GROUP
/begin GROUP MtrVel.MechMtrPos2.Rev_u0p16 "MICROSAR RTE" /begin SUB_GROUP /end SUB_GROUP /begin FUNCTION_LIST /end FUNCTION_LIST /begin REF_CHARACTERISTIC /end REF_CHARACTERISTIC /end GROUP
/begin GROUP MtrVel.MechMtrPos2Timestamp.USec_u32 "MICROSAR RTE" /begin SUB_GROUP /end SUB_GROUP /begin FUNCTION_LIST /end FUNCTION_LIST /begin REF_CHARACTERISTIC /end REF_CHARACTERISTIC /end GROUP
/begin GROUP MtrVel.MotorVelCRF.MtrRadpS_f32 "MICROSAR RTE" /begin SUB_GROUP /end SUB_GROUP /begin FUNCTION_LIST /end FUNCTION_LIST /begin REF_CHARACTERISTIC /end REF_CHARACTERISTIC /end GROUP
/begin GROUP MtrVel.MotorVelMRF.MtrRadpS_f32 "MICROSAR RTE" /begin SUB_GROUP /end SUB_GROUP /begin FUNCTION_LIST /end FUNCTION_LIST /begin REF_CHARACTERISTIC /end REF_CHARACTERISTIC /end GROUP
/begin GROUP MtrVel.ReceiverPorts "MICROSAR RTE"
 /begin SUB_GROUP MtrVel.AsstAssemblyPolarity.Cnt_s08 MtrVel.MechMtrPos2.Rev_u0p16 MtrVel.MechMtrPos2Timestamp.USec_u32 MtrVel.SysCDiagHwVel.HwRadpS_f32 MtrVel.SysCDiagMtrVelMRF.MtrRadpS_f32 /end SUB_GROUP
 /begin FUNCTION_LIST /end FUNCTION_LIST
 /begin REF_CHARACTERISTIC /end REF_CHARACTERISTIC
 /begin REF_MEASUREMENT /end REF_MEASUREMENT
/end GROUP
/begin GROUP MtrVel.SenderPorts "MICROSAR RTE"
 /begin SUB_GROUP MtrVel.HandwheelVel.HwRadpS_f32 MtrVel.HwVelValid.Cnt_lgc MtrVel.MotorVelCRF.MtrRadpS_f32 MtrVel.MotorVelMRF.MtrRadpS_f32 MtrVel.SysCHandwheelVel.HwRadpS_f32 MtrVel.SysCMotorVelMRF.MtrRadpS_f32 /end SUB_GROUP
 /begin FUNCTION_LIST /end FUNCTION_LIST
 /begin REF_CHARACTERISTIC /end REF_CHARACTERISTIC
 /begin REF_MEASUREMENT /end REF_MEASUREMENT
/end GROUP
/begin GROUP MtrVel.SysCDiagHwVel.HwRadpS_f32 "MICROSAR RTE" /begin SUB_GROUP /end SUB_GROUP /begin FUNCTION_LIST /end FUNCTION_LIST /begin REF_CHARACTERISTIC /end REF_CHARACTERISTIC /begin REF_MEASUREMENT Rte_MtrVel2_SysCDiagHwVel_HwRadpS_f32 /end REF_MEASUREMENT /end GROUP
/begin GROUP MtrVel.SysCDiagMtrVelMRF.MtrRadpS_f32 "MICROSAR RTE" /begin SUB_GROUP /end SUB_GROUP /begin FUNCTION_LIST /end FUNCTION_LIST /begin REF_CHARACTERISTIC /end REF_CHARACTERISTIC /begin REF_MEASUREMENT Rte_MtrVel2_SysCDiagMtrVelMRF_MtrRadpS_f32 /end REF_MEASUREMENT /end GROUP
/begin GROUP MtrVel.SysCHandwheelVel.HwRadpS_f32 "MICROSAR RTE" /begin SUB_GROUP /end SUB_GROUP /begin FUNCTION_LIST /end FUNCTION_LIST /begin REF_CHARACTERISTIC /end REF_CHARACTERISTIC /begin REF_MEASUREMENT Rte_MtrVel_SysCHandwheelVel_HwRadpS_f32 /end REF_MEASUREMENT /end GROUP
/begin GROUP MtrVel.SysCMotorVelMRF.MtrRadpS_f32 "MICROSAR RTE" /begin SUB_GROUP /end SUB_GROUP /begin FUNCTION_LIST /end FUNCTION_LIST /begin REF_CHARACTERISTIC /end REF_CHARACTERISTIC /begin REF_MEASUREMENT Rte_MtrVel_SysCMotorVelMRF_MtrRadpS_f32 /end REF_MEASUREMENT /end GROUP
/begin GROUP MtrVel2 "MICROSAR RTE" /begin SUB_GROUP MtrVel2.ReceiverPorts MtrVel2.SenderPorts /end SUB_GROUP /begin FUNCTION_LIST /end FUNCTION_LIST /begin REF_CHARACTERISTIC /end REF_CHARACTERISTIC /begin REF_MEASUREMENT /end REF_MEASUREMENT /end GROUP
/begin GROUP MtrVel2.AsstAssemblyPolarity.Cnt_s08 "MICROSAR RTE" /begin SUB_GROUP /end SUB_GROUP /begin FUNCTION_LIST /end FUNCTION_LIST /begin REF_CHARACTERISTIC /end REF_CHARACTERISTIC /end GROUP
/begin GROUP MtrVel2.CumMechMtrPosMRF.Deg_f32 "MICROSAR RTE" /begin SUB_GROUP /end SUB_GROUP /begin FUNCTION_LIST /end FUNCTION_LIST /begin REF_CHARACTERISTIC /end REF_CHARACTERISTIC /end GROUP
/begin GROUP MtrVel2.HandwheelVel.HwRadpS_f32 "MICROSAR RTE" /begin SUB_GROUP /end SUB_GROUP /begin FUNCTION_LIST /end FUNCTION_LIST /begin REF_CHARACTERISTIC /end REF_CHARACTERISTIC /end GROUP
/begin GROUP MtrVel2.MechMtrPos1Timestamp.USec_u32 "MICROSAR RTE" /begin SUB_GROUP /end SUB_GROUP /begin FUNCTION_LIST /end FUNCTION_LIST /begin REF_CHARACTERISTIC /end REF_CHARACTERISTIC /end GROUP
/begin GROUP MtrVel2.MotorVelMRF.MtrRadpS_f32 "MICROSAR RTE" /begin SUB_GROUP /end SUB_GROUP /begin FUNCTION_LIST /end FUNCTION_LIST /begin REF_CHARACTERISTIC /end REF_CHARACTERISTIC /end GROUP
/begin GROUP MtrVel2.ReceiverPorts "MICROSAR RTE"
 /begin SUB_GROUP MtrVel2.AsstAssemblyPolarity.Cnt_s08 MtrVel2.CumMechMtrPosMRF.Deg_f32 MtrVel2.HandwheelVel.HwRadpS_f32 MtrVel2.MechMtrPos1Timestamp.USec_u32 MtrVel2.MotorVelMRF.MtrRadpS_f32 /end SUB_GROUP
 /begin FUNCTION_LIST /end FUNCTION_LIST
 /begin REF_CHARACTERISTIC /end REF_CHARACTERISTIC
 /begin REF_MEASUREMENT /end REF_MEASUREMENT
/end GROUP
/begin GROUP MtrVel2.SenderPorts "MICROSAR RTE"
 /begin SUB_GROUP MtrVel2.SysCDiagHwVel.HwRadpS_f32 MtrVel2.SysCDiagMtrVelMRF.MtrRadpS_f32 /end SUB_GROUP
 /begin FUNCTION_LIST /end FUNCTION_LIST
 /begin REF_CHARACTERISTIC /end REF_CHARACTERISTIC
 /begin REF_MEASUREMENT /end REF_MEASUREMENT
/end GROUP
/begin GROUP MtrVel2.SysCDiagHwVel.HwRadpS_f32 "MICROSAR RTE" /begin SUB_GROUP /end SUB_GROUP /begin FUNCTION_LIST /end FUNCTION_LIST /begin REF_CHARACTERISTIC /end REF_CHARACTERISTIC /begin REF_MEASUREMENT Rte_MtrVel2_SysCDiagHwVel_HwRadpS_f32 /end REF_MEASUREMENT /end GROUP
/begin GROUP MtrVel2.SysCDiagMtrVelMRF.MtrRadpS_f32 "MICROSAR RTE" /begin SUB_GROUP /end SUB_GROUP /begin FUNCTION_LIST /end FUNCTION_LIST /begin REF_CHARACTERISTIC /end REF_CHARACTERISTIC /begin REF_MEASUREMENT Rte_MtrVel2_SysCDiagMtrVelMRF_MtrRadpS_f32 /end REF_MEASUREMENT /end GROUP
/begin GROUP Nhet1 "MICROSAR RTE" /begin SUB_GROUP Nhet1.SenderPorts /end SUB_GROUP /begin FUNCTION_LIST /end FUNCTION_LIST /begin REF_CHARACTERISTIC /end REF_CHARACTERISTIC /begin REF_MEASUREMENT /end REF_MEASUREMENT /end GROUP
/begin GROUP Nhet1.DigHwTrqT1.HwNm_f32 "MICROSAR RTE" /begin SUB_GROUP /end SUB_GROUP /begin FUNCTION_LIST /end FUNCTION_LIST /begin REF_CHARACTERISTIC /end REF_CHARACTERISTIC /end GROUP
/begin GROUP Nhet1.DigHwTrqT2.HwNm_f32 "MICROSAR RTE" /begin SUB_GROUP /end SUB_GROUP /begin FUNCTION_LIST /end FUNCTION_LIST /begin REF_CHARACTERISTIC /end REF_CHARACTERISTIC /end GROUP
/begin GROUP Nhet1.SenderPorts "MICROSAR RTE" /begin SUB_GROUP Nhet1.DigHwTrqT1.HwNm_f32 Nhet1.DigHwTrqT2.HwNm_f32 /end SUB_GROUP /begin FUNCTION_LIST /end FUNCTION_LIST /begin REF_CHARACTERISTIC /end REF_CHARACTERISTIC /begin REF_MEASUREMENT /end REF_MEASUREMENT /end GROUP
/begin GROUP OvrVoltMon "MICROSAR RTE" /begin SUB_GROUP OvrVoltMon.ModeRequirePorts OvrVoltMon.ReceiverPorts /end SUB_GROUP /begin FUNCTION_LIST /end FUNCTION_LIST /begin REF_CHARACTERISTIC /end REF_CHARACTERISTIC /begin REF_MEASUREMENT /end REF_MEASUREMENT /end GROUP
/begin GROUP OvrVoltMon.ModeRequirePorts "MICROSAR RTE" /begin SUB_GROUP OvrVoltMon.SystemState.Mode /end SUB_GROUP /begin FUNCTION_LIST /end FUNCTION_LIST /begin REF_CHARACTERISTIC /end REF_CHARACTERISTIC /begin REF_MEASUREMENT /end REF_MEASUREMENT /end GROUP
/begin GROUP OvrVoltMon.PwrDiscBTestStart.Cnt_lgc "MICROSAR RTE" /begin SUB_GROUP /end SUB_GROUP /begin FUNCTION_LIST /end FUNCTION_LIST /begin REF_CHARACTERISTIC /end REF_CHARACTERISTIC /end GROUP
/begin GROUP OvrVoltMon.ReceiverPorts "MICROSAR RTE" /begin SUB_GROUP OvrVoltMon.PwrDiscBTestStart.Cnt_lgc /end SUB_GROUP /begin FUNCTION_LIST /end FUNCTION_LIST /begin REF_CHARACTERISTIC /end REF_CHARACTERISTIC /begin REF_MEASUREMENT /end REF_MEASUREMENT /end GROUP
/begin GROUP OvrVoltMon.SystemState.Mode "MICROSAR RTE" /begin SUB_GROUP /end SUB_GROUP /begin FUNCTION_LIST /end FUNCTION_LIST /begin REF_CHARACTERISTIC /end REF_CHARACTERISTIC /end GROUP
/begin GROUP PICurrCntrl "MICROSAR RTE"
 /begin SUB_GROUP PICurrCntrl.ModeRequirePorts PICurrCntrl.ReceiverPorts PICurrCntrl.SenderPorts /end SUB_GROUP
 /begin FUNCTION_LIST /end FUNCTION_LIST
 /begin REF_CHARACTERISTIC /end REF_CHARACTERISTIC
 /begin REF_MEASUREMENT /end REF_MEASUREMENT
/end GROUP
/begin GROUP PICurrCntrl.CorrMtrPosElec.Rev_f32 "MICROSAR RTE" /begin SUB_GROUP /end SUB_GROUP /begin FUNCTION_LIST /end FUNCTION_LIST /begin REF_CHARACTERISTIC /end REF_CHARACTERISTIC /end GROUP
/begin GROUP PICurrCntrl.DervLambdaAlphaDiag.Volt_f32 "MICROSAR RTE" /begin SUB_GROUP /end SUB_GROUP /begin FUNCTION_LIST /end FUNCTION_LIST /begin REF_CHARACTERISTIC /end REF_CHARACTERISTIC /begin REF_MEASUREMENT Rte_PICurrCntrl_DervLambdaAlphaDiag_Volt_f32 /end REF_MEASUREMENT /end GROUP
/begin GROUP PICurrCntrl.DervLambdaBetaDiag.Volt_f32 "MICROSAR RTE" /begin SUB_GROUP /end SUB_GROUP /begin FUNCTION_LIST /end FUNCTION_LIST /begin REF_CHARACTERISTIC /end REF_CHARACTERISTIC /begin REF_MEASUREMENT Rte_PICurrCntrl_DervLambdaBetaDiag_Volt_f32 /end REF_MEASUREMENT /end GROUP
/begin GROUP PICurrCntrl.EstKe.VpRadpS_f32 "MICROSAR RTE" /begin SUB_GROUP /end SUB_GROUP /begin FUNCTION_LIST /end FUNCTION_LIST /begin REF_CHARACTERISTIC /end REF_CHARACTERISTIC /end GROUP
/begin GROUP PICurrCntrl.EstR.Ohm_f32 "MICROSAR RTE" /begin SUB_GROUP /end SUB_GROUP /begin FUNCTION_LIST /end FUNCTION_LIST /begin REF_CHARACTERISTIC /end REF_CHARACTERISTIC /end GROUP
/begin GROUP PICurrCntrl.MRFMtrVel.MtrRadpS_f32 "MICROSAR RTE" /begin SUB_GROUP /end SUB_GROUP /begin FUNCTION_LIST /end FUNCTION_LIST /begin REF_CHARACTERISTIC /end REF_CHARACTERISTIC /end GROUP
/begin GROUP PICurrCntrl.ModeRequirePorts "MICROSAR RTE" /begin SUB_GROUP PICurrCntrl.SystemState.Mode /end SUB_GROUP /begin FUNCTION_LIST /end FUNCTION_LIST /begin REF_CHARACTERISTIC /end REF_CHARACTERISTIC /begin REF_MEASUREMENT /end REF_MEASUREMENT /end GROUP
/begin GROUP PICurrCntrl.MtrCurrDaxRef.Amp_f32 "MICROSAR RTE" /begin SUB_GROUP /end SUB_GROUP /begin FUNCTION_LIST /end FUNCTION_LIST /begin REF_CHARACTERISTIC /end REF_CHARACTERISTIC /end GROUP
/begin GROUP PICurrCntrl.ReceiverPorts "MICROSAR RTE"
 /begin SUB_GROUP PICurrCntrl.CorrMtrPosElec.Rev_f32 PICurrCntrl.EstKe.VpRadpS_f32 PICurrCntrl.EstR.Ohm_f32 PICurrCntrl.MRFMtrVel.MtrRadpS_f32 PICurrCntrl.MtrCurrDaxRef.Amp_f32 /end SUB_GROUP
 /begin FUNCTION_LIST /end FUNCTION_LIST
 /begin REF_CHARACTERISTIC /end REF_CHARACTERISTIC
 /begin REF_MEASUREMENT /end REF_MEASUREMENT
/end GROUP
/begin GROUP PICurrCntrl.SenderPorts "MICROSAR RTE"
 /begin SUB_GROUP PICurrCntrl.DervLambdaAlphaDiag.Volt_f32 PICurrCntrl.DervLambdaBetaDiag.Volt_f32 /end SUB_GROUP
 /begin FUNCTION_LIST /end FUNCTION_LIST
 /begin REF_CHARACTERISTIC /end REF_CHARACTERISTIC
 /begin REF_MEASUREMENT /end REF_MEASUREMENT
/end GROUP
/begin GROUP PICurrCntrl.SystemState.Mode "MICROSAR RTE" /begin SUB_GROUP /end SUB_GROUP /begin FUNCTION_LIST /end FUNCTION_LIST /begin REF_CHARACTERISTIC /end REF_CHARACTERISTIC /end GROUP
/begin GROUP PeakCurrEst "MICROSAR RTE"
 /begin SUB_GROUP PeakCurrEst.ModeRequirePorts PeakCurrEst.ReceiverPorts PeakCurrEst.SenderPorts /end SUB_GROUP
 /begin FUNCTION_LIST /end FUNCTION_LIST
 /begin REF_CHARACTERISTIC /end REF_CHARACTERISTIC
 /begin REF_MEASUREMENT /end REF_MEASUREMENT
/end GROUP
/begin GROUP PeakCurrEst.EstPkCurr.AmpSq_f32 "MICROSAR RTE" /begin SUB_GROUP /end SUB_GROUP /begin FUNCTION_LIST /end FUNCTION_LIST /begin REF_CHARACTERISTIC /end REF_CHARACTERISTIC /begin REF_MEASUREMENT Rte_PeakCurrEst_EstPkCurr_AmpSq_f32 /end REF_MEASUREMENT /end GROUP
/begin GROUP PeakCurrEst.FiltEstPkCurr.AmpSq_f32 "MICROSAR RTE" /begin SUB_GROUP /end SUB_GROUP /begin FUNCTION_LIST /end FUNCTION_LIST /begin REF_CHARACTERISTIC /end REF_CHARACTERISTIC /begin REF_MEASUREMENT Rte_PeakCurrEst_FiltEstPkCurr_AmpSq_f32 /end REF_MEASUREMENT /end GROUP
/begin GROUP PeakCurrEst.IvtrLoaMtgtnEn.Cnt_lgc "MICROSAR RTE" /begin SUB_GROUP /end SUB_GROUP /begin FUNCTION_LIST /end FUNCTION_LIST /begin REF_CHARACTERISTIC /end REF_CHARACTERISTIC /begin REF_MEASUREMENT Rte_PeakCurrEst_IvtrLoaMtgtnEn_Cnt_lgc /end REF_MEASUREMENT /end GROUP
/begin GROUP PeakCurrEst.ModeRequirePorts "MICROSAR RTE" /begin SUB_GROUP PeakCurrEst.SystemState.Mode /end SUB_GROUP /begin FUNCTION_LIST /end FUNCTION_LIST /begin REF_CHARACTERISTIC /end REF_CHARACTERISTIC /begin REF_MEASUREMENT /end REF_MEASUREMENT /end GROUP
/begin GROUP PeakCurrEst.MotCurrLoaMtgtnEn.Cnt_lgc "MICROSAR RTE" /begin SUB_GROUP /end SUB_GROUP /begin FUNCTION_LIST /end FUNCTION_LIST /begin REF_CHARACTERISTIC /end REF_CHARACTERISTIC /begin REF_MEASUREMENT Rte_PeakCurrEst_MotCurrLoaMtgtnEn_Cnt_lgc /end REF_MEASUREMENT /end GROUP
/begin GROUP PeakCurrEst.MtrCurrDax.Amp_f32 "MICROSAR RTE" /begin SUB_GROUP /end SUB_GROUP /begin FUNCTION_LIST /end FUNCTION_LIST /begin REF_CHARACTERISTIC /end REF_CHARACTERISTIC /end GROUP
/begin GROUP PeakCurrEst.MtrCurrDaxRef.Amp_f32 "MICROSAR RTE" /begin SUB_GROUP /end SUB_GROUP /begin FUNCTION_LIST /end FUNCTION_LIST /begin REF_CHARACTERISTIC /end REF_CHARACTERISTIC /end GROUP
/begin GROUP PeakCurrEst.MtrCurrQax.Amp_f32 "MICROSAR RTE" /begin SUB_GROUP /end SUB_GROUP /begin FUNCTION_LIST /end FUNCTION_LIST /begin REF_CHARACTERISTIC /end REF_CHARACTERISTIC /end GROUP
/begin GROUP PeakCurrEst.MtrCurrQaxRef.Amp_f32 "MICROSAR RTE" /begin SUB_GROUP /end SUB_GROUP /begin FUNCTION_LIST /end FUNCTION_LIST /begin REF_CHARACTERISTIC /end REF_CHARACTERISTIC /end GROUP
/begin GROUP PeakCurrEst.ReceiverPorts "MICROSAR RTE"
 /begin SUB_GROUP PeakCurrEst.IvtrLoaMtgtnEn.Cnt_lgc PeakCurrEst.MotCurrLoaMtgtnEn.Cnt_lgc PeakCurrEst.MtrCurrDax.Amp_f32 PeakCurrEst.MtrCurrDaxRef.Amp_f32 PeakCurrEst.MtrCurrQax.Amp_f32 PeakCurrEst.MtrCurrQaxRef.Amp_f32 /end SUB_GROUP
 /begin FUNCTION_LIST /end FUNCTION_LIST
 /begin REF_CHARACTERISTIC /end REF_CHARACTERISTIC
 /begin REF_MEASUREMENT /end REF_MEASUREMENT
/end GROUP
/begin GROUP PeakCurrEst.SenderPorts "MICROSAR RTE"
 /begin SUB_GROUP PeakCurrEst.EstPkCurr.AmpSq_f32 PeakCurrEst.FiltEstPkCurr.AmpSq_f32 /end SUB_GROUP
 /begin FUNCTION_LIST /end FUNCTION_LIST
 /begin REF_CHARACTERISTIC /end REF_CHARACTERISTIC
 /begin REF_MEASUREMENT /end REF_MEASUREMENT
/end GROUP
/begin GROUP PeakCurrEst.SystemState.Mode "MICROSAR RTE" /begin SUB_GROUP /end SUB_GROUP /begin FUNCTION_LIST /end FUNCTION_LIST /begin REF_CHARACTERISTIC /end REF_CHARACTERISTIC /end GROUP
/begin GROUP Polarity "MICROSAR RTE"
 /begin SUB_GROUP Polarity.PerInstanceMemories Polarity.ReceiverPorts Polarity.SenderPorts /end SUB_GROUP
 /begin FUNCTION_LIST /end FUNCTION_LIST
 /begin REF_CHARACTERISTIC /end REF_CHARACTERISTIC
 /begin REF_MEASUREMENT /end REF_MEASUREMENT
/end GROUP
/begin GROUP Polarity.AssistAssyPolarity.Cnt_s08 "MICROSAR RTE" /begin SUB_GROUP /end SUB_GROUP /begin FUNCTION_LIST /end FUNCTION_LIST /begin REF_CHARACTERISTIC /end REF_CHARACTERISTIC /end GROUP
/begin GROUP Polarity.DiagAssistAssyPolarity.Cnt_s08 "MICROSAR RTE" /begin SUB_GROUP /end SUB_GROUP /begin FUNCTION_LIST /end FUNCTION_LIST /begin REF_CHARACTERISTIC /end REF_CHARACTERISTIC /end GROUP
/begin GROUP Polarity.DiagHwPosPolarity.Cnt_s08 "MICROSAR RTE" /begin SUB_GROUP /end SUB_GROUP /begin FUNCTION_LIST /end FUNCTION_LIST /begin REF_CHARACTERISTIC /end REF_CHARACTERISTIC /begin REF_MEASUREMENT Rte_Polarity_HwPosPolarity_Cnt_s08 /end REF_MEASUREMENT /end GROUP
/begin GROUP Polarity.DiagHwTrqPolarity.Cnt_s08 "MICROSAR RTE" /begin SUB_GROUP /end SUB_GROUP /begin FUNCTION_LIST /end FUNCTION_LIST /begin REF_CHARACTERISTIC /end REF_CHARACTERISTIC /begin REF_MEASUREMENT Rte_Polarity_HwTrqPolarity_Cnt_s08 /end REF_MEASUREMENT /end GROUP
/begin GROUP Polarity.DiagMtrElecMechPolarity.Cnt_s08 "MICROSAR RTE" /begin SUB_GROUP /end SUB_GROUP /begin FUNCTION_LIST /end FUNCTION_LIST /begin REF_CHARACTERISTIC /end REF_CHARACTERISTIC /end GROUP
/begin GROUP Polarity.DiagMtrPosPolarity.Cnt_s08 "MICROSAR RTE" /begin SUB_GROUP /end SUB_GROUP /begin FUNCTION_LIST /end FUNCTION_LIST /begin REF_CHARACTERISTIC /end REF_CHARACTERISTIC /end GROUP
/begin GROUP Polarity.DiagMtrVelPolarity.Cnt_s08 "MICROSAR RTE" /begin SUB_GROUP /end SUB_GROUP /begin FUNCTION_LIST /end FUNCTION_LIST /begin REF_CHARACTERISTIC /end REF_CHARACTERISTIC /begin REF_MEASUREMENT Rte_Polarity_MtrVelPolarity_Cnt_s08 /end REF_MEASUREMENT /end GROUP
/begin GROUP Polarity.HwPosPolarity.Cnt_s08 "MICROSAR RTE" /begin SUB_GROUP /end SUB_GROUP /begin FUNCTION_LIST /end FUNCTION_LIST /begin REF_CHARACTERISTIC /end REF_CHARACTERISTIC /begin REF_MEASUREMENT Rte_Polarity_HwPosPolarity_Cnt_s08 /end REF_MEASUREMENT /end GROUP
/begin GROUP Polarity.HwTrqPolarity.Cnt_s08 "MICROSAR RTE" /begin SUB_GROUP /end SUB_GROUP /begin FUNCTION_LIST /end FUNCTION_LIST /begin REF_CHARACTERISTIC /end REF_CHARACTERISTIC /begin REF_MEASUREMENT Rte_Polarity_HwTrqPolarity_Cnt_s08 /end REF_MEASUREMENT /end GROUP
/begin GROUP Polarity.MtrElecMechPolarity.Cnt_s08 "MICROSAR RTE" /begin SUB_GROUP /end SUB_GROUP /begin FUNCTION_LIST /end FUNCTION_LIST /begin REF_CHARACTERISTIC /end REF_CHARACTERISTIC /end GROUP
/begin GROUP Polarity.MtrPosPolarity.Cnt_s08 "MICROSAR RTE" /begin SUB_GROUP /end SUB_GROUP /begin FUNCTION_LIST /end FUNCTION_LIST /begin REF_CHARACTERISTIC /end REF_CHARACTERISTIC /end GROUP
/begin GROUP Polarity.MtrVelPolarity.Cnt_s08 "MICROSAR RTE" /begin SUB_GROUP /end SUB_GROUP /begin FUNCTION_LIST /end FUNCTION_LIST /begin REF_CHARACTERISTIC /end REF_CHARACTERISTIC /begin REF_MEASUREMENT Rte_Polarity_MtrVelPolarity_Cnt_s08 /end REF_MEASUREMENT /end GROUP
/begin GROUP Polarity.PerInstanceMemories "MICROSAR RTE" /begin SUB_GROUP Polarity.Polarity_Cnt_Str /end SUB_GROUP /begin FUNCTION_LIST /end FUNCTION_LIST /begin REF_CHARACTERISTIC /end REF_CHARACTERISTIC /begin REF_MEASUREMENT /end REF_MEASUREMENT /end GROUP
/begin GROUP Polarity.Polarity_Cnt_Str "MICROSAR RTE" /begin SUB_GROUP /end SUB_GROUP /begin FUNCTION_LIST /end FUNCTION_LIST /begin REF_CHARACTERISTIC /end REF_CHARACTERISTIC
 /begin REF_MEASUREMENT Rte_Polarity_Polarity_Cnt_Str.Polarity_Cnt_b08 Rte_Polarity_Polarity_Cnt_Str.R_Polarity_Cnt_b08 /end REF_MEASUREMENT
/end GROUP
/begin GROUP Polarity.ReceiverPorts "MICROSAR RTE"
 /begin SUB_GROUP Polarity.DiagAssistAssyPolarity.Cnt_s08 Polarity.DiagHwPosPolarity.Cnt_s08 Polarity.DiagHwTrqPolarity.Cnt_s08 Polarity.DiagMtrElecMechPolarity.Cnt_s08 Polarity.DiagMtrPosPolarity.Cnt_s08 Polarity.DiagMtrVelPolarity.Cnt_s08 /end SUB_GROUP
 /begin FUNCTION_LIST /end FUNCTION_LIST
 /begin REF_CHARACTERISTIC /end REF_CHARACTERISTIC
 /begin REF_MEASUREMENT /end REF_MEASUREMENT
/end GROUP
/begin GROUP Polarity.SenderPorts "MICROSAR RTE"
 /begin SUB_GROUP Polarity.AssistAssyPolarity.Cnt_s08 Polarity.HwPosPolarity.Cnt_s08 Polarity.HwTrqPolarity.Cnt_s08 Polarity.MtrElecMechPolarity.Cnt_s08 Polarity.MtrPosPolarity.Cnt_s08 Polarity.MtrVelPolarity.Cnt_s08 Polarity.SysC_MtrElecMechPolarity.Cnt_s32 /end SUB_GROUP
 /begin FUNCTION_LIST /end FUNCTION_LIST
 /begin REF_CHARACTERISTIC /end REF_CHARACTERISTIC
 /begin REF_MEASUREMENT /end REF_MEASUREMENT
/end GROUP
/begin GROUP Polarity.SysC_MtrElecMechPolarity.Cnt_s32 "MICROSAR RTE" /begin SUB_GROUP /end SUB_GROUP /begin FUNCTION_LIST /end FUNCTION_LIST /begin REF_CHARACTERISTIC /end REF_CHARACTERISTIC /end GROUP
/begin GROUP PwrLmtFuncCr "MICROSAR RTE"
 /begin SUB_GROUP PwrLmtFuncCr.ModeRequirePorts PwrLmtFuncCr.ReceiverPorts PwrLmtFuncCr.SenderPorts /end SUB_GROUP
 /begin FUNCTION_LIST /end FUNCTION_LIST
 /begin REF_CHARACTERISTIC /end REF_CHARACTERISTIC
 /begin REF_MEASUREMENT /end REF_MEASUREMENT
/end GROUP
/begin GROUP PwrLmtFuncCr.CntDisMtrTrqCmdMRF.MtrNm_f32 "MICROSAR RTE" /begin SUB_GROUP /end SUB_GROUP /begin FUNCTION_LIST /end FUNCTION_LIST /begin REF_CHARACTERISTIC /end REF_CHARACTERISTIC /end GROUP
/begin GROUP PwrLmtFuncCr.EstKe.VpRadpS_f32 "MICROSAR RTE" /begin SUB_GROUP /end SUB_GROUP /begin FUNCTION_LIST /end FUNCTION_LIST /begin REF_CHARACTERISTIC /end REF_CHARACTERISTIC /end GROUP
/begin GROUP PwrLmtFuncCr.FltTrqLmt.Uls_f32 "MICROSAR RTE" /begin SUB_GROUP /end SUB_GROUP /begin FUNCTION_LIST /end FUNCTION_LIST /begin REF_CHARACTERISTIC /end REF_CHARACTERISTIC /end GROUP
/begin GROUP PwrLmtFuncCr.MRFMtrTrqCmd.MtrNm_f32 "MICROSAR RTE" /begin SUB_GROUP /end SUB_GROUP /begin FUNCTION_LIST /end FUNCTION_LIST /begin REF_CHARACTERISTIC /end REF_CHARACTERISTIC /begin REF_MEASUREMENT Rte_PwrLmtFuncCr_MRFMtrTrqCmd_MtrNm_f32 /end REF_MEASUREMENT /end GROUP
/begin GROUP PwrLmtFuncCr.ModeRequirePorts "MICROSAR RTE" /begin SUB_GROUP PwrLmtFuncCr.SystemState.Mode /end SUB_GROUP /begin FUNCTION_LIST /end FUNCTION_LIST /begin REF_CHARACTERISTIC /end REF_CHARACTERISTIC /begin REF_MEASUREMENT /end REF_MEASUREMENT /end GROUP
/begin GROUP PwrLmtFuncCr.MotorVelMRF.MtrRadpS_f32 "MICROSAR RTE" /begin SUB_GROUP /end SUB_GROUP /begin FUNCTION_LIST /end FUNCTION_LIST /begin REF_CHARACTERISTIC /end REF_CHARACTERISTIC /end GROUP
/begin GROUP PwrLmtFuncCr.PosServEnable.Cnt_lgc "MICROSAR RTE" /begin SUB_GROUP /end SUB_GROUP /begin FUNCTION_LIST /end FUNCTION_LIST /begin REF_CHARACTERISTIC /end REF_CHARACTERISTIC /begin REF_MEASUREMENT Rte_PwrLmtFuncCr_PosServEnable_Cnt_lgc /end REF_MEASUREMENT /end GROUP
/begin GROUP PwrLmtFuncCr.ReceiverPorts "MICROSAR RTE"
 /begin SUB_GROUP PwrLmtFuncCr.CntDisMtrTrqCmdMRF.MtrNm_f32 PwrLmtFuncCr.EstKe.VpRadpS_f32 PwrLmtFuncCr.MotorVelMRF.MtrRadpS_f32 PwrLmtFuncCr.PosServEnable.Cnt_lgc PwrLmtFuncCr.Vecu.Volt_f32 /end SUB_GROUP
 /begin FUNCTION_LIST /end FUNCTION_LIST
 /begin REF_CHARACTERISTIC /end REF_CHARACTERISTIC
 /begin REF_MEASUREMENT /end REF_MEASUREMENT
/end GROUP
/begin GROUP PwrLmtFuncCr.SenderPorts "MICROSAR RTE"
 /begin SUB_GROUP PwrLmtFuncCr.FltTrqLmt.Uls_f32 PwrLmtFuncCr.MRFMtrTrqCmd.MtrNm_f32 PwrLmtFuncCr.ThresholdExceeded.Cnt_lgc /end SUB_GROUP
 /begin FUNCTION_LIST /end FUNCTION_LIST
 /begin REF_CHARACTERISTIC /end REF_CHARACTERISTIC
 /begin REF_MEASUREMENT /end REF_MEASUREMENT
/end GROUP
/begin GROUP PwrLmtFuncCr.SystemState.Mode "MICROSAR RTE" /begin SUB_GROUP /end SUB_GROUP /begin FUNCTION_LIST /end FUNCTION_LIST /begin REF_CHARACTERISTIC /end REF_CHARACTERISTIC /end GROUP
/begin GROUP PwrLmtFuncCr.ThresholdExceeded.Cnt_lgc "MICROSAR RTE" /begin SUB_GROUP /end SUB_GROUP /begin FUNCTION_LIST /end FUNCTION_LIST /begin REF_CHARACTERISTIC /end REF_CHARACTERISTIC /begin REF_MEASUREMENT Rte_PwrLmtFuncCr_ThresholdExceeded_Cnt_lgc /end REF_MEASUREMENT /end GROUP
/begin GROUP PwrLmtFuncCr.Vecu.Volt_f32 "MICROSAR RTE" /begin SUB_GROUP /end SUB_GROUP /begin FUNCTION_LIST /end FUNCTION_LIST /begin REF_CHARACTERISTIC /end REF_CHARACTERISTIC /end GROUP
/begin GROUP QuadDet "MICROSAR RTE" /begin SUB_GROUP QuadDet.ReceiverPorts QuadDet.SenderPorts /end SUB_GROUP /begin FUNCTION_LIST /end FUNCTION_LIST /begin REF_CHARACTERISTIC /end REF_CHARACTERISTIC /begin REF_MEASUREMENT /end REF_MEASUREMENT /end GROUP
/begin GROUP QuadDet.InstMtrDir.Cnt_s08 "MICROSAR RTE" /begin SUB_GROUP /end SUB_GROUP /begin FUNCTION_LIST /end FUNCTION_LIST /begin REF_CHARACTERISTIC /end REF_CHARACTERISTIC /begin REF_MEASUREMENT Rte_QuadDet_InstMtrDir_Cnt_s08 /end REF_MEASUREMENT /end GROUP
/begin GROUP QuadDet.MRFCumMtrPos.Deg_f32 "MICROSAR RTE" /begin SUB_GROUP /end SUB_GROUP /begin FUNCTION_LIST /end FUNCTION_LIST /begin REF_CHARACTERISTIC /end REF_CHARACTERISTIC /end GROUP
/begin GROUP QuadDet.MRFMtrTrqCmdScl.MtrNm_f32 "MICROSAR RTE" /begin SUB_GROUP /end SUB_GROUP /begin FUNCTION_LIST /end FUNCTION_LIST /begin REF_CHARACTERISTIC /end REF_CHARACTERISTIC /end GROUP
/begin GROUP QuadDet.MtrQuad.Cnt_u08 "MICROSAR RTE" /begin SUB_GROUP /end SUB_GROUP /begin FUNCTION_LIST /end FUNCTION_LIST /begin REF_CHARACTERISTIC /end REF_CHARACTERISTIC /end GROUP
/begin GROUP QuadDet.ReceiverPorts "MICROSAR RTE"
 /begin SUB_GROUP QuadDet.MRFCumMtrPos.Deg_f32 QuadDet.MRFMtrTrqCmdScl.MtrNm_f32 /end SUB_GROUP
 /begin FUNCTION_LIST /end FUNCTION_LIST
 /begin REF_CHARACTERISTIC /end REF_CHARACTERISTIC
 /begin REF_MEASUREMENT /end REF_MEASUREMENT
/end GROUP
/begin GROUP QuadDet.SenderPorts "MICROSAR RTE" /begin SUB_GROUP QuadDet.InstMtrDir.Cnt_s08 QuadDet.MtrQuad.Cnt_u08 /end SUB_GROUP /begin FUNCTION_LIST /end FUNCTION_LIST /begin REF_CHARACTERISTIC /end REF_CHARACTERISTIC /begin REF_MEASUREMENT /end REF_MEASUREMENT /end GROUP
/begin GROUP RTE "MICROSAR RTE" /begin SUB_GROUP SWCs /end SUB_GROUP /begin FUNCTION_LIST /end FUNCTION_LIST /begin REF_CHARACTERISTIC /end REF_CHARACTERISTIC /begin REF_MEASUREMENT /end REF_MEASUREMENT /end GROUP
/begin GROUP Return "MICROSAR RTE" /begin SUB_GROUP Return.ReceiverPorts Return.SenderPorts /end SUB_GROUP /begin FUNCTION_LIST /end FUNCTION_LIST /begin REF_CHARACTERISTIC /end REF_CHARACTERISTIC /begin REF_MEASUREMENT /end REF_MEASUREMENT /end GROUP
/begin GROUP Return.AssistMechTempEst.DegC_f32 "MICROSAR RTE" /begin SUB_GROUP /end SUB_GROUP /begin FUNCTION_LIST /end FUNCTION_LIST /begin REF_CHARACTERISTIC /end REF_CHARACTERISTIC /end GROUP
/begin GROUP Return.DefeatReturnSvc.Cnt_lgc "MICROSAR RTE" /begin SUB_GROUP /end SUB_GROUP /begin FUNCTION_LIST /end FUNCTION_LIST /begin REF_CHARACTERISTIC /end REF_CHARACTERISTIC /end GROUP
/begin GROUP Return.DiagStsHwPosDis.Cnt_lgc "MICROSAR RTE" /begin SUB_GROUP /end SUB_GROUP /begin FUNCTION_LIST /end FUNCTION_LIST /begin REF_CHARACTERISTIC /end REF_CHARACTERISTIC /end GROUP
/begin GROUP Return.HandwheelAuthority.Uls_f32 "MICROSAR RTE" /begin SUB_GROUP /end SUB_GROUP /begin FUNCTION_LIST /end FUNCTION_LIST /begin REF_CHARACTERISTIC /end REF_CHARACTERISTIC /end GROUP
/begin GROUP Return.HandwheelPosition.HwDeg_f32 "MICROSAR RTE" /begin SUB_GROUP /end SUB_GROUP /begin FUNCTION_LIST /end FUNCTION_LIST /begin REF_CHARACTERISTIC /end REF_CHARACTERISTIC /end GROUP
/begin GROUP Return.HandwheelVel.HwRadpS_f32 "MICROSAR RTE" /begin SUB_GROUP /end SUB_GROUP /begin FUNCTION_LIST /end FUNCTION_LIST /begin REF_CHARACTERISTIC /end REF_CHARACTERISTIC /end GROUP
/begin GROUP Return.HwTorque.HwNm_f32 "MICROSAR RTE" /begin SUB_GROUP /end SUB_GROUP /begin FUNCTION_LIST /end FUNCTION_LIST /begin REF_CHARACTERISTIC /end REF_CHARACTERISTIC /end GROUP
/begin GROUP Return.PAReturnSclFct.Uls_f32 "MICROSAR RTE" /begin SUB_GROUP /end SUB_GROUP /begin FUNCTION_LIST /end FUNCTION_LIST /begin REF_CHARACTERISTIC /end REF_CHARACTERISTIC /begin REF_MEASUREMENT Rte_Return_PAReturnSclFct_Uls_f32 /end REF_MEASUREMENT /end GROUP
/begin GROUP Return.ReceiverPorts "MICROSAR RTE"
 /begin SUB_GROUP Return.AssistMechTempEst.DegC_f32 Return.DefeatReturnSvc.Cnt_lgc Return.DiagStsHwPosDis.Cnt_lgc Return.HandwheelAuthority.Uls_f32 Return.HandwheelPosition.HwDeg_f32 Return.HandwheelVel.HwRadpS_f32 Return.HwTorque.HwNm_f32 Return.PAReturnSclFct.Uls_f32 Return.ReturnDDFactor.Uls_f32 Return.ReturnOffset.HwDeg_f32 Return.VehicleSpeed.Kph_f32 /end SUB_GROUP
 /begin FUNCTION_LIST /end FUNCTION_LIST
 /begin REF_CHARACTERISTIC /end REF_CHARACTERISTIC
 /begin REF_MEASUREMENT /end REF_MEASUREMENT
/end GROUP
/begin GROUP Return.ReturnCmd.MtrNm_f32 "MICROSAR RTE" /begin SUB_GROUP /end SUB_GROUP /begin FUNCTION_LIST /end FUNCTION_LIST /begin REF_CHARACTERISTIC /end REF_CHARACTERISTIC /begin REF_MEASUREMENT Rte_Return_ReturnCmd_MtrNm_f32 /end REF_MEASUREMENT /end GROUP
/begin GROUP Return.ReturnDDFactor.Uls_f32 "MICROSAR RTE" /begin SUB_GROUP /end SUB_GROUP /begin FUNCTION_LIST /end FUNCTION_LIST /begin REF_CHARACTERISTIC /end REF_CHARACTERISTIC /begin REF_MEASUREMENT Rte_Return_ReturnDDFactor_Uls_f32 /end REF_MEASUREMENT /end GROUP
/begin GROUP Return.ReturnOffset.HwDeg_f32 "MICROSAR RTE" /begin SUB_GROUP /end SUB_GROUP /begin FUNCTION_LIST /end FUNCTION_LIST /begin REF_CHARACTERISTIC /end REF_CHARACTERISTIC /begin REF_MEASUREMENT Rte_Return_ReturnOffset_HwDeg_f32 /end REF_MEASUREMENT /end GROUP
/begin GROUP Return.SenderPorts "MICROSAR RTE" /begin SUB_GROUP Return.ReturnCmd.MtrNm_f32 /end SUB_GROUP /begin FUNCTION_LIST /end FUNCTION_LIST /begin REF_CHARACTERISTIC /end REF_CHARACTERISTIC /begin REF_MEASUREMENT /end REF_MEASUREMENT /end GROUP
/begin GROUP Return.VehicleSpeed.Kph_f32 "MICROSAR RTE" /begin SUB_GROUP /end SUB_GROUP /begin FUNCTION_LIST /end FUNCTION_LIST /begin REF_CHARACTERISTIC /end REF_CHARACTERISTIC /end GROUP
/begin GROUP ReturnFirewall "MICROSAR RTE"
 /begin SUB_GROUP ReturnFirewall.ModeRequirePorts ReturnFirewall.ReceiverPorts ReturnFirewall.SenderPorts /end SUB_GROUP
 /begin FUNCTION_LIST /end FUNCTION_LIST
 /begin REF_CHARACTERISTIC /end REF_CHARACTERISTIC
 /begin REF_MEASUREMENT /end REF_MEASUREMENT
/end GROUP
/begin GROUP ReturnFirewall.Defeat_Return_Svc.Cnt_lgc "MICROSAR RTE" /begin SUB_GROUP /end SUB_GROUP /begin FUNCTION_LIST /end FUNCTION_LIST /begin REF_CHARACTERISTIC /end REF_CHARACTERISTIC /end GROUP
/begin GROUP ReturnFirewall.HandwheelPosition.HwDeg_f32 "MICROSAR RTE" /begin SUB_GROUP /end SUB_GROUP /begin FUNCTION_LIST /end FUNCTION_LIST /begin REF_CHARACTERISTIC /end REF_CHARACTERISTIC /end GROUP
/begin GROUP ReturnFirewall.LimitedReturn.MtrNm_f32 "MICROSAR RTE" /begin SUB_GROUP /end SUB_GROUP /begin FUNCTION_LIST /end FUNCTION_LIST /begin REF_CHARACTERISTIC /end REF_CHARACTERISTIC /end GROUP
/begin GROUP ReturnFirewall.MEC_Counter.Cnt_enum "MICROSAR RTE" /begin SUB_GROUP /end SUB_GROUP /begin FUNCTION_LIST /end FUNCTION_LIST /begin REF_CHARACTERISTIC /end REF_CHARACTERISTIC /end GROUP
/begin GROUP ReturnFirewall.ModeRequirePorts "MICROSAR RTE" /begin SUB_GROUP ReturnFirewall.SystemState.Mode /end SUB_GROUP /begin FUNCTION_LIST /end FUNCTION_LIST /begin REF_CHARACTERISTIC /end REF_CHARACTERISTIC /begin REF_MEASUREMENT /end REF_MEASUREMENT /end GROUP
/begin GROUP ReturnFirewall.ReceiverPorts "MICROSAR RTE"
 /begin SUB_GROUP ReturnFirewall.Defeat_Return_Svc.Cnt_lgc ReturnFirewall.HandwheelPosition.HwDeg_f32 ReturnFirewall.MEC_Counter.Cnt_enum ReturnFirewall.ReturnCmd.MtrNm_f32 ReturnFirewall.VehicleSpeed.Kph_f32 /end SUB_GROUP
 /begin FUNCTION_LIST /end FUNCTION_LIST
 /begin REF_CHARACTERISTIC /end REF_CHARACTERISTIC
 /begin REF_MEASUREMENT /end REF_MEASUREMENT
/end GROUP
/begin GROUP ReturnFirewall.ReturnCmd.MtrNm_f32 "MICROSAR RTE" /begin SUB_GROUP /end SUB_GROUP /begin FUNCTION_LIST /end FUNCTION_LIST /begin REF_CHARACTERISTIC /end REF_CHARACTERISTIC /begin REF_MEASUREMENT Rte_Return_ReturnCmd_MtrNm_f32 /end REF_MEASUREMENT /end GROUP
/begin GROUP ReturnFirewall.SenderPorts "MICROSAR RTE" /begin SUB_GROUP ReturnFirewall.LimitedReturn.MtrNm_f32 /end SUB_GROUP /begin FUNCTION_LIST /end FUNCTION_LIST /begin REF_CHARACTERISTIC /end REF_CHARACTERISTIC /begin REF_MEASUREMENT /end REF_MEASUREMENT /end GROUP
/begin GROUP ReturnFirewall.SystemState.Mode "MICROSAR RTE" /begin SUB_GROUP /end SUB_GROUP /begin FUNCTION_LIST /end FUNCTION_LIST /begin REF_CHARACTERISTIC /end REF_CHARACTERISTIC /end GROUP
/begin GROUP ReturnFirewall.VehicleSpeed.Kph_f32 "MICROSAR RTE" /begin SUB_GROUP /end SUB_GROUP /begin FUNCTION_LIST /end FUNCTION_LIST /begin REF_CHARACTERISTIC /end REF_CHARACTERISTIC /end GROUP
/begin GROUP RteErrata "MICROSAR RTE" /begin SUB_GROUP RteErrata.ModeRequirePorts /end SUB_GROUP /begin FUNCTION_LIST /end FUNCTION_LIST /begin REF_CHARACTERISTIC /end REF_CHARACTERISTIC /begin REF_MEASUREMENT /end REF_MEASUREMENT /end GROUP
/begin GROUP RteErrata.ModeRequirePorts "MICROSAR RTE" /begin SUB_GROUP RteErrata.SystemState.Mode /end SUB_GROUP /begin FUNCTION_LIST /end FUNCTION_LIST /begin REF_CHARACTERISTIC /end REF_CHARACTERISTIC /begin REF_MEASUREMENT /end REF_MEASUREMENT /end GROUP
/begin GROUP RteErrata.SystemState.Mode "MICROSAR RTE" /begin SUB_GROUP /end SUB_GROUP /begin FUNCTION_LIST /end FUNCTION_LIST /begin REF_CHARACTERISTIC /end REF_CHARACTERISTIC /end GROUP
/begin GROUP RteErrata8 "MICROSAR RTE" /begin SUB_GROUP RteErrata8.ModeRequirePorts /end SUB_GROUP /begin FUNCTION_LIST /end FUNCTION_LIST /begin REF_CHARACTERISTIC /end REF_CHARACTERISTIC /begin REF_MEASUREMENT /end REF_MEASUREMENT /end GROUP
/begin GROUP RteErrata8.ModeRequirePorts "MICROSAR RTE" /begin SUB_GROUP RteErrata8.SystemState.Mode /end SUB_GROUP /begin FUNCTION_LIST /end FUNCTION_LIST /begin REF_CHARACTERISTIC /end REF_CHARACTERISTIC /begin REF_MEASUREMENT /end REF_MEASUREMENT /end GROUP
/begin GROUP RteErrata8.SystemState.Mode "MICROSAR RTE" /begin SUB_GROUP /end SUB_GROUP /begin FUNCTION_LIST /end FUNCTION_LIST /begin REF_CHARACTERISTIC /end REF_CHARACTERISTIC /end GROUP
/begin GROUP RteErrata9 "MICROSAR RTE" /begin SUB_GROUP RteErrata9.ModeRequirePorts /end SUB_GROUP /begin FUNCTION_LIST /end FUNCTION_LIST /begin REF_CHARACTERISTIC /end REF_CHARACTERISTIC /begin REF_MEASUREMENT /end REF_MEASUREMENT /end GROUP
/begin GROUP RteErrata9.ModeRequirePorts "MICROSAR RTE" /begin SUB_GROUP RteErrata9.SystemState.Mode /end SUB_GROUP /begin FUNCTION_LIST /end FUNCTION_LIST /begin REF_CHARACTERISTIC /end REF_CHARACTERISTIC /begin REF_MEASUREMENT /end REF_MEASUREMENT /end GROUP
/begin GROUP RteErrata9.SystemState.Mode "MICROSAR RTE" /begin SUB_GROUP /end SUB_GROUP /begin FUNCTION_LIST /end FUNCTION_LIST /begin REF_CHARACTERISTIC /end REF_CHARACTERISTIC /end GROUP
/begin GROUP SWCs "MICROSAR RTE"
 /begin SUB_GROUP AbsHwPos ActivePull ApXcp Assist AssistFirewall AstLmt AvgFricLrn BVDiag BatteryVoltage BkCpPc CDDInterface CmMtrCurr ComplErr CtrlTemp CtrldDisShtdn CurrCmd CurrParamComp Damping DampingFirewall DiagMgr10 DiagMgr8 DiagMgr9 DiagSvc DigHwTrqSENT DigMSB DigPhsReasDiag EOTActuatorMng ElePwr EtDmpFw FltInjection FrqDepDmpnInrtCmp Gsod HiLoadStall HighFreqAssist HwPwUp HystComp IoHwAbstractionUsr LmtCod LrnEOT MtrDrvDiag MtrTempEst MtrVel MtrVel2 Nhet1 OvrVoltMon PICurrCntrl PeakCurrEst Polarity PwrLmtFuncCr QuadDet Return ReturnFirewall RteErrata RteErrata8 RteErrata9 Sa_DigColPs SignlCondn SrlComInput SrlComOutput StOpCtrl StaMd StaMd8 StaMd9 StabilityComp StabilityComp2 Sweep Sweep2 ThrmlDutyCycle TmprlMon TqRsDg TrqCanc TrqCmdScl TuningSelAuth VehDyn VehPwrMd VehSpdLmt ePWM2 /end SUB_GROUP
 /begin FUNCTION_LIST /end FUNCTION_LIST
 /begin REF_CHARACTERISTIC /end REF_CHARACTERISTIC
 /begin REF_MEASUREMENT /end REF_MEASUREMENT
/end GROUP
/begin GROUP Sa_DigColPs "MICROSAR RTE"
 /begin SUB_GROUP Sa_DigColPs.PerInstanceMemories Sa_DigColPs.ReceiverPorts Sa_DigColPs.SenderPorts /end SUB_GROUP
 /begin FUNCTION_LIST /end FUNCTION_LIST
 /begin REF_CHARACTERISTIC /end REF_CHARACTERISTIC
 /begin REF_MEASUREMENT /end REF_MEASUREMENT
/end GROUP
/begin GROUP Sa_DigColPs.DigColPsEOL "MICROSAR RTE" /begin SUB_GROUP /end SUB_GROUP /begin FUNCTION_LIST /end FUNCTION_LIST /begin REF_CHARACTERISTIC /end REF_CHARACTERISTIC
 /begin REF_MEASUREMENT Rte_Sa_DigColPs_DigColPsEOL.ColTrim_Deg_f32 Rte_Sa_DigColPs_DigColPsEOL.R_ColTrim_Cnt_u32 Rte_Sa_DigColPs_DigColPsEOL.R_SpurTrim_Cnt_u32 Rte_Sa_DigColPs_DigColPsEOL.R_TrimCom_Cnt_u16 Rte_Sa_DigColPs_DigColPsEOL.SpurTrim_Deg_f32 Rte_Sa_DigColPs_DigColPsEOL.TrimComp_Cnt_u16 /end REF_MEASUREMENT
/end GROUP
/begin GROUP Sa_DigColPs.I2CHwAbsPos.HwDeg_f32 "MICROSAR RTE" /begin SUB_GROUP /end SUB_GROUP /begin FUNCTION_LIST /end FUNCTION_LIST /begin REF_CHARACTERISTIC /end REF_CHARACTERISTIC /end GROUP
/begin GROUP Sa_DigColPs.I2CHwAbsPosValid.Cnt_lgc "MICROSAR RTE" /begin SUB_GROUP /end SUB_GROUP /begin FUNCTION_LIST /end FUNCTION_LIST /begin REF_CHARACTERISTIC /end REF_CHARACTERISTIC /end GROUP
/begin GROUP Sa_DigColPs.MecState.Cnt_enum "MICROSAR RTE" /begin SUB_GROUP /end SUB_GROUP /begin FUNCTION_LIST /end FUNCTION_LIST /begin REF_CHARACTERISTIC /end REF_CHARACTERISTIC /end GROUP
/begin GROUP Sa_DigColPs.PerInstanceMemories "MICROSAR RTE" /begin SUB_GROUP Sa_DigColPs.DigColPsEOL /end SUB_GROUP /begin FUNCTION_LIST /end FUNCTION_LIST /begin REF_CHARACTERISTIC /end REF_CHARACTERISTIC /begin REF_MEASUREMENT /end REF_MEASUREMENT /end GROUP
/begin GROUP Sa_DigColPs.ReceiverPorts "MICROSAR RTE" /begin SUB_GROUP Sa_DigColPs.MecState.Cnt_enum /end SUB_GROUP /begin FUNCTION_LIST /end FUNCTION_LIST /begin REF_CHARACTERISTIC /end REF_CHARACTERISTIC /begin REF_MEASUREMENT /end REF_MEASUREMENT /end GROUP
/begin GROUP Sa_DigColPs.SenderPorts "MICROSAR RTE"
 /begin SUB_GROUP Sa_DigColPs.I2CHwAbsPos.HwDeg_f32 Sa_DigColPs.I2CHwAbsPosValid.Cnt_lgc Sa_DigColPs.TrimComp.Cnt_lgc /end SUB_GROUP
 /begin FUNCTION_LIST /end FUNCTION_LIST
 /begin REF_CHARACTERISTIC /end REF_CHARACTERISTIC
 /begin REF_MEASUREMENT /end REF_MEASUREMENT
/end GROUP
/begin GROUP Sa_DigColPs.TrimComp.Cnt_lgc "MICROSAR RTE" /begin SUB_GROUP /end SUB_GROUP /begin FUNCTION_LIST /end FUNCTION_LIST /begin REF_CHARACTERISTIC /end REF_CHARACTERISTIC /begin REF_MEASUREMENT Rte_Sa_DigColPs_TrimComp_Cnt_lgc /end REF_MEASUREMENT /end GROUP
/begin GROUP SignlCondn "MICROSAR RTE" /begin SUB_GROUP SignlCondn.ReceiverPorts SignlCondn.SenderPorts /end SUB_GROUP /begin FUNCTION_LIST /end FUNCTION_LIST /begin REF_CHARACTERISTIC /end REF_CHARACTERISTIC /begin REF_MEASUREMENT /end REF_MEASUREMENT /end GROUP
/begin GROUP SignlCondn.ReceiverPorts "MICROSAR RTE"
 /begin SUB_GROUP SignlCondn.SrlComVehSpeed.Kph_f32 SignlCondn.SrlCom_VehicleLonAccel.KphpS_f32 /end SUB_GROUP
 /begin FUNCTION_LIST /end FUNCTION_LIST
 /begin REF_CHARACTERISTIC /end REF_CHARACTERISTIC
 /begin REF_MEASUREMENT /end REF_MEASUREMENT
/end GROUP
/begin GROUP SignlCondn.SenderPorts "MICROSAR RTE"
 /begin SUB_GROUP SignlCondn.VehicleSpeed.Kph_f32 SignlCondn.Vehicle_LonAccel.KphpS_f32 /end SUB_GROUP
 /begin FUNCTION_LIST /end FUNCTION_LIST
 /begin REF_CHARACTERISTIC /end REF_CHARACTERISTIC
 /begin REF_MEASUREMENT /end REF_MEASUREMENT
/end GROUP
/begin GROUP SignlCondn.SrlComVehSpeed.Kph_f32 "MICROSAR RTE" /begin SUB_GROUP /end SUB_GROUP /begin FUNCTION_LIST /end FUNCTION_LIST /begin REF_CHARACTERISTIC /end REF_CHARACTERISTIC /begin REF_MEASUREMENT Rte_SrlComInput_SrlComVehSpd_Kph_f32 /end REF_MEASUREMENT /end GROUP
/begin GROUP SignlCondn.SrlCom_VehicleLonAccel.KphpS_f32 "MICROSAR RTE" /begin SUB_GROUP /end SUB_GROUP /begin FUNCTION_LIST /end FUNCTION_LIST /begin REF_CHARACTERISTIC /end REF_CHARACTERISTIC /begin REF_MEASUREMENT Rte_SignlCondn_SrlCom_VehicleLonAccel_KphpS_f32 /end REF_MEASUREMENT /end GROUP
/begin GROUP SignlCondn.VehicleSpeed.Kph_f32 "MICROSAR RTE" /begin SUB_GROUP /end SUB_GROUP /begin FUNCTION_LIST /end FUNCTION_LIST /begin REF_CHARACTERISTIC /end REF_CHARACTERISTIC /end GROUP
/begin GROUP SignlCondn.Vehicle_LonAccel.KphpS_f32 "MICROSAR RTE" /begin SUB_GROUP /end SUB_GROUP /begin FUNCTION_LIST /end FUNCTION_LIST /begin REF_CHARACTERISTIC /end REF_CHARACTERISTIC /begin REF_MEASUREMENT Rte_SignlCondn_Vehicle_LonAccel_KphpS_f32 /end REF_MEASUREMENT /end GROUP
/begin GROUP SrlComInput "MICROSAR RTE"
 /begin SUB_GROUP SrlComInput.ModeRequirePorts SrlComInput.ReceiverPorts SrlComInput.SenderPorts /end SUB_GROUP
 /begin FUNCTION_LIST /end FUNCTION_LIST
 /begin REF_CHARACTERISTIC /end REF_CHARACTERISTIC
 /begin REF_MEASUREMENT /end REF_MEASUREMENT
/end GROUP
/begin GROUP SrlComInput.Batt.Volt_f32 "MICROSAR RTE" /begin SUB_GROUP /end SUB_GROUP /begin FUNCTION_LIST /end FUNCTION_LIST /begin REF_CHARACTERISTIC /end REF_CHARACTERISTIC /end GROUP
/begin GROUP SrlComInput.DefaultVehSpd.Cnt_lgc "MICROSAR RTE" /begin SUB_GROUP /end SUB_GROUP /begin FUNCTION_LIST /end FUNCTION_LIST /begin REF_CHARACTERISTIC /end REF_CHARACTERISTIC /end GROUP
/begin GROUP SrlComInput.DesiredTunPers.Cnt_u16 "MICROSAR RTE" /begin SUB_GROUP /end SUB_GROUP /begin FUNCTION_LIST /end FUNCTION_LIST /begin REF_CHARACTERISTIC /end REF_CHARACTERISTIC /begin REF_MEASUREMENT Rte_SrlComInput_DesiredTunPers_Cnt_u16 /end REF_MEASUREMENT /end GROUP
/begin GROUP SrlComInput.IgnitionPreStart.Cnt_lgc "MICROSAR RTE" /begin SUB_GROUP /end SUB_GROUP /begin FUNCTION_LIST /end FUNCTION_LIST /begin REF_CHARACTERISTIC /end REF_CHARACTERISTIC /end GROUP
/begin GROUP SrlComInput.MEC.Cnt_enum "MICROSAR RTE" /begin SUB_GROUP /end SUB_GROUP /begin FUNCTION_LIST /end FUNCTION_LIST /begin REF_CHARACTERISTIC /end REF_CHARACTERISTIC /end GROUP
/begin GROUP SrlComInput.ModeRequirePorts "MICROSAR RTE" /begin SUB_GROUP SrlComInput.SystemState.Mode /end SUB_GROUP /begin FUNCTION_LIST /end FUNCTION_LIST /begin REF_CHARACTERISTIC /end REF_CHARACTERISTIC /begin REF_MEASUREMENT /end REF_MEASUREMENT /end GROUP
/begin GROUP SrlComInput.ReceiverPorts "MICROSAR RTE"
 /begin SUB_GROUP SrlComInput.Batt.Volt_f32 SrlComInput.DefaultVehSpd.Cnt_lgc SrlComInput.IgnitionPreStart.Cnt_lgc SrlComInput.MEC.Cnt_enum SrlComInput.RxMsgsSrlComSvcDft.Cnt_lgc /end SUB_GROUP
 /begin FUNCTION_LIST /end FUNCTION_LIST
 /begin REF_CHARACTERISTIC /end REF_CHARACTERISTIC
 /begin REF_MEASUREMENT /end REF_MEASUREMENT
/end GROUP
/begin GROUP SrlComInput.RxMsgsSrlComSvcDft.Cnt_lgc "MICROSAR RTE" /begin SUB_GROUP /end SUB_GROUP /begin FUNCTION_LIST /end FUNCTION_LIST /begin REF_CHARACTERISTIC /end REF_CHARACTERISTIC /end GROUP
/begin GROUP SrlComInput.SenderPorts "MICROSAR RTE"
 /begin SUB_GROUP SrlComInput.DesiredTunPers.Cnt_u16 SrlComInput.SrlComVehSpd.Kph_f32 /end SUB_GROUP
 /begin FUNCTION_LIST /end FUNCTION_LIST
 /begin REF_CHARACTERISTIC /end REF_CHARACTERISTIC
 /begin REF_MEASUREMENT /end REF_MEASUREMENT
/end GROUP
/begin GROUP SrlComInput.SrlComVehSpd.Kph_f32 "MICROSAR RTE" /begin SUB_GROUP /end SUB_GROUP /begin FUNCTION_LIST /end FUNCTION_LIST /begin REF_CHARACTERISTIC /end REF_CHARACTERISTIC /begin REF_MEASUREMENT Rte_SrlComInput_SrlComVehSpd_Kph_f32 /end REF_MEASUREMENT /end GROUP
/begin GROUP SrlComInput.SystemState.Mode "MICROSAR RTE" /begin SUB_GROUP /end SUB_GROUP /begin FUNCTION_LIST /end FUNCTION_LIST /begin REF_CHARACTERISTIC /end REF_CHARACTERISTIC /end GROUP
/begin GROUP SrlComOutput "MICROSAR RTE" /begin SUB_GROUP SrlComOutput.ModeRequirePorts SrlComOutput.ReceiverPorts /end SUB_GROUP /begin FUNCTION_LIST /end FUNCTION_LIST /begin REF_CHARACTERISTIC /end REF_CHARACTERISTIC /begin REF_MEASUREMENT /end REF_MEASUREMENT /end GROUP
/begin GROUP SrlComOutput.HandwheelAuthority.Uls_f32 "MICROSAR RTE" /begin SUB_GROUP /end SUB_GROUP /begin FUNCTION_LIST /end FUNCTION_LIST /begin REF_CHARACTERISTIC /end REF_CHARACTERISTIC /end GROUP
/begin GROUP SrlComOutput.HandwheelPosition.HwDeg_f32 "MICROSAR RTE" /begin SUB_GROUP /end SUB_GROUP /begin FUNCTION_LIST /end FUNCTION_LIST /begin REF_CHARACTERISTIC /end REF_CHARACTERISTIC /end GROUP
/begin GROUP SrlComOutput.ModeRequirePorts "MICROSAR RTE" /begin SUB_GROUP SrlComOutput.SystemState.Mode /end SUB_GROUP /begin FUNCTION_LIST /end FUNCTION_LIST /begin REF_CHARACTERISTIC /end REF_CHARACTERISTIC /begin REF_MEASUREMENT /end REF_MEASUREMENT /end GROUP
/begin GROUP SrlComOutput.ReceiverPorts "MICROSAR RTE"
 /begin SUB_GROUP SrlComOutput.HandwheelAuthority.Uls_f32 SrlComOutput.HandwheelPosition.HwDeg_f32 SrlComOutput.SrlComHwPosStatus.Cnt_u16 SrlComOutput.SrlComHwTrq.HwNm_f32 SrlComOutput.SrlComHwTrqValid.Cnt_lgc SrlComOutput.SupplyCurrent.Amp_f32 /end SUB_GROUP
 /begin FUNCTION_LIST /end FUNCTION_LIST
 /begin REF_CHARACTERISTIC /end REF_CHARACTERISTIC
 /begin REF_MEASUREMENT /end REF_MEASUREMENT
/end GROUP
/begin GROUP SrlComOutput.SrlComHwPosStatus.Cnt_u16 "MICROSAR RTE" /begin SUB_GROUP /end SUB_GROUP /begin FUNCTION_LIST /end FUNCTION_LIST /begin REF_CHARACTERISTIC /end REF_CHARACTERISTIC /end GROUP
/begin GROUP SrlComOutput.SrlComHwTrq.HwNm_f32 "MICROSAR RTE" /begin SUB_GROUP /end SUB_GROUP /begin FUNCTION_LIST /end FUNCTION_LIST /begin REF_CHARACTERISTIC /end REF_CHARACTERISTIC /end GROUP
/begin GROUP SrlComOutput.SrlComHwTrqValid.Cnt_lgc "MICROSAR RTE" /begin SUB_GROUP /end SUB_GROUP /begin FUNCTION_LIST /end FUNCTION_LIST /begin REF_CHARACTERISTIC /end REF_CHARACTERISTIC /end GROUP
/begin GROUP SrlComOutput.SupplyCurrent.Amp_f32 "MICROSAR RTE" /begin SUB_GROUP /end SUB_GROUP /begin FUNCTION_LIST /end FUNCTION_LIST /begin REF_CHARACTERISTIC /end REF_CHARACTERISTIC /end GROUP
/begin GROUP SrlComOutput.SystemState.Mode "MICROSAR RTE" /begin SUB_GROUP /end SUB_GROUP /begin FUNCTION_LIST /end FUNCTION_LIST /begin REF_CHARACTERISTIC /end REF_CHARACTERISTIC /end GROUP
/begin GROUP StOpCtrl "MICROSAR RTE" /begin SUB_GROUP StOpCtrl.ReceiverPorts StOpCtrl.SenderPorts /end SUB_GROUP /begin FUNCTION_LIST /end FUNCTION_LIST /begin REF_CHARACTERISTIC /end REF_CHARACTERISTIC /begin REF_MEASUREMENT /end REF_MEASUREMENT /end GROUP
/begin GROUP StOpCtrl.DiagRampRate.XpmS_f32 "MICROSAR RTE" /begin SUB_GROUP /end SUB_GROUP /begin FUNCTION_LIST /end FUNCTION_LIST /begin REF_CHARACTERISTIC /end REF_CHARACTERISTIC /end GROUP
/begin GROUP StOpCtrl.DiagRampValue.Uls_f32 "MICROSAR RTE" /begin SUB_GROUP /end SUB_GROUP /begin FUNCTION_LIST /end FUNCTION_LIST /begin REF_CHARACTERISTIC /end REF_CHARACTERISTIC /end GROUP
/begin GROUP StOpCtrl.DiagStsDiagRmpActive.Cnt_lgc "MICROSAR RTE" /begin SUB_GROUP /end SUB_GROUP /begin FUNCTION_LIST /end FUNCTION_LIST /begin REF_CHARACTERISTIC /end REF_CHARACTERISTIC /end GROUP
/begin GROUP StOpCtrl.OperRampRate.XpmS_f32 "MICROSAR RTE" /begin SUB_GROUP /end SUB_GROUP /begin FUNCTION_LIST /end FUNCTION_LIST /begin REF_CHARACTERISTIC /end REF_CHARACTERISTIC /begin REF_MEASUREMENT Rte_VehPwrMd_OperRampRate_XpmS_f32 /end REF_MEASUREMENT /end GROUP
/begin GROUP StOpCtrl.OperRampValue.Uls_f32 "MICROSAR RTE" /begin SUB_GROUP /end SUB_GROUP /begin FUNCTION_LIST /end FUNCTION_LIST /begin REF_CHARACTERISTIC /end REF_CHARACTERISTIC /begin REF_MEASUREMENT Rte_VehPwrMd_OperRampValue_Uls_f32 /end REF_MEASUREMENT /end GROUP
/begin GROUP StOpCtrl.OutputRampMult.Uls_f32 "MICROSAR RTE" /begin SUB_GROUP /end SUB_GROUP /begin FUNCTION_LIST /end FUNCTION_LIST /begin REF_CHARACTERISTIC /end REF_CHARACTERISTIC /begin REF_MEASUREMENT Rte_StOpCtrl_OutputRampMult_Uls_f32 /end REF_MEASUREMENT /end GROUP
/begin GROUP StOpCtrl.RampDwnStatusComplete.Cnt_lgc "MICROSAR RTE" /begin SUB_GROUP /end SUB_GROUP /begin FUNCTION_LIST /end FUNCTION_LIST /begin REF_CHARACTERISTIC /end REF_CHARACTERISTIC /begin REF_MEASUREMENT Rte_StOpCtrl_RampDwnStatusComplete_Cnt_lgc /end REF_MEASUREMENT /end GROUP
/begin GROUP StOpCtrl.RampSrlComSvcDft.Cnt_lgc "MICROSAR RTE" /begin SUB_GROUP /end SUB_GROUP /begin FUNCTION_LIST /end FUNCTION_LIST /begin REF_CHARACTERISTIC /end REF_CHARACTERISTIC /end GROUP
/begin GROUP StOpCtrl.ReceiverPorts "MICROSAR RTE"
 /begin SUB_GROUP StOpCtrl.DiagRampRate.XpmS_f32 StOpCtrl.DiagRampValue.Uls_f32 StOpCtrl.DiagStsDiagRmpActive.Cnt_lgc StOpCtrl.OperRampRate.XpmS_f32 StOpCtrl.OperRampValue.Uls_f32 StOpCtrl.RampSrlComSvcDft.Cnt_lgc /end SUB_GROUP
 /begin FUNCTION_LIST /end FUNCTION_LIST
 /begin REF_CHARACTERISTIC /end REF_CHARACTERISTIC
 /begin REF_MEASUREMENT /end REF_MEASUREMENT
/end GROUP
/begin GROUP StOpCtrl.SenderPorts "MICROSAR RTE"
 /begin SUB_GROUP StOpCtrl.OutputRampMult.Uls_f32 StOpCtrl.RampDwnStatusComplete.Cnt_lgc /end SUB_GROUP
 /begin FUNCTION_LIST /end FUNCTION_LIST
 /begin REF_CHARACTERISTIC /end REF_CHARACTERISTIC
 /begin REF_MEASUREMENT /end REF_MEASUREMENT
/end GROUP
/begin GROUP StaMd "MICROSAR RTE"
 /begin SUB_GROUP StaMd.ModeProvidePorts StaMd.ModeRequirePorts StaMd.ReceiverPorts StaMd.SenderPorts /end SUB_GROUP
 /begin FUNCTION_LIST /end FUNCTION_LIST
 /begin REF_CHARACTERISTIC /end REF_CHARACTERISTIC
 /begin REF_MEASUREMENT /end REF_MEASUREMENT
/end GROUP
/begin GROUP StaMd.ATerm.Cnt_lgc "MICROSAR RTE" /begin SUB_GROUP /end SUB_GROUP /begin FUNCTION_LIST /end FUNCTION_LIST /begin REF_CHARACTERISTIC /end REF_CHARACTERISTIC /begin REF_MEASUREMENT Rte_VehPwrMd_ATermActive_Cnt_lgc /end REF_MEASUREMENT /end GROUP
/begin GROUP StaMd.CTerm.Cnt_lgc "MICROSAR RTE" /begin SUB_GROUP /end SUB_GROUP /begin FUNCTION_LIST /end FUNCTION_LIST /begin REF_CHARACTERISTIC /end REF_CHARACTERISTIC /begin REF_MEASUREMENT Rte_VehPwrMd_CTermActive_Cnt_lgc /end REF_MEASUREMENT /end GROUP
/begin GROUP StaMd.ControlledDampStatusComplete.Cnt_lgc "MICROSAR RTE" /begin SUB_GROUP /end SUB_GROUP /begin FUNCTION_LIST /end FUNCTION_LIST /begin REF_CHARACTERISTIC /end REF_CHARACTERISTIC /end GROUP
/begin GROUP StaMd.CurrentSystemState.Mode "MICROSAR RTE" /begin SUB_GROUP /end SUB_GROUP /begin FUNCTION_LIST /end FUNCTION_LIST /begin REF_CHARACTERISTIC /end REF_CHARACTERISTIC /end GROUP
/begin GROUP StaMd.FTerm.Cnt_lgc "MICROSAR RTE" /begin SUB_GROUP /end SUB_GROUP /begin FUNCTION_LIST /end FUNCTION_LIST /begin REF_CHARACTERISTIC /end REF_CHARACTERISTIC /end GROUP
/begin GROUP StaMd.InitiatePwrDnFastWrite.Cnt_lgc "MICROSAR RTE" /begin SUB_GROUP /end SUB_GROUP /begin FUNCTION_LIST /end FUNCTION_LIST /begin REF_CHARACTERISTIC /end REF_CHARACTERISTIC /begin REF_MEASUREMENT Rte_StaMd_InitiatePwrDnFastWrite_Cnt_lgc /end REF_MEASUREMENT /end GROUP
/begin GROUP StaMd.InitiatePwrDnNormalWrite.Cnt_lgc "MICROSAR RTE" /begin SUB_GROUP /end SUB_GROUP /begin FUNCTION_LIST /end FUNCTION_LIST /begin REF_CHARACTERISTIC /end REF_CHARACTERISTIC /begin REF_MEASUREMENT Rte_StaMd_InitiatePwrDnNormalWrite_Cnt_lgc /end REF_MEASUREMENT /end GROUP
/begin GROUP StaMd.ModeProvidePorts "MICROSAR RTE" /begin SUB_GROUP StaMd.SystemState.Mode /end SUB_GROUP /begin FUNCTION_LIST /end FUNCTION_LIST /begin REF_CHARACTERISTIC /end REF_CHARACTERISTIC /begin REF_MEASUREMENT /end REF_MEASUREMENT /end GROUP
/begin GROUP StaMd.ModeRequirePorts "MICROSAR RTE" /begin SUB_GROUP StaMd.CurrentSystemState.Mode /end SUB_GROUP /begin FUNCTION_LIST /end FUNCTION_LIST /begin REF_CHARACTERISTIC /end REF_CHARACTERISTIC /begin REF_MEASUREMENT /end REF_MEASUREMENT /end GROUP
/begin GROUP StaMd.PwrDnFastWriteComplete.Cnt_lgc "MICROSAR RTE" /begin SUB_GROUP /end SUB_GROUP /begin FUNCTION_LIST /end FUNCTION_LIST /begin REF_CHARACTERISTIC /end REF_CHARACTERISTIC /begin REF_MEASUREMENT Rte_StaMd_PwrDnFastWriteComplete_Cnt_lgc /end REF_MEASUREMENT /end GROUP
/begin GROUP StaMd.RampStatusComplete.Cnt_lgc "MICROSAR RTE" /begin SUB_GROUP /end SUB_GROUP /begin FUNCTION_LIST /end FUNCTION_LIST /begin REF_CHARACTERISTIC /end REF_CHARACTERISTIC /begin REF_MEASUREMENT Rte_StOpCtrl_RampDwnStatusComplete_Cnt_lgc /end REF_MEASUREMENT /end GROUP
/begin GROUP StaMd.ReceiverPorts "MICROSAR RTE"
 /begin SUB_GROUP StaMd.ATerm.Cnt_lgc StaMd.CTerm.Cnt_lgc StaMd.ControlledDampStatusComplete.Cnt_lgc StaMd.FTerm.Cnt_lgc StaMd.RampStatusComplete.Cnt_lgc StaMd.TMFTestComplete.Cnt_lgc /end SUB_GROUP
 /begin FUNCTION_LIST /end FUNCTION_LIST
 /begin REF_CHARACTERISTIC /end REF_CHARACTERISTIC
 /begin REF_MEASUREMENT /end REF_MEASUREMENT
/end GROUP
/begin GROUP StaMd.SenderPorts "MICROSAR RTE"
 /begin SUB_GROUP StaMd.InitiatePwrDnFastWrite.Cnt_lgc StaMd.InitiatePwrDnNormalWrite.Cnt_lgc StaMd.PwrDnFastWriteComplete.Cnt_lgc /end SUB_GROUP
 /begin FUNCTION_LIST /end FUNCTION_LIST
 /begin REF_CHARACTERISTIC /end REF_CHARACTERISTIC
 /begin REF_MEASUREMENT /end REF_MEASUREMENT
/end GROUP
/begin GROUP StaMd.SystemState.Mode "MICROSAR RTE" /begin SUB_GROUP /end SUB_GROUP /begin FUNCTION_LIST /end FUNCTION_LIST /begin REF_CHARACTERISTIC /end REF_CHARACTERISTIC /end GROUP
/begin GROUP StaMd.TMFTestComplete.Cnt_lgc "MICROSAR RTE" /begin SUB_GROUP /end SUB_GROUP /begin FUNCTION_LIST /end FUNCTION_LIST /begin REF_CHARACTERISTIC /end REF_CHARACTERISTIC /end GROUP
/begin GROUP StaMd8 "MICROSAR RTE" /begin SUB_GROUP StaMd8.ModeProvidePorts StaMd8.ReceiverPorts /end SUB_GROUP /begin FUNCTION_LIST /end FUNCTION_LIST /begin REF_CHARACTERISTIC /end REF_CHARACTERISTIC /begin REF_MEASUREMENT /end REF_MEASUREMENT /end GROUP
/begin GROUP StaMd8.ATerm.Cnt_lgc "MICROSAR RTE" /begin SUB_GROUP /end SUB_GROUP /begin FUNCTION_LIST /end FUNCTION_LIST /begin REF_CHARACTERISTIC /end REF_CHARACTERISTIC /begin REF_MEASUREMENT Rte_VehPwrMd_ATermActive_Cnt_lgc /end REF_MEASUREMENT /end GROUP
/begin GROUP StaMd8.CTerm.Cnt_lgc "MICROSAR RTE" /begin SUB_GROUP /end SUB_GROUP /begin FUNCTION_LIST /end FUNCTION_LIST /begin REF_CHARACTERISTIC /end REF_CHARACTERISTIC /begin REF_MEASUREMENT Rte_VehPwrMd_CTermActive_Cnt_lgc /end REF_MEASUREMENT /end GROUP
/begin GROUP StaMd8.ControlledDampStatusComplete.Cnt_lgc "MICROSAR RTE" /begin SUB_GROUP /end SUB_GROUP /begin FUNCTION_LIST /end FUNCTION_LIST /begin REF_CHARACTERISTIC /end REF_CHARACTERISTIC /end GROUP
/begin GROUP StaMd8.FTerm.Cnt_lgc "MICROSAR RTE" /begin SUB_GROUP /end SUB_GROUP /begin FUNCTION_LIST /end FUNCTION_LIST /begin REF_CHARACTERISTIC /end REF_CHARACTERISTIC /end GROUP
/begin GROUP StaMd8.ModeProvidePorts "MICROSAR RTE" /begin SUB_GROUP StaMd8.SystemState8.Mode /end SUB_GROUP /begin FUNCTION_LIST /end FUNCTION_LIST /begin REF_CHARACTERISTIC /end REF_CHARACTERISTIC /begin REF_MEASUREMENT /end REF_MEASUREMENT /end GROUP
/begin GROUP StaMd8.RampStatusComplete.Cnt_lgc "MICROSAR RTE" /begin SUB_GROUP /end SUB_GROUP /begin FUNCTION_LIST /end FUNCTION_LIST /begin REF_CHARACTERISTIC /end REF_CHARACTERISTIC /begin REF_MEASUREMENT Rte_StOpCtrl_RampDwnStatusComplete_Cnt_lgc /end REF_MEASUREMENT /end GROUP
/begin GROUP StaMd8.ReceiverPorts "MICROSAR RTE"
 /begin SUB_GROUP StaMd8.ATerm.Cnt_lgc StaMd8.CTerm.Cnt_lgc StaMd8.ControlledDampStatusComplete.Cnt_lgc StaMd8.FTerm.Cnt_lgc StaMd8.RampStatusComplete.Cnt_lgc StaMd8.TMFTestComplete.Cnt_lgc /end SUB_GROUP
 /begin FUNCTION_LIST /end FUNCTION_LIST
 /begin REF_CHARACTERISTIC /end REF_CHARACTERISTIC
 /begin REF_MEASUREMENT /end REF_MEASUREMENT
/end GROUP
/begin GROUP StaMd8.SystemState8.Mode "MICROSAR RTE" /begin SUB_GROUP /end SUB_GROUP /begin FUNCTION_LIST /end FUNCTION_LIST /begin REF_CHARACTERISTIC /end REF_CHARACTERISTIC /end GROUP
/begin GROUP StaMd8.TMFTestComplete.Cnt_lgc "MICROSAR RTE" /begin SUB_GROUP /end SUB_GROUP /begin FUNCTION_LIST /end FUNCTION_LIST /begin REF_CHARACTERISTIC /end REF_CHARACTERISTIC /end GROUP
/begin GROUP StaMd9 "MICROSAR RTE" /begin SUB_GROUP StaMd9.ModeProvidePorts /end SUB_GROUP /begin FUNCTION_LIST /end FUNCTION_LIST /begin REF_CHARACTERISTIC /end REF_CHARACTERISTIC /begin REF_MEASUREMENT /end REF_MEASUREMENT /end GROUP
/begin GROUP StaMd9.ModeProvidePorts "MICROSAR RTE" /begin SUB_GROUP StaMd9.SystemState9.Mode /end SUB_GROUP /begin FUNCTION_LIST /end FUNCTION_LIST /begin REF_CHARACTERISTIC /end REF_CHARACTERISTIC /begin REF_MEASUREMENT /end REF_MEASUREMENT /end GROUP
/begin GROUP StaMd9.SystemState9.Mode "MICROSAR RTE" /begin SUB_GROUP /end SUB_GROUP /begin FUNCTION_LIST /end FUNCTION_LIST /begin REF_CHARACTERISTIC /end REF_CHARACTERISTIC /end GROUP
/begin GROUP StabilityComp "MICROSAR RTE" /begin SUB_GROUP StabilityComp.ReceiverPorts StabilityComp.SenderPorts /end SUB_GROUP /begin FUNCTION_LIST /end FUNCTION_LIST /begin REF_CHARACTERISTIC /end REF_CHARACTERISTIC /begin REF_MEASUREMENT /end REF_MEASUREMENT /end GROUP
/begin GROUP StabilityComp.AssistCmd.MtrNm_f32 "MICROSAR RTE" /begin SUB_GROUP /end SUB_GROUP /begin FUNCTION_LIST /end FUNCTION_LIST /begin REF_CHARACTERISTIC /end REF_CHARACTERISTIC /end GROUP
/begin GROUP StabilityComp.AssistDDFactor.Uls_f32 "MICROSAR RTE" /begin SUB_GROUP /end SUB_GROUP /begin FUNCTION_LIST /end FUNCTION_LIST /begin REF_CHARACTERISTIC /end REF_CHARACTERISTIC /begin REF_MEASUREMENT Rte_StabilityComp_AssistDDFactor_Uls_f32 /end REF_MEASUREMENT /end GROUP
/begin GROUP StabilityComp.AsstFWActive.Uls_f32 "MICROSAR RTE" /begin SUB_GROUP /end SUB_GROUP /begin FUNCTION_LIST /end FUNCTION_LIST /begin REF_CHARACTERISTIC /end REF_CHARACTERISTIC /end GROUP
/begin GROUP StabilityComp.CombinedAssist.MtrNm_f32 "MICROSAR RTE" /begin SUB_GROUP /end SUB_GROUP /begin FUNCTION_LIST /end FUNCTION_LIST /begin REF_CHARACTERISTIC /end REF_CHARACTERISTIC /end GROUP
/begin GROUP StabilityComp.HwTorque.HwNm_f32 "MICROSAR RTE" /begin SUB_GROUP /end SUB_GROUP /begin FUNCTION_LIST /end FUNCTION_LIST /begin REF_CHARACTERISTIC /end REF_CHARACTERISTIC /end GROUP
/begin GROUP StabilityComp.ReceiverPorts "MICROSAR RTE"
 /begin SUB_GROUP StabilityComp.AssistDDFactor.Uls_f32 StabilityComp.AsstFWActive.Uls_f32 StabilityComp.CombinedAssist.MtrNm_f32 StabilityComp.HwTorque.HwNm_f32 StabilityComp.SysAssistCmd_MtrNm.MtrNm_f32 StabilityComp.VehicleSpeed.Kph_f32 /end SUB_GROUP
 /begin FUNCTION_LIST /end FUNCTION_LIST
 /begin REF_CHARACTERISTIC /end REF_CHARACTERISTIC
 /begin REF_MEASUREMENT /end REF_MEASUREMENT
/end GROUP
/begin GROUP StabilityComp.SenderPorts "MICROSAR RTE" /begin SUB_GROUP StabilityComp.AssistCmd.MtrNm_f32 /end SUB_GROUP /begin FUNCTION_LIST /end FUNCTION_LIST /begin REF_CHARACTERISTIC /end REF_CHARACTERISTIC /begin REF_MEASUREMENT /end REF_MEASUREMENT /end GROUP
/begin GROUP StabilityComp.SysAssistCmd_MtrNm.MtrNm_f32 "MICROSAR RTE" /begin SUB_GROUP /end SUB_GROUP /begin FUNCTION_LIST /end FUNCTION_LIST /begin REF_CHARACTERISTIC /end REF_CHARACTERISTIC /begin REF_MEASUREMENT Rte_StabilityComp2_SysAssistCmd_MtrNm_f32 /end REF_MEASUREMENT /end GROUP
/begin GROUP StabilityComp.VehicleSpeed.Kph_f32 "MICROSAR RTE" /begin SUB_GROUP /end SUB_GROUP /begin FUNCTION_LIST /end FUNCTION_LIST /begin REF_CHARACTERISTIC /end REF_CHARACTERISTIC /end GROUP
/begin GROUP StabilityComp2 "MICROSAR RTE" /begin SUB_GROUP StabilityComp2.ReceiverPorts StabilityComp2.SenderPorts /end SUB_GROUP /begin FUNCTION_LIST /end FUNCTION_LIST /begin REF_CHARACTERISTIC /end REF_CHARACTERISTIC /begin REF_MEASUREMENT /end REF_MEASUREMENT /end GROUP
/begin GROUP StabilityComp2.AssistDDFactor.Uls_f32 "MICROSAR RTE" /begin SUB_GROUP /end SUB_GROUP /begin FUNCTION_LIST /end FUNCTION_LIST /begin REF_CHARACTERISTIC /end REF_CHARACTERISTIC /begin REF_MEASUREMENT Rte_StabilityComp2_AssistDDFactor_Uls_f32 /end REF_MEASUREMENT /end GROUP
/begin GROUP StabilityComp2.AsstFWActive.Uls_f32 "MICROSAR RTE" /begin SUB_GROUP /end SUB_GROUP /begin FUNCTION_LIST /end FUNCTION_LIST /begin REF_CHARACTERISTIC /end REF_CHARACTERISTIC /end GROUP
/begin GROUP StabilityComp2.CombinedAssist.MtrNm_f32 "MICROSAR RTE" /begin SUB_GROUP /end SUB_GROUP /begin FUNCTION_LIST /end FUNCTION_LIST /begin REF_CHARACTERISTIC /end REF_CHARACTERISTIC /end GROUP
/begin GROUP StabilityComp2.HwTorque.HwNm_f32 "MICROSAR RTE" /begin SUB_GROUP /end SUB_GROUP /begin FUNCTION_LIST /end FUNCTION_LIST /begin REF_CHARACTERISTIC /end REF_CHARACTERISTIC /end GROUP
/begin GROUP StabilityComp2.ReceiverPorts "MICROSAR RTE"
 /begin SUB_GROUP StabilityComp2.AssistDDFactor.Uls_f32 StabilityComp2.AsstFWActive.Uls_f32 StabilityComp2.CombinedAssist.MtrNm_f32 StabilityComp2.HwTorque.HwNm_f32 StabilityComp2.VehicleSpeed.Kph_f32 /end SUB_GROUP
 /begin FUNCTION_LIST /end FUNCTION_LIST
 /begin REF_CHARACTERISTIC /end REF_CHARACTERISTIC
 /begin REF_MEASUREMENT /end REF_MEASUREMENT
/end GROUP
/begin GROUP StabilityComp2.SenderPorts "MICROSAR RTE" /begin SUB_GROUP StabilityComp2.SysAssistCmd.MtrNm_f32 /end SUB_GROUP /begin FUNCTION_LIST /end FUNCTION_LIST /begin REF_CHARACTERISTIC /end REF_CHARACTERISTIC /begin REF_MEASUREMENT /end REF_MEASUREMENT /end GROUP
/begin GROUP StabilityComp2.SysAssistCmd.MtrNm_f32 "MICROSAR RTE" /begin SUB_GROUP /end SUB_GROUP /begin FUNCTION_LIST /end FUNCTION_LIST /begin REF_CHARACTERISTIC /end REF_CHARACTERISTIC /begin REF_MEASUREMENT Rte_StabilityComp2_SysAssistCmd_MtrNm_f32 /end REF_MEASUREMENT /end GROUP
/begin GROUP StabilityComp2.VehicleSpeed.Kph_f32 "MICROSAR RTE" /begin SUB_GROUP /end SUB_GROUP /begin FUNCTION_LIST /end FUNCTION_LIST /begin REF_CHARACTERISTIC /end REF_CHARACTERISTIC /end GROUP
/begin GROUP Sweep "MICROSAR RTE" /begin SUB_GROUP Sweep.ReceiverPorts Sweep.SenderPorts /end SUB_GROUP /begin FUNCTION_LIST /end FUNCTION_LIST /begin REF_CHARACTERISTIC /end REF_CHARACTERISTIC /begin REF_MEASUREMENT /end REF_MEASUREMENT /end GROUP
/begin GROUP Sweep.InputHwTrq.HwNm_f32 "MICROSAR RTE" /begin SUB_GROUP /end SUB_GROUP /begin FUNCTION_LIST /end FUNCTION_LIST /begin REF_CHARACTERISTIC /end REF_CHARACTERISTIC /end GROUP
/begin GROUP Sweep.OutputHwTrq.HwNm_f32 "MICROSAR RTE" /begin SUB_GROUP /end SUB_GROUP /begin FUNCTION_LIST /end FUNCTION_LIST /begin REF_CHARACTERISTIC /end REF_CHARACTERISTIC /end GROUP
/begin GROUP Sweep.ReceiverPorts "MICROSAR RTE"
 /begin SUB_GROUP Sweep.InputHwTrq.HwNm_f32 Sweep.VehSpd.Kph_f32 Sweep.VehSpdValid.Cnt_lgc /end SUB_GROUP
 /begin FUNCTION_LIST /end FUNCTION_LIST
 /begin REF_CHARACTERISTIC /end REF_CHARACTERISTIC
 /begin REF_MEASUREMENT /end REF_MEASUREMENT
/end GROUP
/begin GROUP Sweep.SenderPorts "MICROSAR RTE" /begin SUB_GROUP Sweep.OutputHwTrq.HwNm_f32 /end SUB_GROUP /begin FUNCTION_LIST /end FUNCTION_LIST /begin REF_CHARACTERISTIC /end REF_CHARACTERISTIC /begin REF_MEASUREMENT /end REF_MEASUREMENT /end GROUP
/begin GROUP Sweep.VehSpd.Kph_f32 "MICROSAR RTE" /begin SUB_GROUP /end SUB_GROUP /begin FUNCTION_LIST /end FUNCTION_LIST /begin REF_CHARACTERISTIC /end REF_CHARACTERISTIC /end GROUP
/begin GROUP Sweep.VehSpdValid.Cnt_lgc "MICROSAR RTE" /begin SUB_GROUP /end SUB_GROUP /begin FUNCTION_LIST /end FUNCTION_LIST /begin REF_CHARACTERISTIC /end REF_CHARACTERISTIC /end GROUP
/begin GROUP Sweep2 "MICROSAR RTE" /begin SUB_GROUP Sweep2.ReceiverPorts Sweep2.SenderPorts /end SUB_GROUP /begin FUNCTION_LIST /end FUNCTION_LIST /begin REF_CHARACTERISTIC /end REF_CHARACTERISTIC /begin REF_MEASUREMENT /end REF_MEASUREMENT /end GROUP
/begin GROUP Sweep2.InputMtrTrq.MtrNm_f32 "MICROSAR RTE" /begin SUB_GROUP /end SUB_GROUP /begin FUNCTION_LIST /end FUNCTION_LIST /begin REF_CHARACTERISTIC /end REF_CHARACTERISTIC /end GROUP
/begin GROUP Sweep2.OutputMtrTrq.MtrNm_f32 "MICROSAR RTE" /begin SUB_GROUP /end SUB_GROUP /begin FUNCTION_LIST /end FUNCTION_LIST /begin REF_CHARACTERISTIC /end REF_CHARACTERISTIC /end GROUP
/begin GROUP Sweep2.ReceiverPorts "MICROSAR RTE" /begin SUB_GROUP Sweep2.InputMtrTrq.MtrNm_f32 /end SUB_GROUP /begin FUNCTION_LIST /end FUNCTION_LIST /begin REF_CHARACTERISTIC /end REF_CHARACTERISTIC /begin REF_MEASUREMENT /end REF_MEASUREMENT /end GROUP
/begin GROUP Sweep2.SenderPorts "MICROSAR RTE" /begin SUB_GROUP Sweep2.OutputMtrTrq.MtrNm_f32 /end SUB_GROUP /begin FUNCTION_LIST /end FUNCTION_LIST /begin REF_CHARACTERISTIC /end REF_CHARACTERISTIC /begin REF_MEASUREMENT /end REF_MEASUREMENT /end GROUP
/begin GROUP ThrmlDutyCycle "MICROSAR RTE"
 /begin SUB_GROUP ThrmlDutyCycle.PerInstanceMemories ThrmlDutyCycle.ReceiverPorts ThrmlDutyCycle.SenderPorts /end SUB_GROUP
 /begin FUNCTION_LIST /end FUNCTION_LIST
 /begin REF_CHARACTERISTIC /end REF_CHARACTERISTIC
 /begin REF_MEASUREMENT /end REF_MEASUREMENT
/end GROUP
/begin GROUP ThrmlDutyCycle.CuTempEst.DegC_f32 "MICROSAR RTE" /begin SUB_GROUP /end SUB_GROUP /begin FUNCTION_LIST /end FUNCTION_LIST /begin REF_CHARACTERISTIC /end REF_CHARACTERISTIC /end GROUP
/begin GROUP ThrmlDutyCycle.DefeatDutySvc.Cnt_lgc "MICROSAR RTE" /begin SUB_GROUP /end SUB_GROUP /begin FUNCTION_LIST /end FUNCTION_LIST /begin REF_CHARACTERISTIC /end REF_CHARACTERISTIC /end GROUP
/begin GROUP ThrmlDutyCycle.DutyCycleLevel.Uls_f32 "MICROSAR RTE" /begin SUB_GROUP /end SUB_GROUP /begin FUNCTION_LIST /end FUNCTION_LIST /begin REF_CHARACTERISTIC /end REF_CHARACTERISTIC /end GROUP
/begin GROUP ThrmlDutyCycle.FiltMeasTemp.DegC_f32 "MICROSAR RTE" /begin SUB_GROUP /end SUB_GROUP /begin FUNCTION_LIST /end FUNCTION_LIST /begin REF_CHARACTERISTIC /end REF_CHARACTERISTIC /end GROUP
/begin GROUP ThrmlDutyCycle.FilteredPkCurr.AmpSq_f32 "MICROSAR RTE" /begin SUB_GROUP /end SUB_GROUP /begin FUNCTION_LIST /end FUNCTION_LIST /begin REF_CHARACTERISTIC /end REF_CHARACTERISTIC /begin REF_MEASUREMENT Rte_PeakCurrEst_FiltEstPkCurr_AmpSq_f32 /end REF_MEASUREMENT /end GROUP
/begin GROUP ThrmlDutyCycle.IgnTimeOff.Cnt_u32 "MICROSAR RTE" /begin SUB_GROUP /end SUB_GROUP /begin FUNCTION_LIST /end FUNCTION_LIST /begin REF_CHARACTERISTIC /end REF_CHARACTERISTIC /begin REF_MEASUREMENT Rte_ThrmlDutyCycle_IgnTimeOff_Cnt_u32 /end REF_MEASUREMENT /end GROUP
/begin GROUP ThrmlDutyCycle.MagTempEst.DegC_f32 "MICROSAR RTE" /begin SUB_GROUP /end SUB_GROUP /begin FUNCTION_LIST /end FUNCTION_LIST /begin REF_CHARACTERISTIC /end REF_CHARACTERISTIC /end GROUP
/begin GROUP ThrmlDutyCycle.MotorVelCRF.MtrRadpS_f32 "MICROSAR RTE" /begin SUB_GROUP /end SUB_GROUP /begin FUNCTION_LIST /end FUNCTION_LIST /begin REF_CHARACTERISTIC /end REF_CHARACTERISTIC /end GROUP
/begin GROUP ThrmlDutyCycle.MtrPkCurr.AmpSq_f32 "MICROSAR RTE" /begin SUB_GROUP /end SUB_GROUP /begin FUNCTION_LIST /end FUNCTION_LIST /begin REF_CHARACTERISTIC /end REF_CHARACTERISTIC /begin REF_MEASUREMENT Rte_PeakCurrEst_EstPkCurr_AmpSq_f32 /end REF_MEASUREMENT /end GROUP
/begin GROUP ThrmlDutyCycle.PerInstanceMemories "MICROSAR RTE" /begin SUB_GROUP ThrmlDutyCycle.ThrmlDutyCycle_FltStVal /end SUB_GROUP /begin FUNCTION_LIST /end FUNCTION_LIST /begin REF_CHARACTERISTIC /end REF_CHARACTERISTIC /begin REF_MEASUREMENT /end REF_MEASUREMENT /end GROUP
/begin GROUP ThrmlDutyCycle.ReceiverPorts "MICROSAR RTE"
 /begin SUB_GROUP ThrmlDutyCycle.CuTempEst.DegC_f32 ThrmlDutyCycle.DefeatDutySvc.Cnt_lgc ThrmlDutyCycle.FiltMeasTemp.DegC_f32 ThrmlDutyCycle.FilteredPkCurr.AmpSq_f32 ThrmlDutyCycle.IgnTimeOff.Cnt_u32 ThrmlDutyCycle.MagTempEst.DegC_f32 ThrmlDutyCycle.MotorVelCRF.MtrRadpS_f32 ThrmlDutyCycle.MtrPkCurr.AmpSq_f32 ThrmlDutyCycle.SiTempEst.DegC_f32 ThrmlDutyCycle.VehTimeValid.Cnt_lgc /end SUB_GROUP
 /begin FUNCTION_LIST /end FUNCTION_LIST
 /begin REF_CHARACTERISTIC /end REF_CHARACTERISTIC
 /begin REF_MEASUREMENT /end REF_MEASUREMENT
/end GROUP
/begin GROUP ThrmlDutyCycle.SenderPorts "MICROSAR RTE"
 /begin SUB_GROUP ThrmlDutyCycle.DutyCycleLevel.Uls_f32 ThrmlDutyCycle.ThermLimitPerc.Uls_f32 ThrmlDutyCycle.ThermalLimit.MtrNm_f32 /end SUB_GROUP
 /begin FUNCTION_LIST /end FUNCTION_LIST
 /begin REF_CHARACTERISTIC /end REF_CHARACTERISTIC
 /begin REF_MEASUREMENT /end REF_MEASUREMENT
/end GROUP
/begin GROUP ThrmlDutyCycle.SiTempEst.DegC_f32 "MICROSAR RTE" /begin SUB_GROUP /end SUB_GROUP /begin FUNCTION_LIST /end FUNCTION_LIST /begin REF_CHARACTERISTIC /end REF_CHARACTERISTIC /end GROUP
/begin GROUP ThrmlDutyCycle.ThermLimitPerc.Uls_f32 "MICROSAR RTE" /begin SUB_GROUP /end SUB_GROUP /begin FUNCTION_LIST /end FUNCTION_LIST /begin REF_CHARACTERISTIC /end REF_CHARACTERISTIC /end GROUP
/begin GROUP ThrmlDutyCycle.ThermalLimit.MtrNm_f32 "MICROSAR RTE" /begin SUB_GROUP /end SUB_GROUP /begin FUNCTION_LIST /end FUNCTION_LIST /begin REF_CHARACTERISTIC /end REF_CHARACTERISTIC /begin REF_MEASUREMENT Rte_ThrmlDutyCycle_ThermalLimit_MtrNm_f32 /end REF_MEASUREMENT /end GROUP
/begin GROUP ThrmlDutyCycle.ThrmlDutyCycle_FltStVal "MICROSAR RTE" /begin SUB_GROUP /end SUB_GROUP /begin FUNCTION_LIST /end FUNCTION_LIST /begin REF_CHARACTERISTIC /end REF_CHARACTERISTIC
 /begin REF_MEASUREMENT Rte_ThrmlDutyCycle_ThrmlDutyCycle_FltStVal.Filt3Val_Cnt_u8 Rte_ThrmlDutyCycle_ThrmlDutyCycle_FltStVal.Filt4Val_Cnt_u8 Rte_ThrmlDutyCycle_ThrmlDutyCycle_FltStVal.Filt5Val_Cnt_u8 Rte_ThrmlDutyCycle_ThrmlDutyCycle_FltStVal.Filt6Val_Cnt_u8 /end REF_MEASUREMENT
/end GROUP
/begin GROUP ThrmlDutyCycle.VehTimeValid.Cnt_lgc "MICROSAR RTE" /begin SUB_GROUP /end SUB_GROUP /begin FUNCTION_LIST /end FUNCTION_LIST /begin REF_CHARACTERISTIC /end REF_CHARACTERISTIC /begin REF_MEASUREMENT Rte_ThrmlDutyCycle_VehTimeValid_Cnt_lgc /end REF_MEASUREMENT /end GROUP
/begin GROUP TmprlMon "MICROSAR RTE"
 /begin SUB_GROUP TmprlMon.ModeRequirePorts TmprlMon.ReceiverPorts TmprlMon.SenderPorts /end SUB_GROUP
 /begin FUNCTION_LIST /end FUNCTION_LIST
 /begin REF_CHARACTERISTIC /end REF_CHARACTERISTIC
 /begin REF_MEASUREMENT /end REF_MEASUREMENT
/end GROUP
/begin GROUP TmprlMon.ModeRequirePorts "MICROSAR RTE" /begin SUB_GROUP TmprlMon.SystemState.Mode /end SUB_GROUP /begin FUNCTION_LIST /end FUNCTION_LIST /begin REF_CHARACTERISTIC /end REF_CHARACTERISTIC /begin REF_MEASUREMENT /end REF_MEASUREMENT /end GROUP
/begin GROUP TmprlMon.ReceiverPorts "MICROSAR RTE" /begin SUB_GROUP TmprlMon.TMFTestStart.Cnt_lgc /end SUB_GROUP /begin FUNCTION_LIST /end FUNCTION_LIST /begin REF_CHARACTERISTIC /end REF_CHARACTERISTIC /begin REF_MEASUREMENT /end REF_MEASUREMENT /end GROUP
/begin GROUP TmprlMon.SenderPorts "MICROSAR RTE" /begin SUB_GROUP TmprlMon.TMFTestComplete.Cnt_lgc /end SUB_GROUP /begin FUNCTION_LIST /end FUNCTION_LIST /begin REF_CHARACTERISTIC /end REF_CHARACTERISTIC /begin REF_MEASUREMENT /end REF_MEASUREMENT /end GROUP
/begin GROUP TmprlMon.SystemState.Mode "MICROSAR RTE" /begin SUB_GROUP /end SUB_GROUP /begin FUNCTION_LIST /end FUNCTION_LIST /begin REF_CHARACTERISTIC /end REF_CHARACTERISTIC /end GROUP
/begin GROUP TmprlMon.TMFTestComplete.Cnt_lgc "MICROSAR RTE" /begin SUB_GROUP /end SUB_GROUP /begin FUNCTION_LIST /end FUNCTION_LIST /begin REF_CHARACTERISTIC /end REF_CHARACTERISTIC /end GROUP
/begin GROUP TmprlMon.TMFTestStart.Cnt_lgc "MICROSAR RTE" /begin SUB_GROUP /end SUB_GROUP /begin FUNCTION_LIST /end FUNCTION_LIST /begin REF_CHARACTERISTIC /end REF_CHARACTERISTIC /end GROUP
/begin GROUP TqRsDg "MICROSAR RTE" /begin SUB_GROUP TqRsDg.ModeRequirePorts TqRsDg.ReceiverPorts /end SUB_GROUP /begin FUNCTION_LIST /end FUNCTION_LIST /begin REF_CHARACTERISTIC /end REF_CHARACTERISTIC /begin REF_MEASUREMENT /end REF_MEASUREMENT /end GROUP
/begin GROUP TqRsDg.DervLambdaAlphaDiag.Volt_f32 "MICROSAR RTE" /begin SUB_GROUP /end SUB_GROUP /begin FUNCTION_LIST /end FUNCTION_LIST /begin REF_CHARACTERISTIC /end REF_CHARACTERISTIC /begin REF_MEASUREMENT Rte_PICurrCntrl_DervLambdaAlphaDiag_Volt_f32 /end REF_MEASUREMENT /end GROUP
/begin GROUP TqRsDg.DervLambdaBetaDiag.Volt_f32 "MICROSAR RTE" /begin SUB_GROUP /end SUB_GROUP /begin FUNCTION_LIST /end FUNCTION_LIST /begin REF_CHARACTERISTIC /end REF_CHARACTERISTIC /begin REF_MEASUREMENT Rte_PICurrCntrl_DervLambdaBetaDiag_Volt_f32 /end REF_MEASUREMENT /end GROUP
/begin GROUP TqRsDg.ModeRequirePorts "MICROSAR RTE" /begin SUB_GROUP TqRsDg.SystemState.Mode /end SUB_GROUP /begin FUNCTION_LIST /end FUNCTION_LIST /begin REF_CHARACTERISTIC /end REF_CHARACTERISTIC /begin REF_MEASUREMENT /end REF_MEASUREMENT /end GROUP
/begin GROUP TqRsDg.OutputRampMult.Uls_f32 "MICROSAR RTE" /begin SUB_GROUP /end SUB_GROUP /begin FUNCTION_LIST /end FUNCTION_LIST /begin REF_CHARACTERISTIC /end REF_CHARACTERISTIC /begin REF_MEASUREMENT Rte_StOpCtrl_OutputRampMult_Uls_f32 /end REF_MEASUREMENT /end GROUP
/begin GROUP TqRsDg.ReceiverPorts "MICROSAR RTE"
 /begin SUB_GROUP TqRsDg.DervLambdaAlphaDiag.Volt_f32 TqRsDg.DervLambdaBetaDiag.Volt_f32 TqRsDg.OutputRampMult.Uls_f32 TqRsDg.TrqLimitMin.MtrNm_f32 /end SUB_GROUP
 /begin FUNCTION_LIST /end FUNCTION_LIST
 /begin REF_CHARACTERISTIC /end REF_CHARACTERISTIC
 /begin REF_MEASUREMENT /end REF_MEASUREMENT
/end GROUP
/begin GROUP TqRsDg.SystemState.Mode "MICROSAR RTE" /begin SUB_GROUP /end SUB_GROUP /begin FUNCTION_LIST /end FUNCTION_LIST /begin REF_CHARACTERISTIC /end REF_CHARACTERISTIC /end GROUP
/begin GROUP TqRsDg.TrqLimitMin.MtrNm_f32 "MICROSAR RTE" /begin SUB_GROUP /end SUB_GROUP /begin FUNCTION_LIST /end FUNCTION_LIST /begin REF_CHARACTERISTIC /end REF_CHARACTERISTIC /end GROUP
/begin GROUP TrqCanc "MICROSAR RTE" /begin SUB_GROUP TrqCanc.PerInstanceMemories TrqCanc.ReceiverPorts /end SUB_GROUP /begin FUNCTION_LIST /end FUNCTION_LIST /begin REF_CHARACTERISTIC /end REF_CHARACTERISTIC /begin REF_MEASUREMENT /end REF_MEASUREMENT /end GROUP
/begin GROUP TrqCanc.CogTrqCal "MICROSAR RTE" /begin SUB_GROUP /end SUB_GROUP /begin FUNCTION_LIST /end FUNCTION_LIST /begin REF_CHARACTERISTIC /end REF_CHARACTERISTIC /begin REF_MEASUREMENT Rte_TrqCanc_CogTrqCal /end REF_MEASUREMENT /end GROUP
/begin GROUP TrqCanc.CogTrqRplComp "MICROSAR RTE" /begin SUB_GROUP /end SUB_GROUP /begin FUNCTION_LIST /end FUNCTION_LIST /begin REF_CHARACTERISTIC /end REF_CHARACTERISTIC /begin REF_MEASUREMENT Rte_TrqCanc_CogTrqRplComp /end REF_MEASUREMENT /end GROUP
/begin GROUP TrqCanc.EstKe.VpRadpS_f32 "MICROSAR RTE" /begin SUB_GROUP /end SUB_GROUP /begin FUNCTION_LIST /end FUNCTION_LIST /begin REF_CHARACTERISTIC /end REF_CHARACTERISTIC /end GROUP
/begin GROUP TrqCanc.EstLd.Henry_f32 "MICROSAR RTE" /begin SUB_GROUP /end SUB_GROUP /begin FUNCTION_LIST /end FUNCTION_LIST /begin REF_CHARACTERISTIC /end REF_CHARACTERISTIC /end GROUP
/begin GROUP TrqCanc.EstLq.Henry_f32 "MICROSAR RTE" /begin SUB_GROUP /end SUB_GROUP /begin FUNCTION_LIST /end FUNCTION_LIST /begin REF_CHARACTERISTIC /end REF_CHARACTERISTIC /end GROUP
/begin GROUP TrqCanc.MRFMtrVel.MtrRadpS_f32 "MICROSAR RTE" /begin SUB_GROUP /end SUB_GROUP /begin FUNCTION_LIST /end FUNCTION_LIST /begin REF_CHARACTERISTIC /end REF_CHARACTERISTIC /end GROUP
/begin GROUP TrqCanc.MtrCurrDaxRef.Amp_f32 "MICROSAR RTE" /begin SUB_GROUP /end SUB_GROUP /begin FUNCTION_LIST /end FUNCTION_LIST /begin REF_CHARACTERISTIC /end REF_CHARACTERISTIC /end GROUP
/begin GROUP TrqCanc.MtrCurrQaxRef.Amp_f32 "MICROSAR RTE" /begin SUB_GROUP /end SUB_GROUP /begin FUNCTION_LIST /end FUNCTION_LIST /begin REF_CHARACTERISTIC /end REF_CHARACTERISTIC /end GROUP
/begin GROUP TrqCanc.MtrTrqCmdMRFScl.MtrNm_f32 "MICROSAR RTE" /begin SUB_GROUP /end SUB_GROUP /begin FUNCTION_LIST /end FUNCTION_LIST /begin REF_CHARACTERISTIC /end REF_CHARACTERISTIC /end GROUP
/begin GROUP TrqCanc.PerInstanceMemories "MICROSAR RTE" /begin SUB_GROUP TrqCanc.CogTrqCal TrqCanc.CogTrqRplComp /end SUB_GROUP /begin FUNCTION_LIST /end FUNCTION_LIST /begin REF_CHARACTERISTIC /end REF_CHARACTERISTIC /begin REF_MEASUREMENT /end REF_MEASUREMENT /end GROUP
/begin GROUP TrqCanc.ReceiverPorts "MICROSAR RTE"
 /begin SUB_GROUP TrqCanc.EstKe.VpRadpS_f32 TrqCanc.EstLd.Henry_f32 TrqCanc.EstLq.Henry_f32 TrqCanc.MRFMtrVel.MtrRadpS_f32 TrqCanc.MtrCurrDaxRef.Amp_f32 TrqCanc.MtrCurrQaxRef.Amp_f32 TrqCanc.MtrTrqCmdMRFScl.MtrNm_f32 /end SUB_GROUP
 /begin FUNCTION_LIST /end FUNCTION_LIST
 /begin REF_CHARACTERISTIC /end REF_CHARACTERISTIC
 /begin REF_MEASUREMENT /end REF_MEASUREMENT
/end GROUP
/begin GROUP TrqCmdScl "MICROSAR RTE"
 /begin SUB_GROUP TrqCmdScl.PerInstanceMemories TrqCmdScl.ReceiverPorts TrqCmdScl.SenderPorts /end SUB_GROUP
 /begin FUNCTION_LIST /end FUNCTION_LIST
 /begin REF_CHARACTERISTIC /end REF_CHARACTERISTIC
 /begin REF_MEASUREMENT /end REF_MEASUREMENT
/end GROUP
/begin GROUP TrqCmdScl.MRFMtrTrqCmd.MtrNm_f32 "MICROSAR RTE" /begin SUB_GROUP /end SUB_GROUP /begin FUNCTION_LIST /end FUNCTION_LIST /begin REF_CHARACTERISTIC /end REF_CHARACTERISTIC /begin REF_MEASUREMENT Rte_PwrLmtFuncCr_MRFMtrTrqCmd_MtrNm_f32 /end REF_MEASUREMENT /end GROUP
/begin GROUP TrqCmdScl.MRFMtrTrqCmdScl.MtrNm_f32 "MICROSAR RTE" /begin SUB_GROUP /end SUB_GROUP /begin FUNCTION_LIST /end FUNCTION_LIST /begin REF_CHARACTERISTIC /end REF_CHARACTERISTIC /end GROUP
/begin GROUP TrqCmdScl.PerInstanceMemories "MICROSAR RTE" /begin SUB_GROUP TrqCmdScl.TorqueCmdSF_Uls_f32 /end SUB_GROUP /begin FUNCTION_LIST /end FUNCTION_LIST /begin REF_CHARACTERISTIC /end REF_CHARACTERISTIC /begin REF_MEASUREMENT /end REF_MEASUREMENT /end GROUP
/begin GROUP TrqCmdScl.ReceiverPorts "MICROSAR RTE" /begin SUB_GROUP TrqCmdScl.MRFMtrTrqCmd.MtrNm_f32 /end SUB_GROUP /begin FUNCTION_LIST /end FUNCTION_LIST /begin REF_CHARACTERISTIC /end REF_CHARACTERISTIC /begin REF_MEASUREMENT /end REF_MEASUREMENT /end GROUP
/begin GROUP TrqCmdScl.SenderPorts "MICROSAR RTE" /begin SUB_GROUP TrqCmdScl.MRFMtrTrqCmdScl.MtrNm_f32 /end SUB_GROUP /begin FUNCTION_LIST /end FUNCTION_LIST /begin REF_CHARACTERISTIC /end REF_CHARACTERISTIC /begin REF_MEASUREMENT /end REF_MEASUREMENT /end GROUP
/begin GROUP TrqCmdScl.TorqueCmdSF_Uls_f32 "MICROSAR RTE" /begin SUB_GROUP /end SUB_GROUP /begin FUNCTION_LIST /end FUNCTION_LIST /begin REF_CHARACTERISTIC /end REF_CHARACTERISTIC /begin REF_MEASUREMENT Rte_TrqCmdScl_TorqueCmdSF_Uls_f32 /end REF_MEASUREMENT /end GROUP
/begin GROUP TuningSelAuth "MICROSAR RTE" /begin SUB_GROUP TuningSelAuth.ReceiverPorts TuningSelAuth.SenderPorts /end SUB_GROUP /begin FUNCTION_LIST /end FUNCTION_LIST /begin REF_CHARACTERISTIC /end REF_CHARACTERISTIC /begin REF_MEASUREMENT /end REF_MEASUREMENT /end GROUP
/begin GROUP TuningSelAuth.ActiveTunOvrPtrAddr.Cnt_u32 "MICROSAR RTE" /begin SUB_GROUP /end SUB_GROUP /begin FUNCTION_LIST /end FUNCTION_LIST /begin REF_CHARACTERISTIC /end REF_CHARACTERISTIC /end GROUP
/begin GROUP TuningSelAuth.ActiveTunPers.Cnt_u16 "MICROSAR RTE" /begin SUB_GROUP /end SUB_GROUP /begin FUNCTION_LIST /end FUNCTION_LIST /begin REF_CHARACTERISTIC /end REF_CHARACTERISTIC /end GROUP
/begin GROUP TuningSelAuth.ActiveTunSet.Cnt_u16 "MICROSAR RTE" /begin SUB_GROUP /end SUB_GROUP /begin FUNCTION_LIST /end FUNCTION_LIST /begin REF_CHARACTERISTIC /end REF_CHARACTERISTIC /end GROUP
/begin GROUP TuningSelAuth.DesiredTunPers.Cnt_u16 "MICROSAR RTE" /begin SUB_GROUP /end SUB_GROUP /begin FUNCTION_LIST /end FUNCTION_LIST /begin REF_CHARACTERISTIC /end REF_CHARACTERISTIC /begin REF_MEASUREMENT Rte_SrlComInput_DesiredTunPers_Cnt_u16 /end REF_MEASUREMENT /end GROUP
/begin GROUP TuningSelAuth.DesiredTunSet.Cnt_u16 "MICROSAR RTE" /begin SUB_GROUP /end SUB_GROUP /begin FUNCTION_LIST /end FUNCTION_LIST /begin REF_CHARACTERISTIC /end REF_CHARACTERISTIC /end GROUP
/begin GROUP TuningSelAuth.HwTorque.HwNm_f32 "MICROSAR RTE" /begin SUB_GROUP /end SUB_GROUP /begin FUNCTION_LIST /end FUNCTION_LIST /begin REF_CHARACTERISTIC /end REF_CHARACTERISTIC /end GROUP
/begin GROUP TuningSelAuth.ReceiverPorts "MICROSAR RTE"
 /begin SUB_GROUP TuningSelAuth.ActiveTunOvrPtrAddr.Cnt_u32 TuningSelAuth.DesiredTunPers.Cnt_u16 TuningSelAuth.DesiredTunSet.Cnt_u16 TuningSelAuth.HwTorque.HwNm_f32 TuningSelAuth.VehicleSpeed.Kph_f32 /end SUB_GROUP
 /begin FUNCTION_LIST /end FUNCTION_LIST
 /begin REF_CHARACTERISTIC /end REF_CHARACTERISTIC
 /begin REF_MEASUREMENT /end REF_MEASUREMENT
/end GROUP
/begin GROUP TuningSelAuth.SenderPorts "MICROSAR RTE"
 /begin SUB_GROUP TuningSelAuth.ActiveTunPers.Cnt_u16 TuningSelAuth.ActiveTunSet.Cnt_u16 /end SUB_GROUP
 /begin FUNCTION_LIST /end FUNCTION_LIST
 /begin REF_CHARACTERISTIC /end REF_CHARACTERISTIC
 /begin REF_MEASUREMENT /end REF_MEASUREMENT
/end GROUP
/begin GROUP TuningSelAuth.VehicleSpeed.Kph_f32 "MICROSAR RTE" /begin SUB_GROUP /end SUB_GROUP /begin FUNCTION_LIST /end FUNCTION_LIST /begin REF_CHARACTERISTIC /end REF_CHARACTERISTIC /end GROUP
/begin GROUP VehDyn "MICROSAR RTE"
 /begin SUB_GROUP VehDyn.ModeRequirePorts VehDyn.PerInstanceMemories VehDyn.ReceiverPorts VehDyn.SenderPorts /end SUB_GROUP
 /begin FUNCTION_LIST /end FUNCTION_LIST
 /begin REF_CHARACTERISTIC /end REF_CHARACTERISTIC
 /begin REF_MEASUREMENT /end REF_MEASUREMENT
/end GROUP
/begin GROUP VehDyn.CcwEOT.HwDeg_f32 "MICROSAR RTE" /begin SUB_GROUP /end SUB_GROUP /begin FUNCTION_LIST /end FUNCTION_LIST /begin REF_CHARACTERISTIC /end REF_CHARACTERISTIC /end GROUP
/begin GROUP VehDyn.CwEOT.HwDeg_f32 "MICROSAR RTE" /begin SUB_GROUP /end SUB_GROUP /begin FUNCTION_LIST /end FUNCTION_LIST /begin REF_CHARACTERISTIC /end REF_CHARACTERISTIC /end GROUP
/begin GROUP VehDyn.HandwheelPosition.HwDeg_f32 "MICROSAR RTE" /begin SUB_GROUP /end SUB_GROUP /begin FUNCTION_LIST /end FUNCTION_LIST /begin REF_CHARACTERISTIC /end REF_CHARACTERISTIC /end GROUP
/begin GROUP VehDyn.HwAuth.Uls_f32 "MICROSAR RTE" /begin SUB_GROUP /end SUB_GROUP /begin FUNCTION_LIST /end FUNCTION_LIST /begin REF_CHARACTERISTIC /end REF_CHARACTERISTIC /end GROUP
/begin GROUP VehDyn.HwTorque.HwNm_f32 "MICROSAR RTE" /begin SUB_GROUP /end SUB_GROUP /begin FUNCTION_LIST /end FUNCTION_LIST /begin REF_CHARACTERISTIC /end REF_CHARACTERISTIC /end GROUP
/begin GROUP VehDyn.MechMtrPos.Rev_f32 "MICROSAR RTE" /begin SUB_GROUP /end SUB_GROUP /begin FUNCTION_LIST /end FUNCTION_LIST /begin REF_CHARACTERISTIC /end REF_CHARACTERISTIC /end GROUP
/begin GROUP VehDyn.ModeRequirePorts "MICROSAR RTE" /begin SUB_GROUP VehDyn.SystemState.Mode /end SUB_GROUP /begin FUNCTION_LIST /end FUNCTION_LIST /begin REF_CHARACTERISTIC /end REF_CHARACTERISTIC /begin REF_MEASUREMENT /end REF_MEASUREMENT /end GROUP
/begin GROUP VehDyn.MotPosReset "MICROSAR RTE" /begin SUB_GROUP /end SUB_GROUP /begin FUNCTION_LIST /end FUNCTION_LIST /begin REF_CHARACTERISTIC /end REF_CHARACTERISTIC
 /begin REF_MEASUREMENT Rte_VehDyn_MotPosReset.NVMStoredLastPosValid_Cnt_lgc Rte_VehDyn_MotPosReset.NVMStoredLastPos_HwDeg_f32 /end REF_MEASUREMENT
/end GROUP
/begin GROUP VehDyn.MotorVelCRF.MtrRadpS_f32 "MICROSAR RTE" /begin SUB_GROUP /end SUB_GROUP /begin FUNCTION_LIST /end FUNCTION_LIST /begin REF_CHARACTERISTIC /end REF_CHARACTERISTIC /end GROUP
/begin GROUP VehDyn.PerInstanceMemories "MICROSAR RTE" /begin SUB_GROUP VehDyn.MotPosReset /end SUB_GROUP /begin FUNCTION_LIST /end FUNCTION_LIST /begin REF_CHARACTERISTIC /end REF_CHARACTERISTIC /begin REF_MEASUREMENT /end REF_MEASUREMENT /end GROUP
/begin GROUP VehDyn.ReceiverPorts "MICROSAR RTE"
 /begin SUB_GROUP VehDyn.CcwEOT.HwDeg_f32 VehDyn.CwEOT.HwDeg_f32 VehDyn.HandwheelPosition.HwDeg_f32 VehDyn.HwAuth.Uls_f32 VehDyn.HwTorque.HwNm_f32 VehDyn.MechMtrPos.Rev_f32 VehDyn.MotorVelCRF.MtrRadpS_f32 VehDyn.RelHwPos.HwDeg_f32 VehDyn.SrlHwAg.HwDeg_f32 VehDyn.SrlHwAgVld.Cnt_lgc VehDyn.TorqueCmdCRF.MtrNm_f32 VehDyn.VehicleSpeed.Kph_f32 VehDyn.VehicleSpeedValid.Cnt_lgc /end SUB_GROUP
 /begin FUNCTION_LIST /end FUNCTION_LIST
 /begin REF_CHARACTERISTIC /end REF_CHARACTERISTIC
 /begin REF_MEASUREMENT /end REF_MEASUREMENT
/end GROUP
/begin GROUP VehDyn.RelHwPos.HwDeg_f32 "MICROSAR RTE" /begin SUB_GROUP /end SUB_GROUP /begin FUNCTION_LIST /end FUNCTION_LIST /begin REF_CHARACTERISTIC /end REF_CHARACTERISTIC /end GROUP
/begin GROUP VehDyn.SenderPorts "MICROSAR RTE"
 /begin SUB_GROUP VehDyn.SensorlessAuthority.Uls_f32 VehDyn.SensorlessHwPos.HwDeg_f32 /end SUB_GROUP
 /begin FUNCTION_LIST /end FUNCTION_LIST
 /begin REF_CHARACTERISTIC /end REF_CHARACTERISTIC
 /begin REF_MEASUREMENT /end REF_MEASUREMENT
/end GROUP
/begin GROUP VehDyn.SensorlessAuthority.Uls_f32 "MICROSAR RTE" /begin SUB_GROUP /end SUB_GROUP /begin FUNCTION_LIST /end FUNCTION_LIST /begin REF_CHARACTERISTIC /end REF_CHARACTERISTIC /end GROUP
/begin GROUP VehDyn.SensorlessHwPos.HwDeg_f32 "MICROSAR RTE" /begin SUB_GROUP /end SUB_GROUP /begin FUNCTION_LIST /end FUNCTION_LIST /begin REF_CHARACTERISTIC /end REF_CHARACTERISTIC /end GROUP
/begin GROUP VehDyn.SrlHwAg.HwDeg_f32 "MICROSAR RTE" /begin SUB_GROUP /end SUB_GROUP /begin FUNCTION_LIST /end FUNCTION_LIST /begin REF_CHARACTERISTIC /end REF_CHARACTERISTIC /begin REF_MEASUREMENT Rte_VehDyn_SrlHwAg_HwDeg_f32 /end REF_MEASUREMENT /end GROUP
/begin GROUP VehDyn.SrlHwAgVld.Cnt_lgc "MICROSAR RTE" /begin SUB_GROUP /end SUB_GROUP /begin FUNCTION_LIST /end FUNCTION_LIST /begin REF_CHARACTERISTIC /end REF_CHARACTERISTIC /begin REF_MEASUREMENT Rte_VehDyn_SrlHwAgVld_Cnt_lgc /end REF_MEASUREMENT /end GROUP
/begin GROUP VehDyn.SystemState.Mode "MICROSAR RTE" /begin SUB_GROUP /end SUB_GROUP /begin FUNCTION_LIST /end FUNCTION_LIST /begin REF_CHARACTERISTIC /end REF_CHARACTERISTIC /end GROUP
/begin GROUP VehDyn.TorqueCmdCRF.MtrNm_f32 "MICROSAR RTE" /begin SUB_GROUP /end SUB_GROUP /begin FUNCTION_LIST /end FUNCTION_LIST /begin REF_CHARACTERISTIC /end REF_CHARACTERISTIC /end GROUP
/begin GROUP VehDyn.VehicleSpeed.Kph_f32 "MICROSAR RTE" /begin SUB_GROUP /end SUB_GROUP /begin FUNCTION_LIST /end FUNCTION_LIST /begin REF_CHARACTERISTIC /end REF_CHARACTERISTIC /end GROUP
/begin GROUP VehDyn.VehicleSpeedValid.Cnt_lgc "MICROSAR RTE" /begin SUB_GROUP /end SUB_GROUP /begin FUNCTION_LIST /end FUNCTION_LIST /begin REF_CHARACTERISTIC /end REF_CHARACTERISTIC /end GROUP
/begin GROUP VehPwrMd "MICROSAR RTE"
 /begin SUB_GROUP VehPwrMd.ModeRequirePorts VehPwrMd.ReceiverPorts VehPwrMd.SenderPorts /end SUB_GROUP
 /begin FUNCTION_LIST /end FUNCTION_LIST
 /begin REF_CHARACTERISTIC /end REF_CHARACTERISTIC
 /begin REF_MEASUREMENT /end REF_MEASUREMENT
/end GROUP
/begin GROUP VehPwrMd.ATermActive.Cnt_lgc "MICROSAR RTE" /begin SUB_GROUP /end SUB_GROUP /begin FUNCTION_LIST /end FUNCTION_LIST /begin REF_CHARACTERISTIC /end REF_CHARACTERISTIC /begin REF_MEASUREMENT Rte_VehPwrMd_ATermActive_Cnt_lgc /end REF_MEASUREMENT /end GROUP
/begin GROUP VehPwrMd.CTermActive.Cnt_lgc "MICROSAR RTE" /begin SUB_GROUP /end SUB_GROUP /begin FUNCTION_LIST /end FUNCTION_LIST /begin REF_CHARACTERISTIC /end REF_CHARACTERISTIC /begin REF_MEASUREMENT Rte_VehPwrMd_CTermActive_Cnt_lgc /end REF_MEASUREMENT /end GROUP
/begin GROUP VehPwrMd.EngONSrlComSvcDft.Cnt_lgc "MICROSAR RTE" /begin SUB_GROUP /end SUB_GROUP /begin FUNCTION_LIST /end FUNCTION_LIST /begin REF_CHARACTERISTIC /end REF_CHARACTERISTIC /end GROUP
/begin GROUP VehPwrMd.MEC.Cnt_enum "MICROSAR RTE" /begin SUB_GROUP /end SUB_GROUP /begin FUNCTION_LIST /end FUNCTION_LIST /begin REF_CHARACTERISTIC /end REF_CHARACTERISTIC /end GROUP
/begin GROUP VehPwrMd.ModeRequirePorts "MICROSAR RTE" /begin SUB_GROUP VehPwrMd.SystemState.Mode /end SUB_GROUP /begin FUNCTION_LIST /end FUNCTION_LIST /begin REF_CHARACTERISTIC /end REF_CHARACTERISTIC /begin REF_MEASUREMENT /end REF_MEASUREMENT /end GROUP
/begin GROUP VehPwrMd.OperRampRate.XpmS_f32 "MICROSAR RTE" /begin SUB_GROUP /end SUB_GROUP /begin FUNCTION_LIST /end FUNCTION_LIST /begin REF_CHARACTERISTIC /end REF_CHARACTERISTIC /begin REF_MEASUREMENT Rte_VehPwrMd_OperRampRate_XpmS_f32 /end REF_MEASUREMENT /end GROUP
/begin GROUP VehPwrMd.OperRampValue.Uls_f32 "MICROSAR RTE" /begin SUB_GROUP /end SUB_GROUP /begin FUNCTION_LIST /end FUNCTION_LIST /begin REF_CHARACTERISTIC /end REF_CHARACTERISTIC /begin REF_MEASUREMENT Rte_VehPwrMd_OperRampValue_Uls_f32 /end REF_MEASUREMENT /end GROUP
/begin GROUP VehPwrMd.ReceiverPorts "MICROSAR RTE"
 /begin SUB_GROUP VehPwrMd.EngONSrlComSvcDft.Cnt_lgc VehPwrMd.MEC.Cnt_enum VehPwrMd.VehicleSpeed.Kph_f32 /end SUB_GROUP
 /begin FUNCTION_LIST /end FUNCTION_LIST
 /begin REF_CHARACTERISTIC /end REF_CHARACTERISTIC
 /begin REF_MEASUREMENT /end REF_MEASUREMENT
/end GROUP
/begin GROUP VehPwrMd.SenderPorts "MICROSAR RTE"
 /begin SUB_GROUP VehPwrMd.ATermActive.Cnt_lgc VehPwrMd.CTermActive.Cnt_lgc VehPwrMd.OperRampRate.XpmS_f32 VehPwrMd.OperRampValue.Uls_f32 /end SUB_GROUP
 /begin FUNCTION_LIST /end FUNCTION_LIST
 /begin REF_CHARACTERISTIC /end REF_CHARACTERISTIC
 /begin REF_MEASUREMENT /end REF_MEASUREMENT
/end GROUP
/begin GROUP VehPwrMd.SystemState.Mode "MICROSAR RTE" /begin SUB_GROUP /end SUB_GROUP /begin FUNCTION_LIST /end FUNCTION_LIST /begin REF_CHARACTERISTIC /end REF_CHARACTERISTIC /end GROUP
/begin GROUP VehPwrMd.VehicleSpeed.Kph_f32 "MICROSAR RTE" /begin SUB_GROUP /end SUB_GROUP /begin FUNCTION_LIST /end FUNCTION_LIST /begin REF_CHARACTERISTIC /end REF_CHARACTERISTIC /end GROUP
/begin GROUP VehSpdLmt "MICROSAR RTE" /begin SUB_GROUP VehSpdLmt.ReceiverPorts VehSpdLmt.SenderPorts /end SUB_GROUP /begin FUNCTION_LIST /end FUNCTION_LIST /begin REF_CHARACTERISTIC /end REF_CHARACTERISTIC /begin REF_MEASUREMENT /end REF_MEASUREMENT /end GROUP
/begin GROUP VehSpdLmt.AstVehSpdLimit.MtrNm_f32 "MICROSAR RTE" /begin SUB_GROUP /end SUB_GROUP /begin FUNCTION_LIST /end FUNCTION_LIST /begin REF_CHARACTERISTIC /end REF_CHARACTERISTIC /begin REF_MEASUREMENT Rte_VehSpdLmt_AstVehSpdLimit_MtrNm_f32 /end REF_MEASUREMENT /end GROUP
/begin GROUP VehSpdLmt.CCWPosition.HwDeg_f32 "MICROSAR RTE" /begin SUB_GROUP /end SUB_GROUP /begin FUNCTION_LIST /end FUNCTION_LIST /begin REF_CHARACTERISTIC /end REF_CHARACTERISTIC /end GROUP
/begin GROUP VehSpdLmt.CWPosition.HwDeg_f32 "MICROSAR RTE" /begin SUB_GROUP /end SUB_GROUP /begin FUNCTION_LIST /end FUNCTION_LIST /begin REF_CHARACTERISTIC /end REF_CHARACTERISTIC /end GROUP
/begin GROUP VehSpdLmt.HwPos.HwDeg_f32 "MICROSAR RTE" /begin SUB_GROUP /end SUB_GROUP /begin FUNCTION_LIST /end FUNCTION_LIST /begin REF_CHARACTERISTIC /end REF_CHARACTERISTIC /end GROUP
/begin GROUP VehSpdLmt.HwPosAuth.Uls_f32 "MICROSAR RTE" /begin SUB_GROUP /end SUB_GROUP /begin FUNCTION_LIST /end FUNCTION_LIST /begin REF_CHARACTERISTIC /end REF_CHARACTERISTIC /end GROUP
/begin GROUP VehSpdLmt.ReceiverPorts "MICROSAR RTE"
 /begin SUB_GROUP VehSpdLmt.CCWPosition.HwDeg_f32 VehSpdLmt.CWPosition.HwDeg_f32 VehSpdLmt.HwPos.HwDeg_f32 VehSpdLmt.HwPosAuth.Uls_f32 VehSpdLmt.VehSpd.Kph_f32 /end SUB_GROUP
 /begin FUNCTION_LIST /end FUNCTION_LIST
 /begin REF_CHARACTERISTIC /end REF_CHARACTERISTIC
 /begin REF_MEASUREMENT /end REF_MEASUREMENT
/end GROUP
/begin GROUP VehSpdLmt.SenderPorts "MICROSAR RTE" /begin SUB_GROUP VehSpdLmt.AstVehSpdLimit.MtrNm_f32 /end SUB_GROUP /begin FUNCTION_LIST /end FUNCTION_LIST /begin REF_CHARACTERISTIC /end REF_CHARACTERISTIC /begin REF_MEASUREMENT /end REF_MEASUREMENT /end GROUP
/begin GROUP VehSpdLmt.VehSpd.Kph_f32 "MICROSAR RTE" /begin SUB_GROUP /end SUB_GROUP /begin FUNCTION_LIST /end FUNCTION_LIST /begin REF_CHARACTERISTIC /end REF_CHARACTERISTIC /end GROUP
/begin GROUP ePWM2 "MICROSAR RTE" /begin SUB_GROUP ePWM2.ModeRequirePorts ePWM2.ReceiverPorts /end SUB_GROUP /begin FUNCTION_LIST /end FUNCTION_LIST /begin REF_CHARACTERISTIC /end REF_CHARACTERISTIC /begin REF_MEASUREMENT /end REF_MEASUREMENT /end GROUP
/begin GROUP ePWM2.CtrldDmpStsCmp.Cnt_lgc "MICROSAR RTE" /begin SUB_GROUP /end SUB_GROUP /begin FUNCTION_LIST /end FUNCTION_LIST /begin REF_CHARACTERISTIC /end REF_CHARACTERISTIC /end GROUP
/begin GROUP ePWM2.DiagStsCtrldDisRmpPres.Cnt_lgc "MICROSAR RTE" /begin SUB_GROUP /end SUB_GROUP /begin FUNCTION_LIST /end FUNCTION_LIST /begin REF_CHARACTERISTIC /end REF_CHARACTERISTIC /end GROUP
/begin GROUP ePWM2.DiagStsNonRecRmpToZeroFltPres.Cnt_lgc "MICROSAR RTE" /begin SUB_GROUP /end SUB_GROUP /begin FUNCTION_LIST /end FUNCTION_LIST /begin REF_CHARACTERISTIC /end REF_CHARACTERISTIC /end GROUP
/begin GROUP ePWM2.ModeRequirePorts "MICROSAR RTE" /begin SUB_GROUP ePWM2.SystemState.Mode /end SUB_GROUP /begin FUNCTION_LIST /end FUNCTION_LIST /begin REF_CHARACTERISTIC /end REF_CHARACTERISTIC /begin REF_MEASUREMENT /end REF_MEASUREMENT /end GROUP
/begin GROUP ePWM2.RampDwnStatusComplete.Cnt_lgc "MICROSAR RTE" /begin SUB_GROUP /end SUB_GROUP /begin FUNCTION_LIST /end FUNCTION_LIST /begin REF_CHARACTERISTIC /end REF_CHARACTERISTIC /begin REF_MEASUREMENT Rte_StOpCtrl_RampDwnStatusComplete_Cnt_lgc /end REF_MEASUREMENT /end GROUP
/begin GROUP ePWM2.ReceiverPorts "MICROSAR RTE"
 /begin SUB_GROUP ePWM2.CtrldDmpStsCmp.Cnt_lgc ePWM2.DiagStsCtrldDisRmpPres.Cnt_lgc ePWM2.DiagStsNonRecRmpToZeroFltPres.Cnt_lgc ePWM2.RampDwnStatusComplete.Cnt_lgc /end SUB_GROUP
 /begin FUNCTION_LIST /end FUNCTION_LIST
 /begin REF_CHARACTERISTIC /end REF_CHARACTERISTIC
 /begin REF_MEASUREMENT /end REF_MEASUREMENT
/end GROUP
/begin GROUP ePWM2.SystemState.Mode "MICROSAR RTE" /begin SUB_GROUP /end SUB_GROUP /begin FUNCTION_LIST /end FUNCTION_LIST /begin REF_CHARACTERISTIC /end REF_CHARACTERISTIC /end GROUP
/begin RECORD_LAYOUT RTE_RL_SLONG FNC_VALUES 1 SLONG ROW_DIR DIRECT /end RECORD_LAYOUT
/begin RECORD_LAYOUT RTE_RL_FLOAT32_IEEE FNC_VALUES 1 FLOAT32_IEEE ROW_DIR DIRECT /end RECORD_LAYOUT
/begin RECORD_LAYOUT RTE_RL_FLOAT64_IEEE FNC_VALUES 1 FLOAT64_IEEE ROW_DIR DIRECT /end RECORD_LAYOUT
/begin RECORD_LAYOUT RTE_RL_BOOLEAN FNC_VALUES 1 UBYTE ROW_DIR DIRECT /end RECORD_LAYOUT
/**********************************************************************************************************************
* COMPU_METHOD / COMPU_VTAB_RANGE
*********************************************************************************************************************/
/begin COMPU_METHOD RTE_CM_BOOLEAN "" TAB_VERB "%3.1" "" COMPU_TAB_REF RTE_CM_BOOLEAN /end COMPU_METHOD
/begin COMPU_VTAB_RANGE RTE_CM_BOOLEAN "" 2 0 0 "false" 1 255 "true" /end COMPU_VTAB_RANGE
/begin COMPU_METHOD RTE_CM_STRING "" TAB_VERB "%.1" "" COMPU_TAB_REF RTE_CM_STRING /end COMPU_METHOD
/begin COMPU_VTAB_RANGE RTE_CM_STRING "" 256 0 31 "UNDEFINED" 32 32 " " 33 33 "!" 34 34 "\"" 35 35 "#" 36 36 "$" 37 37 "%" 38 38 "&" 39 39 "'" 40 40 "(" 41 41 ")" 42 42 "*" 43 43 "+" 44 44 "," 45 45 "-" 46 46 "." 47 47 "/" 48 48 "0" 49 49 "1" 50 50 "2" 51 51 "3" 52 52 "4" 53 53 "5" 54 54 "6" 55 55 "7" 56 56 "8" 57 57 "9" 58 58 ":" 59 59 ";" 60 60 "<" 61 61 "=" 62 62 ">" 63 63 "?" 64 64 "@" 65 65 "A" 66 66 "B" 67 67 "C" 68 68 "D" 69 69 "E" 70 70 "F" 71 71 "G" 72 72 "H" 73 73 "I" 74 74 "J" 75 75 "K" 76 76 "L" 77 77 "M" 78 78 "N" 79 79 "O" 80 80 "P" 81 81 "Q" 82 82 "R" 83 83 "S" 84 84 "T" 85 85 "U" 86 86 "V" 87 87 "W" 88 88 "X" 89 89 "Y" 90 90 "Z" 91 91 "[" 92 92 "\\" 93 93 "]" 94 94 "^" 95 95 "_" 96 96 "`" 97 97 "a" 98 98 "b" 99 99 "c" 100 100 "d" 101 101 "e" 102 102 "f" 103 103 "g" 104 104 "h" 105 105 "i" 106 106 "j" 107 107 "k" 108 108 "l" 109 109 "m" 110 110 "n" 111 111 "o" 112 112 "p" 113 113 "q" 114 114 "r" 115 115 "s" 116 116 "t" 117 117 "u" 118 118 "v" 119 119 "w" 120 120 "x" 121 121 "y" 122 122 "z" 123 123 "{" 124 124 "|" 125 125 "}" 126 126 "~" 127 255 "UNDEFINED" /end COMPU_VTAB_RANGE
/begin COMPU_METHOD RTE_CM_ENUM_FETPHASETYPE_ENUM "" TAB_VERB "%.1" "" COMPU_TAB_REF RTE_CM_ENUM_FETPHASETYPE_ENUM /end COMPU_METHOD
/begin COMPU_VTAB_RANGE RTE_CM_ENUM_FETPHASETYPE_ENUM "" 4 0 0 "NOPHASE" 1 1 "PHASEA" 2 2 "PHASEB" 3 3 "PHASEC" /end COMPU_VTAB_RANGE
/begin COMPU_METHOD RTE_CM_ENUM_FETFAULTTYPE_ENUM "" TAB_VERB "%.1" "" COMPU_TAB_REF RTE_CM_ENUM_FETFAULTTYPE_ENUM /end COMPU_METHOD
/begin COMPU_VTAB_RANGE RTE_CM_ENUM_FETFAULTTYPE_ENUM "" 3 0 0 "NOFAULT" 1 1 "LOWER" 2 2 "UPPER" /end COMPU_VTAB_RANGE
