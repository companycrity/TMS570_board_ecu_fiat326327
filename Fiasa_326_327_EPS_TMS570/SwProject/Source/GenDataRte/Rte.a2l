/**********************************************************************************************************************
* COPYRIGHT
* Copyright (c) 2006-2011 by Vector Informatik GmbH. All rights reserved.
* This software is copyright protected and proprietary to Vector Informatik GmbH.
* Vector Informatik GmbH grants to you only those rights as set out in the license conditions.
* All other rights remain with Vector Informatik GmbH.
* FILE DESCRIPTION
* File: Rte.a2l
* Workspace: C:/Users/mzjphh/Desktop/Fiasa_326_327_05.01.00/Fiasa_326_327_EPS_TMS570/Tools/AsrProject/Config/DCF/EPS.dcf
* ECU-Project: EPS
* Generator: MICROSAR RTE Generator Version 2.19.1
* License: License CBD1010124 valid for CBD1010124 Nexteer Package: BMW MSR SIP BAC3.0 Micro: TI TMS570 TMS570LS30306 Compiler: Code Composer Studio 4.9.0
* Description: MICROSAR RTE A2L file
*********************************************************************************************************************/
/**********************************************************************************************************************
* MEASUREMENT
*********************************************************************************************************************/
/begin MEASUREMENT Rte_DigMSB_AlignedCumMechMtrPosCRF_Deg_f32 "MICROSAR RTE" FLOAT32_IEEE NO_COMPU_METHOD 0 0 1.175494351e-38 3.402823466e+38 ECU_ADDRESS 0 /end MEASUREMENT
/begin MEASUREMENT Rte_ComplErr_ComplErr_HwDeg_f32 "MICROSAR RTE" FLOAT32_IEEE NO_COMPU_METHOD 0 0 1.175494351e-38 3.402823466e+38 ECU_ADDRESS 0 /end MEASUREMENT
/begin MEASUREMENT Rte_DigMSB_CumMechMtrPosCRF_Deg_f32 "MICROSAR RTE" FLOAT32_IEEE NO_COMPU_METHOD 0 0 1.175494351e-38 3.402823466e+38 ECU_ADDRESS 0 /end MEASUREMENT
/begin MEASUREMENT Rte_DiagMgr10_DiagStsHWASbSystmFltPres_Cnt_lgc "MICROSAR RTE" UBYTE RTE_CM_BOOLEAN 0 0 0 255 ECU_ADDRESS 0 /end MEASUREMENT
/begin MEASUREMENT Rte_AbsHwPos_EOLVehCntrOffset.EOLHwPosTrimPerformed_Cnt_u16 "MICROSAR RTE" UWORD NO_COMPU_METHOD 0 0 0 65535 ECU_ADDRESS 0 READ_WRITE /end MEASUREMENT
/begin MEASUREMENT Rte_AbsHwPos_EOLVehCntrOffset.EOLVehCntrOffset_HwDeg_f32 "MICROSAR RTE" FLOAT32_IEEE NO_COMPU_METHOD 0 0 1.175494351e-38 3.402823466e+38 ECU_ADDRESS 0 READ_WRITE /end MEASUREMENT
/begin MEASUREMENT Rte_AbsHwPos_HandwheelAuthority_Uls_f32 "MICROSAR RTE" FLOAT32_IEEE NO_COMPU_METHOD 0 0 1.175494351e-38 3.402823466e+38 ECU_ADDRESS 0 /end MEASUREMENT
/begin MEASUREMENT Rte_AbsHwPos_HandwheelPosition_HwDeg_f32 "MICROSAR RTE" FLOAT32_IEEE NO_COMPU_METHOD 0 0 1.175494351e-38 3.402823466e+38 ECU_ADDRESS 0 /end MEASUREMENT
/begin MEASUREMENT Rte_AbsHwPos_HwPosSource_Cnt_u16 "MICROSAR RTE" UWORD NO_COMPU_METHOD 0 0 0 65535 ECU_ADDRESS 0 /end MEASUREMENT
/begin MEASUREMENT Rte_Sa_DigColPs_I2CHwAbsPos_HwDeg_f32 "MICROSAR RTE" FLOAT32_IEEE NO_COMPU_METHOD 0 0 1.175494351e-38 3.402823466e+38 ECU_ADDRESS 0 /end MEASUREMENT
/begin MEASUREMENT Rte_Sa_DigColPs_I2CHwAbsPosValid_Cnt_lgc "MICROSAR RTE" UBYTE RTE_CM_BOOLEAN 0 0 0 255 ECU_ADDRESS 0 /end MEASUREMENT
/begin MEASUREMENT Rte_CDDInterface_MEC_Cnt_enum "MICROSAR RTE" UBYTE RTE_CM_ENUM_ManufModeType 0 0 0 2 ECU_ADDRESS 0 /end MEASUREMENT
/begin MEASUREMENT Rte_AbsHwPos_RelHwPos_HwDeg_f32 "MICROSAR RTE" FLOAT32_IEEE NO_COMPU_METHOD 0 0 1.175494351e-38 3.402823466e+38 ECU_ADDRESS 0 /end MEASUREMENT
/begin MEASUREMENT Rte_VehDyn_SensorlessAuthority_Uls_f32 "MICROSAR RTE" FLOAT32_IEEE NO_COMPU_METHOD 0 0 1.175494351e-38 3.402823466e+38 ECU_ADDRESS 0 /end MEASUREMENT
/begin MEASUREMENT Rte_VehDyn_SensorlessHwPos_HwDeg_f32 "MICROSAR RTE" FLOAT32_IEEE NO_COMPU_METHOD 0 0 1.175494351e-38 3.402823466e+38 ECU_ADDRESS 0 /end MEASUREMENT
/begin MEASUREMENT Rte_AbsHwPos_SrlComHwPos_HwDeg_f32 "MICROSAR RTE" FLOAT32_IEEE NO_COMPU_METHOD 0 0 1.175494351e-38 3.402823466e+38 ECU_ADDRESS 0 /end MEASUREMENT
/begin MEASUREMENT Rte_AbsHwPos_SrlComHwPosStatus_Cnt_u16 "MICROSAR RTE" UWORD NO_COMPU_METHOD 0 0 0 65535 ECU_ADDRESS 0 /end MEASUREMENT
/begin MEASUREMENT Rte_DigMSB_AlignedCumMechMtrPosStatus_Cnt_u08 "MICROSAR RTE" UBYTE NO_COMPU_METHOD 0 0 0 255 ECU_ADDRESS 0 /end MEASUREMENT
/begin MEASUREMENT Rte_CDDInterface_PullCompSrlComSvcDft_Cnt_lgc "MICROSAR RTE" UBYTE RTE_CM_BOOLEAN 0 0 0 255 ECU_ADDRESS 0 /end MEASUREMENT
/begin MEASUREMENT Rte_MtrVel_HandwheelVel_HwRadpS_f32 "MICROSAR RTE" FLOAT32_IEEE NO_COMPU_METHOD 0 0 1.175494351e-38 3.402823466e+38 ECU_ADDRESS 0 /end MEASUREMENT
/begin MEASUREMENT Rte_Sweep_OutputHwTrq_HwNm_f32 "MICROSAR RTE" FLOAT32_IEEE NO_COMPU_METHOD 0 0 1.175494351e-38 3.402823466e+38 ECU_ADDRESS 0 /end MEASUREMENT
/begin MEASUREMENT Rte_ActivePull_PullCompCmd_MtrNm_f32 "MICROSAR RTE" FLOAT32_IEEE NO_COMPU_METHOD 0 0 1.175494351e-38 3.402823466e+38 ECU_ADDRESS 0 /end MEASUREMENT
/begin MEASUREMENT Rte_ActivePull_SrlComYawRate_DegpS_f32 "MICROSAR RTE" FLOAT32_IEEE NO_COMPU_METHOD 0 0 1.175494351e-38 3.402823466e+38 ECU_ADDRESS 0 /end MEASUREMENT
/begin MEASUREMENT Rte_SignlCondn_VehicleSpeed_Kph_f32 "MICROSAR RTE" FLOAT32_IEEE NO_COMPU_METHOD 0 0 1.175494351e-38 3.402823466e+38 ECU_ADDRESS 0 /end MEASUREMENT
/begin MEASUREMENT Rte_SrlComInput_VehicleSpeedValid_Cnt_lgc "MICROSAR RTE" UBYTE RTE_CM_BOOLEAN 0 0 0 255 ECU_ADDRESS 0 /end MEASUREMENT
/begin MEASUREMENT Rte_ApXcp_ActiveTunOvrPtrAddr_Cnt_u32 "MICROSAR RTE" ULONG NO_COMPU_METHOD 0 0 0 4294967295 ECU_ADDRESS 0 /end MEASUREMENT
/begin MEASUREMENT Rte_TuningSelAuth_ActiveTunPers_Cnt_u16 "MICROSAR RTE" UWORD NO_COMPU_METHOD 0 0 0 65535 ECU_ADDRESS 0 /end MEASUREMENT
/begin MEASUREMENT Rte_TuningSelAuth_ActiveTunSet_Cnt_u16 "MICROSAR RTE" UWORD NO_COMPU_METHOD 0 0 0 65535 ECU_ADDRESS 0 /end MEASUREMENT
/begin MEASUREMENT Rte_ApXcp_DesiredTunPers_Cnt_u16 "MICROSAR RTE" UWORD NO_COMPU_METHOD 0 0 0 65535 ECU_ADDRESS 0 /end MEASUREMENT
/begin MEASUREMENT Rte_DiagSvc_DesiredTunSet_Cnt_u16 "MICROSAR RTE" UWORD NO_COMPU_METHOD 0 0 0 65535 ECU_ADDRESS 0 /end MEASUREMENT
/begin MEASUREMENT Rte_Assist_AssistDDFactor_Uls_f32 "MICROSAR RTE" FLOAT32_IEEE NO_COMPU_METHOD 0 0 1.175494351e-38 3.402823466e+38 ECU_ADDRESS 0 /end MEASUREMENT
/begin MEASUREMENT Rte_Assist_BaseAssistCmd_MtrNm_f32 "MICROSAR RTE" FLOAT32_IEEE NO_COMPU_METHOD 0 0 1.175494351e-38 3.402823466e+38 ECU_ADDRESS 0 /end MEASUREMENT
/begin MEASUREMENT Rte_CDDInterface_DftAsstTbl_Cnt_lgc "MICROSAR RTE" UBYTE RTE_CM_BOOLEAN 0 0 0 255 ECU_ADDRESS 0 /end MEASUREMENT
/begin MEASUREMENT Rte_ThrmlDutyCycle_DutyCycleLevel_Uls_f32 "MICROSAR RTE" FLOAT32_IEEE NO_COMPU_METHOD 0 0 1.175494351e-38 3.402823466e+38 ECU_ADDRESS 0 /end MEASUREMENT
/begin MEASUREMENT Rte_CDDInterface_DwnldAsstGain_Uls_f32 "MICROSAR RTE" FLOAT32_IEEE NO_COMPU_METHOD 0 0 1.175494351e-38 3.402823466e+38 ECU_ADDRESS 0 /end MEASUREMENT
/begin MEASUREMENT Rte_Assist_HwTrqHysAdd_HwNm_f32 "MICROSAR RTE" FLOAT32_IEEE NO_COMPU_METHOD 0 0 1.175494351e-38 3.402823466e+38 ECU_ADDRESS 0 /end MEASUREMENT
/begin MEASUREMENT Rte_Assist_IpTrqOvr_HwNm_f32 "MICROSAR RTE" FLOAT32_IEEE NO_COMPU_METHOD 0 0 1.175494351e-38 3.402823466e+38 ECU_ADDRESS 0 /end MEASUREMENT
/begin MEASUREMENT Rte_Assist_WIRCmdAmpBlnd_MtrNm_f32 "MICROSAR RTE" FLOAT32_IEEE NO_COMPU_METHOD 0 0 1.175494351e-38 3.402823466e+38 ECU_ADDRESS 0 /end MEASUREMENT
/begin MEASUREMENT Rte_AssistFirewall_AsstFirewallActive_Uls_f32 "MICROSAR RTE" FLOAT32_IEEE NO_COMPU_METHOD 0 0 1.175494351e-38 3.402823466e+38 ECU_ADDRESS 0 /end MEASUREMENT
/begin MEASUREMENT Rte_AssistFirewall_CombinedAssist_MtrNm_f32 "MICROSAR RTE" FLOAT32_IEEE NO_COMPU_METHOD 0 0 1.175494351e-38 3.402823466e+38 ECU_ADDRESS 0 /end MEASUREMENT
/begin MEASUREMENT Rte_HighFreqAssist_HighFreqAssist_MtrNm_f32 "MICROSAR RTE" FLOAT32_IEEE NO_COMPU_METHOD 0 0 1.175494351e-38 3.402823466e+38 ECU_ADDRESS 0 /end MEASUREMENT
/begin MEASUREMENT Rte_HystComp_HysteresisComp_MtrNm_f32 "MICROSAR RTE" FLOAT32_IEEE NO_COMPU_METHOD 0 0 1.175494351e-38 3.402823466e+38 ECU_ADDRESS 0 /end MEASUREMENT
/begin MEASUREMENT Rte_StabilityComp_AssistCmd_MtrNm_f32 "MICROSAR RTE" FLOAT32_IEEE NO_COMPU_METHOD 0 0 1.175494351e-38 3.402823466e+38 ECU_ADDRESS 0 /end MEASUREMENT
/begin MEASUREMENT Rte_EtDmpFw_EOTDampingLtd_MtrNm_f32 "MICROSAR RTE" FLOAT32_IEEE NO_COMPU_METHOD 0 0 1.175494351e-38 3.402823466e+38 ECU_ADDRESS 0 /end MEASUREMENT
/begin MEASUREMENT Rte_LmtCod_EOTGainLtd_Uls_f32 "MICROSAR RTE" FLOAT32_IEEE NO_COMPU_METHOD 0 0 1.175494351e-38 3.402823466e+38 ECU_ADDRESS 0 /end MEASUREMENT
/begin MEASUREMENT Rte_LmtCod_EOTLimitLtd_MtrNm_f32 "MICROSAR RTE" FLOAT32_IEEE NO_COMPU_METHOD 0 0 1.175494351e-38 3.402823466e+38 ECU_ADDRESS 0 /end MEASUREMENT
/begin MEASUREMENT Rte_LmtCod_StallLimitLtd_MtrNm_f32 "MICROSAR RTE" FLOAT32_IEEE NO_COMPU_METHOD 0 0 1.175494351e-38 3.402823466e+38 ECU_ADDRESS 0 /end MEASUREMENT
/begin MEASUREMENT Rte_LmtCod_VehSpdLimitLtd_MtrNm_f32 "MICROSAR RTE" FLOAT32_IEEE NO_COMPU_METHOD 0 0 1.175494351e-38 3.402823466e+38 ECU_ADDRESS 0 /end MEASUREMENT
/begin MEASUREMENT Rte_DampingFirewall_CombinedDamping_MtrNm_f32 "MICROSAR RTE" FLOAT32_IEEE NO_COMPU_METHOD 0 0 1.175494351e-38 3.402823466e+38 ECU_ADDRESS 0 /end MEASUREMENT
/begin MEASUREMENT Rte_CDDInterface_LimitSrlComSvcDft_Cnt_lgc "MICROSAR RTE" UBYTE RTE_CM_BOOLEAN 0 0 0 255 ECU_ADDRESS 0 /end MEASUREMENT
/begin MEASUREMENT Rte_AstLmt_LimitPercentFiltered_Uls_f32 "MICROSAR RTE" FLOAT32_IEEE NO_COMPU_METHOD 0 0 1.175494351e-38 3.402823466e+38 ECU_ADDRESS 0 /end MEASUREMENT
/begin MEASUREMENT Rte_ReturnFirewall_LimitedReturn_MtrNm_f32 "MICROSAR RTE" FLOAT32_IEEE NO_COMPU_METHOD 0 0 1.175494351e-38 3.402823466e+38 ECU_ADDRESS 0 /end MEASUREMENT
/begin MEASUREMENT Rte_AstLmt_LrnPnCtrCCDisable_Cnt_lgc "MICROSAR RTE" UBYTE RTE_CM_BOOLEAN 0 0 0 255 ECU_ADDRESS 0 /end MEASUREMENT
/begin MEASUREMENT Rte_AstLmt_LrnPnCtrEnable_Cnt_lgc "MICROSAR RTE" UBYTE RTE_CM_BOOLEAN 0 0 0 255 ECU_ADDRESS 0 /end MEASUREMENT
/begin MEASUREMENT Rte_AstLmt_LrnPnCtrTCmd_MtrNm_f32 "MICROSAR RTE" FLOAT32_IEEE NO_COMPU_METHOD 0 0 1.175494351e-38 3.402823466e+38 ECU_ADDRESS 0 /end MEASUREMENT
/begin MEASUREMENT Rte_AstLmt_OpTrqOvr_MtrNm_f32 "MICROSAR RTE" FLOAT32_IEEE NO_COMPU_METHOD 0 0 1.175494351e-38 3.402823466e+38 ECU_ADDRESS 0 /end MEASUREMENT
/begin MEASUREMENT Rte_LmtCod_OutputRampMultLtd_Uls_f32 "MICROSAR RTE" FLOAT32_IEEE NO_COMPU_METHOD 0 0 1.175494351e-38 3.402823466e+38 ECU_ADDRESS 0 /end MEASUREMENT
/begin MEASUREMENT Rte_AstLmt_PosServCCDisable_Cnt_lgc "MICROSAR RTE" UBYTE RTE_CM_BOOLEAN 0 0 0 255 ECU_ADDRESS 0 /end MEASUREMENT
/begin MEASUREMENT Rte_PwrLmtFuncCr_FltTrqLmt_Uls_f32 "MICROSAR RTE" FLOAT32_IEEE NO_COMPU_METHOD 0 0 1.175494351e-38 3.402823466e+38 ECU_ADDRESS 0 /end MEASUREMENT
/begin MEASUREMENT Rte_AstLmt_PreLimitForStall_MtrNm_f32 "MICROSAR RTE" FLOAT32_IEEE NO_COMPU_METHOD 0 0 1.175494351e-38 3.402823466e+38 ECU_ADDRESS 0 /end MEASUREMENT
/begin MEASUREMENT Rte_AstLmt_PreLimitTorque_MtrNm_f32 "MICROSAR RTE" FLOAT32_IEEE NO_COMPU_METHOD 0 0 1.175494351e-38 3.402823466e+38 ECU_ADDRESS 0 /end MEASUREMENT
/begin MEASUREMENT Rte_AstLmt_PrkAssistCmd_MtrNm_f32 "MICROSAR RTE" FLOAT32_IEEE NO_COMPU_METHOD 0 0 1.175494351e-38 3.402823466e+38 ECU_ADDRESS 0 /end MEASUREMENT
/begin MEASUREMENT Rte_AstLmt_SteerAsstDefeat "MICROSAR RTE" UBYTE RTE_CM_BOOLEAN 0 0 0 255 ECU_ADDRESS 0 READ_WRITE /end MEASUREMENT
/begin MEASUREMENT Rte_AstLmt_SumLimTrqCmd_MtrNm_f32 "MICROSAR RTE" FLOAT32_IEEE NO_COMPU_METHOD 0 0 1.175494351e-38 3.402823466e+38 ECU_ADDRESS 0 /end MEASUREMENT
/begin MEASUREMENT Rte_AstLmt_TSMitCommand_MtrNm_f32 "MICROSAR RTE" FLOAT32_IEEE NO_COMPU_METHOD 0 0 1.175494351e-38 3.402823466e+38 ECU_ADDRESS 0 /end MEASUREMENT
/begin MEASUREMENT Rte_LmtCod_ThermalLimitLtd_MtrNm_f32 "MICROSAR RTE" FLOAT32_IEEE NO_COMPU_METHOD 0 0 1.175494351e-38 3.402823466e+38 ECU_ADDRESS 0 /end MEASUREMENT
/begin MEASUREMENT Rte_ThrmlDutyCycle_ThermLimitPerc_Uls_f32 "MICROSAR RTE" FLOAT32_IEEE NO_COMPU_METHOD 0 0 1.175494351e-38 3.402823466e+38 ECU_ADDRESS 0 /end MEASUREMENT
/begin MEASUREMENT Rte_AstLmt_TrqLimitMin_MtrNm_f32 "MICROSAR RTE" FLOAT32_IEEE NO_COMPU_METHOD 0 0 1.175494351e-38 3.402823466e+38 ECU_ADDRESS 0 /end MEASUREMENT
/begin MEASUREMENT Rte_AstLmt_WheelImbalanceCmd_MtrNm_f32 "MICROSAR RTE" FLOAT32_IEEE NO_COMPU_METHOD 0 0 1.175494351e-38 3.402823466e+38 ECU_ADDRESS 0 /end MEASUREMENT
/begin MEASUREMENT Rte_AvgFricLrn_AvgFricLrnData.EOLFric_HwNm_f32 "MICROSAR RTE" FLOAT32_IEEE NO_COMPU_METHOD 0 0 1.175494351e-38 3.402823466e+38 ECU_ADDRESS 0 READ_WRITE /end MEASUREMENT
/begin MEASUREMENT Rte_AvgFricLrn_AvgFricLrnData.EnableFricLearning_Cnt_lgc "MICROSAR RTE" UBYTE RTE_CM_BOOLEAN 0 0 0 255 ECU_ADDRESS 0 READ_WRITE /end MEASUREMENT
/begin MEASUREMENT Rte_AvgFricLrn_AvgFricLrnData.EnableFricOffsetOutput_Cnt_lgc "MICROSAR RTE" UBYTE RTE_CM_BOOLEAN 0 0 0 255 ECU_ADDRESS 0 READ_WRITE /end MEASUREMENT
/begin MEASUREMENT Rte_AvgFricLrn_AvgFricLrnData.FricOffset_HwNm_f32 "MICROSAR RTE" FLOAT32_IEEE NO_COMPU_METHOD 0 0 1.175494351e-38 3.402823466e+38 ECU_ADDRESS 0 READ_WRITE /end MEASUREMENT
/begin MEASUREMENT Rte_AvgFricLrn_AvgFricLrnData.OpMode_Cnt_enum "MICROSAR RTE" UBYTE NO_COMPU_METHOD 0 0 0 255 ECU_ADDRESS 0 READ_WRITE /end MEASUREMENT
/begin MEASUREMENT Rte_AvgFricLrn_AvgFricLrnData.RangeCounter_Cnt_u16 "MICROSAR RTE" UWORD NO_COMPU_METHOD 0 0 0 65535 MATRIX_DIM 8 3 1 ECU_ADDRESS 0 READ_WRITE /end MEASUREMENT
/begin MEASUREMENT Rte_AvgFricLrn_AvgFricLrnData.Theta_HwNm_f32 "MICROSAR RTE" FLOAT32_IEEE NO_COMPU_METHOD 0 0 1.175494351e-38 3.402823466e+38 MATRIX_DIM 8 4 1 ECU_ADDRESS 0 READ_WRITE /end MEASUREMENT
/begin MEASUREMENT Rte_AvgFricLrn_AvgFricLrnData.VehLearnedFric_HwNm_f32 "MICROSAR RTE" FLOAT32_IEEE NO_COMPU_METHOD 0 0 1.175494351e-38 3.402823466e+38 MATRIX_DIM 4 1 1 ECU_ADDRESS 0 READ_WRITE /end MEASUREMENT
/begin MEASUREMENT Rte_CtrldDisShtdn_CntDisMtrTrqCmdCRF_MtrNm_f32 "MICROSAR RTE" FLOAT32_IEEE NO_COMPU_METHOD 0 0 1.175494351e-38 3.402823466e+38 ECU_ADDRESS 0 /end MEASUREMENT
/begin MEASUREMENT Rte_CDDInterface_FricLrnSrlComSvcDft_Cnt_lgc "MICROSAR RTE" UBYTE RTE_CM_BOOLEAN 0 0 0 255 ECU_ADDRESS 0 /end MEASUREMENT
/begin MEASUREMENT Rte_AvgFricLrn_EstFric_HwNm_f32 "MICROSAR RTE" FLOAT32_IEEE NO_COMPU_METHOD 0 0 1.175494351e-38 3.402823466e+38 ECU_ADDRESS 0 /end MEASUREMENT
/begin MEASUREMENT Rte_AvgFricLrn_FricOffset_HwNm_f32 "MICROSAR RTE" FLOAT32_IEEE NO_COMPU_METHOD 0 0 1.175494351e-38 3.402823466e+38 ECU_ADDRESS 0 /end MEASUREMENT
/begin MEASUREMENT Rte_AvgFricLrn_SatEstFric_HwNm_f32 "MICROSAR RTE" FLOAT32_IEEE NO_COMPU_METHOD 0 0 1.175494351e-38 3.402823466e+38 ECU_ADDRESS 0 /end MEASUREMENT
/begin MEASUREMENT Rte_MtrTempEst_AssistMechTempEst_DegC_f32 "MICROSAR RTE" FLOAT32_IEEE NO_COMPU_METHOD 0 0 1.175494351e-38 3.402823466e+38 ECU_ADDRESS 0 /end MEASUREMENT
/begin MEASUREMENT Rte_IoHwAbstractionUsr_Batt_Volt_f32 "This signal is intended to communicate any type voltage signal measured by the ecu.  This signal has a lower limit of 0 which reequires users of the signal to provide divide by 0 protection if it is used as a denominator in a calculation.  See Vecu port p" FLOAT32_IEEE NO_COMPU_METHOD 0 0 1.175494351e-38 3.402823466e+38 ECU_ADDRESS 0 /end MEASUREMENT
/begin MEASUREMENT Rte_BVDiag_CCLMSAActive_Cnt_lgc "MICROSAR RTE" UBYTE RTE_CM_BOOLEAN 0 0 0 255 ECU_ADDRESS 0 /end MEASUREMENT
/begin MEASUREMENT Rte_BVDiag_NTCB0Enbl_Cnt_lgc "MICROSAR RTE" UBYTE RTE_CM_BOOLEAN 0 0 0 255 ECU_ADDRESS 0 /end MEASUREMENT
/begin MEASUREMENT Rte_BVDiag_NTCB1Enbl_Cnt_lgc "MICROSAR RTE" UBYTE RTE_CM_BOOLEAN 0 0 0 255 ECU_ADDRESS 0 /end MEASUREMENT
/begin MEASUREMENT Rte_IoHwAbstractionUsr_BattSwitched_Volt_f32 "This signal is intended to communicate any type voltage signal measured by the ecu.  This signal has a lower limit of 0 which reequires users of the signal to provide divide by 0 protection if it is used as a denominator in a calculation.  See Vecu port p" FLOAT32_IEEE NO_COMPU_METHOD 0 0 1.175494351e-38 3.402823466e+38 ECU_ADDRESS 0 /end MEASUREMENT
/begin MEASUREMENT Rte_BatteryVoltage_OvervoltageData.MaxBattVoltage_Volts_f32 "MICROSAR RTE" FLOAT32_IEEE NO_COMPU_METHOD 0 0 1.175494351e-38 3.402823466e+38 ECU_ADDRESS 0 READ_WRITE /end MEASUREMENT
/begin MEASUREMENT Rte_BatteryVoltage_OvervoltageData.OvervoltageCounter_Cnt_u16 "MICROSAR RTE" UWORD NO_COMPU_METHOD 0 0 0 65535 ECU_ADDRESS 0 READ_WRITE /end MEASUREMENT
/begin MEASUREMENT Rte_IoHwAbstractionUsr_SysCVSwitch_Volt_f32 "This signal is intended to communicate any type voltage signal measured by the ecu.  This signal has a lower limit of 0 which reequires users of the signal to provide divide by 0 protection if it is used as a denominator in a calculation.  See Vecu port p" FLOAT32_IEEE NO_COMPU_METHOD 0 0 1.175494351e-38 3.402823466e+38 ECU_ADDRESS 0 /end MEASUREMENT
/begin MEASUREMENT Rte_BatteryVoltage_SysC_Vecu_Volt_f32 "This port prototype is inteded to communicate voltage signals that represent the ecu supplied voltage.  This signal has a lower limit, which is non-zero, to allow users of the signal to use it as a denominator in an expression without requiring a divide b" FLOAT32_IEEE NO_COMPU_METHOD 0 0 1.175494351e-38 3.402823466e+38 ECU_ADDRESS 0 /end MEASUREMENT
/begin MEASUREMENT Rte_BatteryVoltage_Vecu_Volt_f32 "This port prototype is inteded to communicate voltage signals that represent the ecu supplied voltage.  This signal has a lower limit, which is non-zero, to allow users of the signal to use it as a denominator in an expression without requiring a divide b" FLOAT32_IEEE NO_COMPU_METHOD 0 0 1.175494351e-38 3.402823466e+38 ECU_ADDRESS 0 /end MEASUREMENT
/begin MEASUREMENT Rte_BatteryVoltage_VswitchClosed_Cnt_lgc "MICROSAR RTE" UBYTE RTE_CM_BOOLEAN 0 0 0 255 ECU_ADDRESS 0 /end MEASUREMENT
/begin MEASUREMENT Rte_MtrVel_MotorVelMRF_MtrRadpS_f32 "MICROSAR RTE" FLOAT32_IEEE NO_COMPU_METHOD 0 0 1.175494351e-38 3.402823466e+38 ECU_ADDRESS 0 /end MEASUREMENT
/begin MEASUREMENT Rte_BkCpPc_OVERRIDESIGDIAGADC_Volt_f32 "This signal is intended to communicate any type voltage signal measured by the ecu.  This signal has a lower limit of 0 which reequires users of the signal to provide divide by 0 protection if it is used as a denominator in a calculation.  See Vecu port p" FLOAT32_IEEE NO_COMPU_METHOD 0 0 1.175494351e-38 3.402823466e+38 ECU_ADDRESS 0 /end MEASUREMENT
/begin MEASUREMENT Rte_BkCpPc_PMOSDIAGADC_Volt_f32 "This signal is intended to communicate any type voltage signal measured by the ecu.  This signal has a lower limit of 0 which reequires users of the signal to provide divide by 0 protection if it is used as a denominator in a calculation.  See Vecu port p" FLOAT32_IEEE NO_COMPU_METHOD 0 0 1.175494351e-38 3.402823466e+38 ECU_ADDRESS 0 /end MEASUREMENT
/begin MEASUREMENT Rte_BkCpPc_PwrDiscATestComplete_Cnt_lgc "MICROSAR RTE" UBYTE RTE_CM_BOOLEAN 0 0 0 255 ECU_ADDRESS 0 /end MEASUREMENT
/begin MEASUREMENT Rte_HwPwUp_PwrDiscATestStart_Cnt_lgc "MICROSAR RTE" UBYTE RTE_CM_BOOLEAN 0 0 0 255 ECU_ADDRESS 0 /end MEASUREMENT
/begin MEASUREMENT Rte_BkCpPc_PwrDiscBTestComplete_Cnt_lgc "MICROSAR RTE" UBYTE RTE_CM_BOOLEAN 0 0 0 255 ECU_ADDRESS 0 /end MEASUREMENT
/begin MEASUREMENT Rte_HwPwUp_PwrDiscBTestStart_Cnt_lgc "MICROSAR RTE" UBYTE RTE_CM_BOOLEAN 0 0 0 255 ECU_ADDRESS 0 /end MEASUREMENT
/begin MEASUREMENT Rte_BkCpPc_PwrDiscClosed_Cnt_lgc "MICROSAR RTE" UBYTE RTE_CM_BOOLEAN 0 0 0 255 ECU_ADDRESS 0 /end MEASUREMENT
/begin MEASUREMENT Rte_CDDInterface_ADCMtrCurr1_Volts_f32 "MICROSAR RTE" FLOAT32_IEEE NO_COMPU_METHOD 0 0 1.175494351e-38 3.402823466e+38 ECU_ADDRESS 0 /end MEASUREMENT
/begin MEASUREMENT Rte_CDDInterface_ADCMtrCurr2_Volts_f32 "MICROSAR RTE" FLOAT32_IEEE NO_COMPU_METHOD 0 0 1.175494351e-38 3.402823466e+38 ECU_ADDRESS 0 /end MEASUREMENT
/begin MEASUREMENT Rte_CmMtrCurr_ComOffset_Cnt_u16 "MICROSAR RTE" UWORD NO_COMPU_METHOD 0 0 0 65535 ECU_ADDRESS 0 /end MEASUREMENT
/begin MEASUREMENT Rte_CDDInterface_CorrMtrCurrPosition_Rev_f32 "MICROSAR RTE" FLOAT32_IEEE NO_COMPU_METHOD 0 0 1.175494351e-38 3.402823466e+38 ECU_ADDRESS 0 /end MEASUREMENT
/begin MEASUREMENT Rte_CDDInterface_CorrMtrPosElec_Rev_f32 "MICROSAR RTE" FLOAT32_IEEE NO_COMPU_METHOD 0 0 1.175494351e-38 3.402823466e+38 ECU_ADDRESS 0 /end MEASUREMENT
/begin MEASUREMENT Rte_CDDInterface_CorrectedElecMtrPos_Rev_u0p16 "MICROSAR RTE" UWORD NO_COMPU_METHOD 0 0 0 65535 ECU_ADDRESS 0 /end MEASUREMENT
/begin MEASUREMENT Rte_CDDInterface_CumMechMtrPos_Rev_f32 "MICROSAR RTE" FLOAT32_IEEE NO_COMPU_METHOD 0 0 1.175494351e-38 3.402823466e+38 ECU_ADDRESS 0 /end MEASUREMENT
/begin MEASUREMENT Rte_CDDInterface_DampingSrlComSvcDft_Cnt_lgc "MICROSAR RTE" UBYTE RTE_CM_BOOLEAN 0 0 0 255 ECU_ADDRESS 0 /end MEASUREMENT
/begin MEASUREMENT Rte_CDDInterface_Die1RxError_Cnt_u16 "MICROSAR RTE" UWORD NO_COMPU_METHOD 0 0 0 65535 ECU_ADDRESS 0 /end MEASUREMENT
/begin MEASUREMENT Rte_CDDInterface_Die1RxMtrPos_Cnt_u16 "MICROSAR RTE" UWORD NO_COMPU_METHOD 0 0 0 65535 ECU_ADDRESS 0 /end MEASUREMENT
/begin MEASUREMENT Rte_CDDInterface_Die1RxRevCtr_Cnt_u16 "MICROSAR RTE" UWORD NO_COMPU_METHOD 0 0 0 65535 ECU_ADDRESS 0 /end MEASUREMENT
/begin MEASUREMENT Rte_CDDInterface_Die1UnderVoltgFltAccum_Cnt_u16 "MICROSAR RTE" UWORD NO_COMPU_METHOD 0 0 0 65535 ECU_ADDRESS 0 /end MEASUREMENT
/begin MEASUREMENT Rte_CDDInterface_Die2RxError_Cnt_u16 "MICROSAR RTE" UWORD NO_COMPU_METHOD 0 0 0 65535 ECU_ADDRESS 0 /end MEASUREMENT
/begin MEASUREMENT Rte_CDDInterface_Die2RxMtrPos_Cnt_u16 "MICROSAR RTE" UWORD NO_COMPU_METHOD 0 0 0 65535 ECU_ADDRESS 0 /end MEASUREMENT
/begin MEASUREMENT Rte_CDDInterface_Die2RxRevCtr_Cnt_u16 "MICROSAR RTE" UWORD NO_COMPU_METHOD 0 0 0 65535 ECU_ADDRESS 0 /end MEASUREMENT
/begin MEASUREMENT Rte_CDDInterface_DrivingDynSrlComSvcDft_Cnt_lgc "MICROSAR RTE" UBYTE RTE_CM_BOOLEAN 0 0 0 255 ECU_ADDRESS 0 /end MEASUREMENT
/begin MEASUREMENT Rte_CDDInterface_EOTImpactSrlComSvcDft_Cnt_lgc "MICROSAR RTE" UBYTE RTE_CM_BOOLEAN 0 0 0 255 ECU_ADDRESS 0 /end MEASUREMENT
/begin MEASUREMENT Rte_CDDInterface_EOTThermalSrlComSvcDft_Cnt_lgc "MICROSAR RTE" UBYTE RTE_CM_BOOLEAN 0 0 0 255 ECU_ADDRESS 0 /end MEASUREMENT
/begin MEASUREMENT Rte_CDDInterface_EngONSrlComSvcDft_Cnt_lgc "MICROSAR RTE" UBYTE RTE_CM_BOOLEAN 0 0 0 255 ECU_ADDRESS 0 /end MEASUREMENT
/begin MEASUREMENT Rte_CDDInterface_ExpectedOnTimeA_Cnt_u32 "MICROSAR RTE" ULONG NO_COMPU_METHOD 0 0 0 4294967295 ECU_ADDRESS 0 /end MEASUREMENT
/begin MEASUREMENT Rte_CDDInterface_ExpectedOnTimeB_Cnt_u32 "MICROSAR RTE" ULONG NO_COMPU_METHOD 0 0 0 4294967295 ECU_ADDRESS 0 /end MEASUREMENT
/begin MEASUREMENT Rte_CDDInterface_ExpectedOnTimeC_Cnt_u32 "MICROSAR RTE" ULONG NO_COMPU_METHOD 0 0 0 4294967295 ECU_ADDRESS 0 /end MEASUREMENT
/begin MEASUREMENT Rte_CDDInterface_FreqDepDmpSrlComSvcDft_Cnt_lgc "MICROSAR RTE" UBYTE RTE_CM_BOOLEAN 0 0 0 255 ECU_ADDRESS 0 /end MEASUREMENT
/begin MEASUREMENT Rte_CDDInterface_HysAddSrlComSvcDft_Cnt_lgc "MICROSAR RTE" UBYTE RTE_CM_BOOLEAN 0 0 0 255 ECU_ADDRESS 0 /end MEASUREMENT
/begin MEASUREMENT Rte_CDDInterface_HystCompSrlComSvcDft_Cnt_lgc "MICROSAR RTE" UBYTE RTE_CM_BOOLEAN 0 0 0 255 ECU_ADDRESS 0 /end MEASUREMENT
/begin MEASUREMENT Rte_CDDInterface_IgnCnt_Cnt_u16 "MICROSAR RTE" UWORD NO_COMPU_METHOD 0 0 0 65535 ECU_ADDRESS 0 /end MEASUREMENT
/begin MEASUREMENT Rte_CDDInterface_KinIntDiagSrlComSvcDft_Cnt_lgc "MICROSAR RTE" UBYTE RTE_CM_BOOLEAN 0 0 0 255 ECU_ADDRESS 0 /end MEASUREMENT
/begin MEASUREMENT Rte_CDDInterface_LRPRPhaseadvanceCaptured_Cnt_s16 "MICROSAR RTE" SWORD NO_COMPU_METHOD 0 0 -32768 32767 ECU_ADDRESS 0 /end MEASUREMENT
/begin MEASUREMENT Rte_CDDInterface_MeasuredOnTimeA_Cnt_u32 "MICROSAR RTE" ULONG NO_COMPU_METHOD 0 0 0 4294967295 ECU_ADDRESS 0 /end MEASUREMENT
/begin MEASUREMENT Rte_CDDInterface_MeasuredOnTimeB_Cnt_u32 "MICROSAR RTE" ULONG NO_COMPU_METHOD 0 0 0 4294967295 ECU_ADDRESS 0 /end MEASUREMENT
/begin MEASUREMENT Rte_CDDInterface_MeasuredOnTimeC_Cnt_u32 "MICROSAR RTE" ULONG NO_COMPU_METHOD 0 0 0 4294967295 ECU_ADDRESS 0 /end MEASUREMENT
/begin MEASUREMENT Rte_CDDInterface_MechMtrPos1_Rev_f32 "MICROSAR RTE" FLOAT32_IEEE NO_COMPU_METHOD 0 0 1.175494351e-38 3.402823466e+38 ECU_ADDRESS 0 /end MEASUREMENT
/begin MEASUREMENT Rte_CDDInterface_MechMtrPos1TimeStamp_USec_u32 "MICROSAR RTE" ULONG NO_COMPU_METHOD 0 0 0 4294967295 ECU_ADDRESS 0 /end MEASUREMENT
/begin MEASUREMENT Rte_CDDInterface_MechMtrPos2TimeStamp_USec_u32 "MICROSAR RTE" ULONG NO_COMPU_METHOD 0 0 0 4294967295 ECU_ADDRESS 0 /end MEASUREMENT
/begin MEASUREMENT Rte_CDDInterface_MfgDiagInhibit_Cnt_lgc "MICROSAR RTE" UBYTE RTE_CM_BOOLEAN 0 0 0 255 ECU_ADDRESS 0 /end MEASUREMENT
/begin MEASUREMENT Rte_CDDInterface_ModIdxFinal_Uls_f32 "MICROSAR RTE" FLOAT32_IEEE NO_COMPU_METHOD 0 0 1.175494351e-38 3.402823466e+38 ECU_ADDRESS 0 /end MEASUREMENT
/begin MEASUREMENT Rte_CDDInterface_ModIdxSrlComSvcDft_Cnt_lgc "MICROSAR RTE" UBYTE RTE_CM_BOOLEAN 0 0 0 255 ECU_ADDRESS 0 /end MEASUREMENT
/begin MEASUREMENT Rte_CmMtrCurr_MtrCurr1TempOffset_Volt_f32 "This signal is intended to communicate any type voltage signal measured by the ecu.  This signal has a lower limit of 0 which reequires users of the signal to provide divide by 0 protection if it is used as a denominator in a calculation.  See Vecu port p" FLOAT32_IEEE NO_COMPU_METHOD 0 0 1.175494351e-38 3.402823466e+38 ECU_ADDRESS 0 /end MEASUREMENT
/begin MEASUREMENT Rte_CmMtrCurr_MtrCurr2TempOffset_Volt_f32 "This signal is intended to communicate any type voltage signal measured by the ecu.  This signal has a lower limit of 0 which reequires users of the signal to provide divide by 0 protection if it is used as a denominator in a calculation.  See Vecu port p" FLOAT32_IEEE NO_COMPU_METHOD 0 0 1.175494351e-38 3.402823466e+38 ECU_ADDRESS 0 /end MEASUREMENT
/begin MEASUREMENT Rte_CDDInterface_MtrCurrDax_Amp_f32 "MICROSAR RTE" FLOAT32_IEEE NO_COMPU_METHOD 0 0 1.175494351e-38 3.402823466e+38 ECU_ADDRESS 0 /end MEASUREMENT
/begin MEASUREMENT Rte_CDDInterface_MtrCurrK1_Amp_f32 "MICROSAR RTE" FLOAT32_IEEE NO_COMPU_METHOD 0 0 1.175494351e-38 3.402823466e+38 ECU_ADDRESS 0 /end MEASUREMENT
/begin MEASUREMENT Rte_CDDInterface_MtrCurrK2_Amp_f32 "MICROSAR RTE" FLOAT32_IEEE NO_COMPU_METHOD 0 0 1.175494351e-38 3.402823466e+38 ECU_ADDRESS 0 /end MEASUREMENT
/begin MEASUREMENT Rte_CDDInterface_MtrCurrQax_Amp_f32 "MICROSAR RTE" FLOAT32_IEEE NO_COMPU_METHOD 0 0 1.175494351e-38 3.402823466e+38 ECU_ADDRESS 0 /end MEASUREMENT
/begin MEASUREMENT Rte_CDDInterface_MtrCurrQaxFinalRef_Amp_f32 "MICROSAR RTE" FLOAT32_IEEE NO_COMPU_METHOD 0 0 1.175494351e-38 3.402823466e+38 ECU_ADDRESS 0 /end MEASUREMENT
/begin MEASUREMENT Rte_Polarity_MtrElecMechPolarity_Cnt_s08 "MICROSAR RTE" SBYTE NO_COMPU_METHOD 0 0 -128 127 ECU_ADDRESS 0 /end MEASUREMENT
/begin MEASUREMENT Rte_CDDInterface_MtrParmNrmLrnSrlComSvcDft_Cnt_lgc "MICROSAR RTE" UBYTE RTE_CM_BOOLEAN 0 0 0 255 ECU_ADDRESS 0 /end MEASUREMENT
/begin MEASUREMENT Rte_Polarity_MtrPosPolarity_Cnt_s08 "MICROSAR RTE" SBYTE NO_COMPU_METHOD 0 0 -128 127 ECU_ADDRESS 0 /end MEASUREMENT
/begin MEASUREMENT Rte_CDDInterface_MtrTrqCmdSign_Cnt_s16 "MICROSAR RTE" SWORD NO_COMPU_METHOD 0 0 -32768 32767 ECU_ADDRESS 0 /end MEASUREMENT
/begin MEASUREMENT Rte_CDDInterface_MtrVelNrmLrnSrlComSvcDft_Cnt_lgc "MICROSAR RTE" UBYTE RTE_CM_BOOLEAN 0 0 0 255 ECU_ADDRESS 0 /end MEASUREMENT
/begin MEASUREMENT Rte_CDDInterface_MtrVoltDax_Volt_f32 "This signal is intended to communicate any type voltage signal measured by the ecu.  This signal has a lower limit of 0 which reequires users of the signal to provide divide by 0 protection if it is used as a denominator in a calculation.  See Vecu port p" FLOAT32_IEEE NO_COMPU_METHOD 0 0 1.175494351e-38 3.402823466e+38 ECU_ADDRESS 0 /end MEASUREMENT
/begin MEASUREMENT Rte_CDDInterface_MtrVoltQax_Volt_f32 "This signal is intended to communicate any type voltage signal measured by the ecu.  This signal has a lower limit of 0 which reequires users of the signal to provide divide by 0 protection if it is used as a denominator in a calculation.  See Vecu port p" FLOAT32_IEEE NO_COMPU_METHOD 0 0 1.175494351e-38 3.402823466e+38 ECU_ADDRESS 0 /end MEASUREMENT
/begin MEASUREMENT Rte_CDDInterface_MultIgnSrlComSvcDft_Cnt_lgc "MICROSAR RTE" UBYTE RTE_CM_BOOLEAN 0 0 0 255 ECU_ADDRESS 0 /end MEASUREMENT
/begin MEASUREMENT Rte_CDDInterface_ParkAstSrlComSvcDft_Cnt_lgc "MICROSAR RTE" UBYTE RTE_CM_BOOLEAN 0 0 0 255 ECU_ADDRESS 0 /end MEASUREMENT
/begin MEASUREMENT Rte_CDDInterface_ReturnSrlComSvcDft_Cnt_lgc "MICROSAR RTE" UBYTE RTE_CM_BOOLEAN 0 0 0 255 ECU_ADDRESS 0 /end MEASUREMENT
/begin MEASUREMENT Rte_CDDInterface_RxMsgsSrlComSvcDft_Cnt_lgc "MICROSAR RTE" UBYTE RTE_CM_BOOLEAN 0 0 0 255 ECU_ADDRESS 0 /end MEASUREMENT
/begin MEASUREMENT Rte_CDDInterface_RxMtrPosParityAccum_Cnt_u16 "MICROSAR RTE" UWORD NO_COMPU_METHOD 0 0 0 65535 ECU_ADDRESS 0 /end MEASUREMENT
/begin MEASUREMENT Rte_ModeMachine_StaMd_SystemState_Mode "MICROSAR RTE" UBYTE RTE_CM_ENUM_StaMd_Mode 0 0 0 255 ECU_ADDRESS 0 /end MEASUREMENT
/begin MEASUREMENT Rte_ModeMachine_StaMd9_SystemState9_Mode "MICROSAR RTE" UBYTE RTE_CM_ENUM_StaMd_Mode 0 0 0 255 ECU_ADDRESS 0 /end MEASUREMENT
/**********************************************************************************************************************
* GROUP
*********************************************************************************************************************/
/begin GROUP AbsHwPos "MICROSAR RTE"
 /begin SUB_GROUP AbsHwPos.PerInstanceMemories AbsHwPos.ReceiverPorts AbsHwPos.SenderPorts /end SUB_GROUP
 /begin FUNCTION_LIST /end FUNCTION_LIST
 /begin REF_CHARACTERISTIC /end REF_CHARACTERISTIC
 /begin REF_MEASUREMENT /end REF_MEASUREMENT
/end GROUP
/begin GROUP AbsHwPos.AlignedCumMechMtrPosCRF.Deg_f32 "MICROSAR RTE" /begin SUB_GROUP /end SUB_GROUP /begin FUNCTION_LIST /end FUNCTION_LIST /begin REF_CHARACTERISTIC /end REF_CHARACTERISTIC /begin REF_MEASUREMENT Rte_DigMSB_AlignedCumMechMtrPosCRF_Deg_f32 /end REF_MEASUREMENT /end GROUP
/begin GROUP AbsHwPos.ComplError.HwDeg_f32 "MICROSAR RTE" /begin SUB_GROUP /end SUB_GROUP /begin FUNCTION_LIST /end FUNCTION_LIST /begin REF_CHARACTERISTIC /end REF_CHARACTERISTIC /begin REF_MEASUREMENT Rte_ComplErr_ComplErr_HwDeg_f32 /end REF_MEASUREMENT /end GROUP
/begin GROUP AbsHwPos.CumMechMtrPosCRF.Deg_f32 "MICROSAR RTE" /begin SUB_GROUP /end SUB_GROUP /begin FUNCTION_LIST /end FUNCTION_LIST /begin REF_CHARACTERISTIC /end REF_CHARACTERISTIC /begin REF_MEASUREMENT Rte_DigMSB_CumMechMtrPosCRF_Deg_f32 /end REF_MEASUREMENT /end GROUP
/begin GROUP AbsHwPos.DiagStatusHwPosReducedPerf.Cnt_lgc "MICROSAR RTE" /begin SUB_GROUP /end SUB_GROUP /begin FUNCTION_LIST /end FUNCTION_LIST /begin REF_CHARACTERISTIC /end REF_CHARACTERISTIC /begin REF_MEASUREMENT Rte_DiagMgr10_DiagStsHWASbSystmFltPres_Cnt_lgc /end REF_MEASUREMENT /end GROUP
/begin GROUP AbsHwPos.EOLVehCntrOffset "MICROSAR RTE" /begin SUB_GROUP /end SUB_GROUP /begin FUNCTION_LIST /end FUNCTION_LIST /begin REF_CHARACTERISTIC /end REF_CHARACTERISTIC
 /begin REF_MEASUREMENT Rte_AbsHwPos_EOLVehCntrOffset.EOLHwPosTrimPerformed_Cnt_u16 Rte_AbsHwPos_EOLVehCntrOffset.EOLVehCntrOffset_HwDeg_f32 /end REF_MEASUREMENT
/end GROUP
/begin GROUP AbsHwPos.HandwheelAuthority.Uls_f32 "MICROSAR RTE" /begin SUB_GROUP /end SUB_GROUP /begin FUNCTION_LIST /end FUNCTION_LIST /begin REF_CHARACTERISTIC /end REF_CHARACTERISTIC /begin REF_MEASUREMENT Rte_AbsHwPos_HandwheelAuthority_Uls_f32 /end REF_MEASUREMENT /end GROUP
/begin GROUP AbsHwPos.HandwheelPosition.HwDeg_f32 "MICROSAR RTE" /begin SUB_GROUP /end SUB_GROUP /begin FUNCTION_LIST /end FUNCTION_LIST /begin REF_CHARACTERISTIC /end REF_CHARACTERISTIC /begin REF_MEASUREMENT Rte_AbsHwPos_HandwheelPosition_HwDeg_f32 /end REF_MEASUREMENT /end GROUP
/begin GROUP AbsHwPos.HwPosSource.Cnt_u16 "MICROSAR RTE" /begin SUB_GROUP /end SUB_GROUP /begin FUNCTION_LIST /end FUNCTION_LIST /begin REF_CHARACTERISTIC /end REF_CHARACTERISTIC /begin REF_MEASUREMENT Rte_AbsHwPos_HwPosSource_Cnt_u16 /end REF_MEASUREMENT /end GROUP
/begin GROUP AbsHwPos.I2CHwAbsPos.HwDeg_f32 "MICROSAR RTE" /begin SUB_GROUP /end SUB_GROUP /begin FUNCTION_LIST /end FUNCTION_LIST /begin REF_CHARACTERISTIC /end REF_CHARACTERISTIC /begin REF_MEASUREMENT Rte_Sa_DigColPs_I2CHwAbsPos_HwDeg_f32 /end REF_MEASUREMENT /end GROUP
/begin GROUP AbsHwPos.I2CHwAbsPosValid.Cnt_lgc "MICROSAR RTE" /begin SUB_GROUP /end SUB_GROUP /begin FUNCTION_LIST /end FUNCTION_LIST /begin REF_CHARACTERISTIC /end REF_CHARACTERISTIC /begin REF_MEASUREMENT Rte_Sa_DigColPs_I2CHwAbsPosValid_Cnt_lgc /end REF_MEASUREMENT /end GROUP
/begin GROUP AbsHwPos.ManufMode.Cnt_enum "MICROSAR RTE" /begin SUB_GROUP /end SUB_GROUP /begin FUNCTION_LIST /end FUNCTION_LIST /begin REF_CHARACTERISTIC /end REF_CHARACTERISTIC /begin REF_MEASUREMENT Rte_CDDInterface_MEC_Cnt_enum /end REF_MEASUREMENT /end GROUP
/begin GROUP AbsHwPos.PerInstanceMemories "MICROSAR RTE" /begin SUB_GROUP AbsHwPos.EOLVehCntrOffset /end SUB_GROUP /begin FUNCTION_LIST /end FUNCTION_LIST /begin REF_CHARACTERISTIC /end REF_CHARACTERISTIC /begin REF_MEASUREMENT /end REF_MEASUREMENT /end GROUP
/begin GROUP AbsHwPos.ReceiverPorts "MICROSAR RTE"
 /begin SUB_GROUP AbsHwPos.AlignedCumMechMtrPosCRF.Deg_f32 AbsHwPos.ComplError.HwDeg_f32 AbsHwPos.CumMechMtrPosCRF.Deg_f32 AbsHwPos.DiagStatusHwPosReducedPerf.Cnt_lgc AbsHwPos.I2CHwAbsPos.HwDeg_f32 AbsHwPos.I2CHwAbsPosValid.Cnt_lgc AbsHwPos.ManufMode.Cnt_enum AbsHwPos.SensorlessAuthority.Uls_f32 AbsHwPos.SensorlessHwPos.HwDeg_f32 AbsHwPos.TurnsCntrValidity.Cnt_u08 /end SUB_GROUP
 /begin FUNCTION_LIST /end FUNCTION_LIST
 /begin REF_CHARACTERISTIC /end REF_CHARACTERISTIC
 /begin REF_MEASUREMENT /end REF_MEASUREMENT
/end GROUP
/begin GROUP AbsHwPos.RelHwPos.HwDeg_f32 "MICROSAR RTE" /begin SUB_GROUP /end SUB_GROUP /begin FUNCTION_LIST /end FUNCTION_LIST /begin REF_CHARACTERISTIC /end REF_CHARACTERISTIC /begin REF_MEASUREMENT Rte_AbsHwPos_RelHwPos_HwDeg_f32 /end REF_MEASUREMENT /end GROUP
/begin GROUP AbsHwPos.SenderPorts "MICROSAR RTE"
 /begin SUB_GROUP AbsHwPos.HandwheelAuthority.Uls_f32 AbsHwPos.HandwheelPosition.HwDeg_f32 AbsHwPos.HwPosSource.Cnt_u16 AbsHwPos.RelHwPos.HwDeg_f32 AbsHwPos.SrlComHwPos.HwDeg_f32 AbsHwPos.SrlComHwPosStatus.Cnt_u16 /end SUB_GROUP
 /begin FUNCTION_LIST /end FUNCTION_LIST
 /begin REF_CHARACTERISTIC /end REF_CHARACTERISTIC
 /begin REF_MEASUREMENT /end REF_MEASUREMENT
/end GROUP
/begin GROUP AbsHwPos.SensorlessAuthority.Uls_f32 "MICROSAR RTE" /begin SUB_GROUP /end SUB_GROUP /begin FUNCTION_LIST /end FUNCTION_LIST /begin REF_CHARACTERISTIC /end REF_CHARACTERISTIC /begin REF_MEASUREMENT Rte_VehDyn_SensorlessAuthority_Uls_f32 /end REF_MEASUREMENT /end GROUP
/begin GROUP AbsHwPos.SensorlessHwPos.HwDeg_f32 "MICROSAR RTE" /begin SUB_GROUP /end SUB_GROUP /begin FUNCTION_LIST /end FUNCTION_LIST /begin REF_CHARACTERISTIC /end REF_CHARACTERISTIC /begin REF_MEASUREMENT Rte_VehDyn_SensorlessHwPos_HwDeg_f32 /end REF_MEASUREMENT /end GROUP
/begin GROUP AbsHwPos.SrlComHwPos.HwDeg_f32 "MICROSAR RTE" /begin SUB_GROUP /end SUB_GROUP /begin FUNCTION_LIST /end FUNCTION_LIST /begin REF_CHARACTERISTIC /end REF_CHARACTERISTIC /begin REF_MEASUREMENT Rte_AbsHwPos_SrlComHwPos_HwDeg_f32 /end REF_MEASUREMENT /end GROUP
/begin GROUP AbsHwPos.SrlComHwPosStatus.Cnt_u16 "MICROSAR RTE" /begin SUB_GROUP /end SUB_GROUP /begin FUNCTION_LIST /end FUNCTION_LIST /begin REF_CHARACTERISTIC /end REF_CHARACTERISTIC /begin REF_MEASUREMENT Rte_AbsHwPos_SrlComHwPosStatus_Cnt_u16 /end REF_MEASUREMENT /end GROUP
/begin GROUP AbsHwPos.TurnsCntrValidity.Cnt_u08 "MICROSAR RTE" /begin SUB_GROUP /end SUB_GROUP /begin FUNCTION_LIST /end FUNCTION_LIST /begin REF_CHARACTERISTIC /end REF_CHARACTERISTIC /begin REF_MEASUREMENT Rte_DigMSB_AlignedCumMechMtrPosStatus_Cnt_u08 /end REF_MEASUREMENT /end GROUP
/begin GROUP ActivePull "MICROSAR RTE"
 /begin SUB_GROUP ActivePull.ModeRequirePorts ActivePull.ReceiverPorts ActivePull.SenderPorts /end SUB_GROUP
 /begin FUNCTION_LIST /end FUNCTION_LIST
 /begin REF_CHARACTERISTIC /end REF_CHARACTERISTIC
 /begin REF_MEASUREMENT /end REF_MEASUREMENT
/end GROUP
/begin GROUP ActivePull.DisableLearning.Cnt_lgc "MICROSAR RTE" /begin SUB_GROUP /end SUB_GROUP /begin FUNCTION_LIST /end FUNCTION_LIST /begin REF_CHARACTERISTIC /end REF_CHARACTERISTIC /begin REF_MEASUREMENT Rte_CDDInterface_PullCompSrlComSvcDft_Cnt_lgc /end REF_MEASUREMENT /end GROUP
/begin GROUP ActivePull.DisableOutput.Cnt_lgc "MICROSAR RTE" /begin SUB_GROUP /end SUB_GROUP /begin FUNCTION_LIST /end FUNCTION_LIST /begin REF_CHARACTERISTIC /end REF_CHARACTERISTIC /begin REF_MEASUREMENT Rte_CDDInterface_PullCompSrlComSvcDft_Cnt_lgc /end REF_MEASUREMENT /end GROUP
/begin GROUP ActivePull.HandwheelAuthority.Uls_f32 "MICROSAR RTE" /begin SUB_GROUP /end SUB_GROUP /begin FUNCTION_LIST /end FUNCTION_LIST /begin REF_CHARACTERISTIC /end REF_CHARACTERISTIC /begin REF_MEASUREMENT Rte_AbsHwPos_HandwheelAuthority_Uls_f32 /end REF_MEASUREMENT /end GROUP
/begin GROUP ActivePull.HandwheelPosition.HwDeg_f32 "MICROSAR RTE" /begin SUB_GROUP /end SUB_GROUP /begin FUNCTION_LIST /end FUNCTION_LIST /begin REF_CHARACTERISTIC /end REF_CHARACTERISTIC /begin REF_MEASUREMENT Rte_AbsHwPos_HandwheelPosition_HwDeg_f32 /end REF_MEASUREMENT /end GROUP
/begin GROUP ActivePull.HandwheelVelocity.HwRadpS_f32 "MICROSAR RTE" /begin SUB_GROUP /end SUB_GROUP /begin FUNCTION_LIST /end FUNCTION_LIST /begin REF_CHARACTERISTIC /end REF_CHARACTERISTIC /begin REF_MEASUREMENT Rte_MtrVel_HandwheelVel_HwRadpS_f32 /end REF_MEASUREMENT /end GROUP
/begin GROUP ActivePull.HwTorque.HwNm_f32 "MICROSAR RTE" /begin SUB_GROUP /end SUB_GROUP /begin FUNCTION_LIST /end FUNCTION_LIST /begin REF_CHARACTERISTIC /end REF_CHARACTERISTIC /begin REF_MEASUREMENT Rte_Sweep_OutputHwTrq_HwNm_f32 /end REF_MEASUREMENT /end GROUP
/begin GROUP ActivePull.ModeRequirePorts "MICROSAR RTE" /begin SUB_GROUP ActivePull.SystemState.Mode /end SUB_GROUP /begin FUNCTION_LIST /end FUNCTION_LIST /begin REF_CHARACTERISTIC /end REF_CHARACTERISTIC /begin REF_MEASUREMENT /end REF_MEASUREMENT /end GROUP
/begin GROUP ActivePull.PullCompCmd.MtrNm_f32 "MICROSAR RTE" /begin SUB_GROUP /end SUB_GROUP /begin FUNCTION_LIST /end FUNCTION_LIST /begin REF_CHARACTERISTIC /end REF_CHARACTERISTIC /begin REF_MEASUREMENT Rte_ActivePull_PullCompCmd_MtrNm_f32 /end REF_MEASUREMENT /end GROUP
/begin GROUP ActivePull.ReceiverPorts "MICROSAR RTE"
 /begin SUB_GROUP ActivePull.DisableLearning.Cnt_lgc ActivePull.DisableOutput.Cnt_lgc ActivePull.HandwheelAuthority.Uls_f32 ActivePull.HandwheelPosition.HwDeg_f32 ActivePull.HandwheelVelocity.HwRadpS_f32 ActivePull.HwTorque.HwNm_f32 ActivePull.SrlComYawRate.DegpS_f32 ActivePull.VehicleSpeed.Kph_f32 ActivePull.VehicleSpeedValid.Cnt_lgc /end SUB_GROUP
 /begin FUNCTION_LIST /end FUNCTION_LIST
 /begin REF_CHARACTERISTIC /end REF_CHARACTERISTIC
 /begin REF_MEASUREMENT /end REF_MEASUREMENT
/end GROUP
/begin GROUP ActivePull.SenderPorts "MICROSAR RTE" /begin SUB_GROUP ActivePull.PullCompCmd.MtrNm_f32 /end SUB_GROUP /begin FUNCTION_LIST /end FUNCTION_LIST /begin REF_CHARACTERISTIC /end REF_CHARACTERISTIC /begin REF_MEASUREMENT /end REF_MEASUREMENT /end GROUP
/begin GROUP ActivePull.SrlComYawRate.DegpS_f32 "MICROSAR RTE" /begin SUB_GROUP /end SUB_GROUP /begin FUNCTION_LIST /end FUNCTION_LIST /begin REF_CHARACTERISTIC /end REF_CHARACTERISTIC /begin REF_MEASUREMENT Rte_ActivePull_SrlComYawRate_DegpS_f32 /end REF_MEASUREMENT /end GROUP
/begin GROUP ActivePull.SystemState.Mode "MICROSAR RTE" /begin SUB_GROUP /end SUB_GROUP /begin FUNCTION_LIST /end FUNCTION_LIST /begin REF_CHARACTERISTIC /end REF_CHARACTERISTIC /begin REF_MEASUREMENT Rte_ModeMachine_StaMd9_SystemState9_Mode /end REF_MEASUREMENT /end GROUP
/begin GROUP ActivePull.VehicleSpeed.Kph_f32 "MICROSAR RTE" /begin SUB_GROUP /end SUB_GROUP /begin FUNCTION_LIST /end FUNCTION_LIST /begin REF_CHARACTERISTIC /end REF_CHARACTERISTIC /begin REF_MEASUREMENT Rte_SignlCondn_VehicleSpeed_Kph_f32 /end REF_MEASUREMENT /end GROUP
/begin GROUP ActivePull.VehicleSpeedValid.Cnt_lgc "MICROSAR RTE" /begin SUB_GROUP /end SUB_GROUP /begin FUNCTION_LIST /end FUNCTION_LIST /begin REF_CHARACTERISTIC /end REF_CHARACTERISTIC /begin REF_MEASUREMENT Rte_SrlComInput_VehicleSpeedValid_Cnt_lgc /end REF_MEASUREMENT /end GROUP
/begin GROUP ApXcp "MICROSAR RTE" /begin SUB_GROUP ApXcp.ReceiverPorts ApXcp.SenderPorts /end SUB_GROUP /begin FUNCTION_LIST /end FUNCTION_LIST /begin REF_CHARACTERISTIC /end REF_CHARACTERISTIC /begin REF_MEASUREMENT /end REF_MEASUREMENT /end GROUP
/begin GROUP ApXcp.ActiveTunOvrPtrAddr.Cnt_u32 "MICROSAR RTE" /begin SUB_GROUP /end SUB_GROUP /begin FUNCTION_LIST /end FUNCTION_LIST /begin REF_CHARACTERISTIC /end REF_CHARACTERISTIC /begin REF_MEASUREMENT Rte_ApXcp_ActiveTunOvrPtrAddr_Cnt_u32 /end REF_MEASUREMENT /end GROUP
/begin GROUP ApXcp.ActiveTunPers.Cnt_u16 "MICROSAR RTE" /begin SUB_GROUP /end SUB_GROUP /begin FUNCTION_LIST /end FUNCTION_LIST /begin REF_CHARACTERISTIC /end REF_CHARACTERISTIC /begin REF_MEASUREMENT Rte_TuningSelAuth_ActiveTunPers_Cnt_u16 /end REF_MEASUREMENT /end GROUP
/begin GROUP ApXcp.ActiveTunSet.Cnt_u16 "MICROSAR RTE" /begin SUB_GROUP /end SUB_GROUP /begin FUNCTION_LIST /end FUNCTION_LIST /begin REF_CHARACTERISTIC /end REF_CHARACTERISTIC /begin REF_MEASUREMENT Rte_TuningSelAuth_ActiveTunSet_Cnt_u16 /end REF_MEASUREMENT /end GROUP
/begin GROUP ApXcp.DesiredTunPers.Cnt_u16 "MICROSAR RTE" /begin SUB_GROUP /end SUB_GROUP /begin FUNCTION_LIST /end FUNCTION_LIST /begin REF_CHARACTERISTIC /end REF_CHARACTERISTIC /begin REF_MEASUREMENT Rte_ApXcp_DesiredTunPers_Cnt_u16 /end REF_MEASUREMENT /end GROUP
/begin GROUP ApXcp.DesiredTunSet.Cnt_u16 "MICROSAR RTE" /begin SUB_GROUP /end SUB_GROUP /begin FUNCTION_LIST /end FUNCTION_LIST /begin REF_CHARACTERISTIC /end REF_CHARACTERISTIC /begin REF_MEASUREMENT Rte_DiagSvc_DesiredTunSet_Cnt_u16 /end REF_MEASUREMENT /end GROUP
/begin GROUP ApXcp.ReceiverPorts "MICROSAR RTE"
 /begin SUB_GROUP ApXcp.ActiveTunPers.Cnt_u16 ApXcp.ActiveTunSet.Cnt_u16 ApXcp.DesiredTunPers.Cnt_u16 ApXcp.DesiredTunSet.Cnt_u16 /end SUB_GROUP
 /begin FUNCTION_LIST /end FUNCTION_LIST
 /begin REF_CHARACTERISTIC /end REF_CHARACTERISTIC
 /begin REF_MEASUREMENT /end REF_MEASUREMENT
/end GROUP
/begin GROUP ApXcp.SenderPorts "MICROSAR RTE" /begin SUB_GROUP ApXcp.ActiveTunOvrPtrAddr.Cnt_u32 /end SUB_GROUP /begin FUNCTION_LIST /end FUNCTION_LIST /begin REF_CHARACTERISTIC /end REF_CHARACTERISTIC /begin REF_MEASUREMENT /end REF_MEASUREMENT /end GROUP
/begin GROUP Assist "MICROSAR RTE" /begin SUB_GROUP Assist.ReceiverPorts Assist.SenderPorts /end SUB_GROUP /begin FUNCTION_LIST /end FUNCTION_LIST /begin REF_CHARACTERISTIC /end REF_CHARACTERISTIC /begin REF_MEASUREMENT /end REF_MEASUREMENT /end GROUP
/begin GROUP Assist.AssistDDFactor.Uls_f32 "MICROSAR RTE" /begin SUB_GROUP /end SUB_GROUP /begin FUNCTION_LIST /end FUNCTION_LIST /begin REF_CHARACTERISTIC /end REF_CHARACTERISTIC /begin REF_MEASUREMENT Rte_Assist_AssistDDFactor_Uls_f32 /end REF_MEASUREMENT /end GROUP
/begin GROUP Assist.BaseAssistCmd.MtrNm_f32 "MICROSAR RTE" /begin SUB_GROUP /end SUB_GROUP /begin FUNCTION_LIST /end FUNCTION_LIST /begin REF_CHARACTERISTIC /end REF_CHARACTERISTIC /begin REF_MEASUREMENT Rte_Assist_BaseAssistCmd_MtrNm_f32 /end REF_MEASUREMENT /end GROUP
/begin GROUP Assist.DftAsstTbl.Cnt_lgc "MICROSAR RTE" /begin SUB_GROUP /end SUB_GROUP /begin FUNCTION_LIST /end FUNCTION_LIST /begin REF_CHARACTERISTIC /end REF_CHARACTERISTIC /begin REF_MEASUREMENT Rte_CDDInterface_DftAsstTbl_Cnt_lgc /end REF_MEASUREMENT /end GROUP
/begin GROUP Assist.DutyCycleLevel.Uls_f32 "MICROSAR RTE" /begin SUB_GROUP /end SUB_GROUP /begin FUNCTION_LIST /end FUNCTION_LIST /begin REF_CHARACTERISTIC /end REF_CHARACTERISTIC /begin REF_MEASUREMENT Rte_ThrmlDutyCycle_DutyCycleLevel_Uls_f32 /end REF_MEASUREMENT /end GROUP
/begin GROUP Assist.DwnldAsstGain.Uls_f32 "MICROSAR RTE" /begin SUB_GROUP /end SUB_GROUP /begin FUNCTION_LIST /end FUNCTION_LIST /begin REF_CHARACTERISTIC /end REF_CHARACTERISTIC /begin REF_MEASUREMENT Rte_CDDInterface_DwnldAsstGain_Uls_f32 /end REF_MEASUREMENT /end GROUP
/begin GROUP Assist.HwTrq.HwNm_f32 "MICROSAR RTE" /begin SUB_GROUP /end SUB_GROUP /begin FUNCTION_LIST /end FUNCTION_LIST /begin REF_CHARACTERISTIC /end REF_CHARACTERISTIC /begin REF_MEASUREMENT Rte_Sweep_OutputHwTrq_HwNm_f32 /end REF_MEASUREMENT /end GROUP
/begin GROUP Assist.HwTrqHysAdd.HwNm_f32 "MICROSAR RTE" /begin SUB_GROUP /end SUB_GROUP /begin FUNCTION_LIST /end FUNCTION_LIST /begin REF_CHARACTERISTIC /end REF_CHARACTERISTIC /begin REF_MEASUREMENT Rte_Assist_HwTrqHysAdd_HwNm_f32 /end REF_MEASUREMENT /end GROUP
/begin GROUP Assist.IpTrqOvr.HwNm_f32 "MICROSAR RTE" /begin SUB_GROUP /end SUB_GROUP /begin FUNCTION_LIST /end FUNCTION_LIST /begin REF_CHARACTERISTIC /end REF_CHARACTERISTIC /begin REF_MEASUREMENT Rte_Assist_IpTrqOvr_HwNm_f32 /end REF_MEASUREMENT /end GROUP
/begin GROUP Assist.ReceiverPorts "MICROSAR RTE"
 /begin SUB_GROUP Assist.AssistDDFactor.Uls_f32 Assist.DftAsstTbl.Cnt_lgc Assist.DutyCycleLevel.Uls_f32 Assist.DwnldAsstGain.Uls_f32 Assist.HwTrq.HwNm_f32 Assist.HwTrqHysAdd.HwNm_f32 Assist.IpTrqOvr.HwNm_f32 Assist.VehSpd.Kph_f32 Assist.WIRCmdAmpBlnd.MtrNm_f32 /end SUB_GROUP
 /begin FUNCTION_LIST /end FUNCTION_LIST
 /begin REF_CHARACTERISTIC /end REF_CHARACTERISTIC
 /begin REF_MEASUREMENT /end REF_MEASUREMENT
/end GROUP
/begin GROUP Assist.SenderPorts "MICROSAR RTE" /begin SUB_GROUP Assist.BaseAssistCmd.MtrNm_f32 /end SUB_GROUP /begin FUNCTION_LIST /end FUNCTION_LIST /begin REF_CHARACTERISTIC /end REF_CHARACTERISTIC /begin REF_MEASUREMENT /end REF_MEASUREMENT /end GROUP
/begin GROUP Assist.VehSpd.Kph_f32 "MICROSAR RTE" /begin SUB_GROUP /end SUB_GROUP /begin FUNCTION_LIST /end FUNCTION_LIST /begin REF_CHARACTERISTIC /end REF_CHARACTERISTIC /begin REF_MEASUREMENT Rte_SignlCondn_VehicleSpeed_Kph_f32 /end REF_MEASUREMENT /end GROUP
/begin GROUP Assist.WIRCmdAmpBlnd.MtrNm_f32 "MICROSAR RTE" /begin SUB_GROUP /end SUB_GROUP /begin FUNCTION_LIST /end FUNCTION_LIST /begin REF_CHARACTERISTIC /end REF_CHARACTERISTIC /begin REF_MEASUREMENT Rte_Assist_WIRCmdAmpBlnd_MtrNm_f32 /end REF_MEASUREMENT /end GROUP
/begin GROUP AssistFirewall "MICROSAR RTE"
 /begin SUB_GROUP AssistFirewall.ModeRequirePorts AssistFirewall.ReceiverPorts AssistFirewall.SenderPorts /end SUB_GROUP
 /begin FUNCTION_LIST /end FUNCTION_LIST
 /begin REF_CHARACTERISTIC /end REF_CHARACTERISTIC
 /begin REF_MEASUREMENT /end REF_MEASUREMENT
/end GROUP
/begin GROUP AssistFirewall.AsstFirewallActive.Uls_f32 "MICROSAR RTE" /begin SUB_GROUP /end SUB_GROUP /begin FUNCTION_LIST /end FUNCTION_LIST /begin REF_CHARACTERISTIC /end REF_CHARACTERISTIC /begin REF_MEASUREMENT Rte_AssistFirewall_AsstFirewallActive_Uls_f32 /end REF_MEASUREMENT /end GROUP
/begin GROUP AssistFirewall.BaseAssistCmd.MtrNm_f32 "MICROSAR RTE" /begin SUB_GROUP /end SUB_GROUP /begin FUNCTION_LIST /end FUNCTION_LIST /begin REF_CHARACTERISTIC /end REF_CHARACTERISTIC /begin REF_MEASUREMENT Rte_Assist_BaseAssistCmd_MtrNm_f32 /end REF_MEASUREMENT /end GROUP
/begin GROUP AssistFirewall.CombinedAssist.MtrNm_f32 "MICROSAR RTE" /begin SUB_GROUP /end SUB_GROUP /begin FUNCTION_LIST /end FUNCTION_LIST /begin REF_CHARACTERISTIC /end REF_CHARACTERISTIC /begin REF_MEASUREMENT Rte_AssistFirewall_CombinedAssist_MtrNm_f32 /end REF_MEASUREMENT /end GROUP
/begin GROUP AssistFirewall.Defeat_AsstTbl_Service.Cnt_lgc "MICROSAR RTE" /begin SUB_GROUP /end SUB_GROUP /begin FUNCTION_LIST /end FUNCTION_LIST /begin REF_CHARACTERISTIC /end REF_CHARACTERISTIC /begin REF_MEASUREMENT Rte_CDDInterface_DftAsstTbl_Cnt_lgc /end REF_MEASUREMENT /end GROUP
/begin GROUP AssistFirewall.HighFreqAssist.MtrNm_f32 "MICROSAR RTE" /begin SUB_GROUP /end SUB_GROUP /begin FUNCTION_LIST /end FUNCTION_LIST /begin REF_CHARACTERISTIC /end REF_CHARACTERISTIC /begin REF_MEASUREMENT Rte_HighFreqAssist_HighFreqAssist_MtrNm_f32 /end REF_MEASUREMENT /end GROUP
/begin GROUP AssistFirewall.HwTorque.HwNm_f32 "MICROSAR RTE" /begin SUB_GROUP /end SUB_GROUP /begin FUNCTION_LIST /end FUNCTION_LIST /begin REF_CHARACTERISTIC /end REF_CHARACTERISTIC /begin REF_MEASUREMENT Rte_Sweep_OutputHwTrq_HwNm_f32 /end REF_MEASUREMENT /end GROUP
/begin GROUP AssistFirewall.HysteresisComp.MtrNm_f32 "MICROSAR RTE" /begin SUB_GROUP /end SUB_GROUP /begin FUNCTION_LIST /end FUNCTION_LIST /begin REF_CHARACTERISTIC /end REF_CHARACTERISTIC /begin REF_MEASUREMENT Rte_HystComp_HysteresisComp_MtrNm_f32 /end REF_MEASUREMENT /end GROUP
/begin GROUP AssistFirewall.MEC_Counter.Cnt_enum "MICROSAR RTE" /begin SUB_GROUP /end SUB_GROUP /begin FUNCTION_LIST /end FUNCTION_LIST /begin REF_CHARACTERISTIC /end REF_CHARACTERISTIC /begin REF_MEASUREMENT Rte_CDDInterface_MEC_Cnt_enum /end REF_MEASUREMENT /end GROUP
/begin GROUP AssistFirewall.ModeRequirePorts "MICROSAR RTE" /begin SUB_GROUP AssistFirewall.SystemState.Mode /end SUB_GROUP /begin FUNCTION_LIST /end FUNCTION_LIST /begin REF_CHARACTERISTIC /end REF_CHARACTERISTIC /begin REF_MEASUREMENT /end REF_MEASUREMENT /end GROUP
/begin GROUP AssistFirewall.ReceiverPorts "MICROSAR RTE"
 /begin SUB_GROUP AssistFirewall.BaseAssistCmd.MtrNm_f32 AssistFirewall.Defeat_AsstTbl_Service.Cnt_lgc AssistFirewall.HighFreqAssist.MtrNm_f32 AssistFirewall.HwTorque.HwNm_f32 AssistFirewall.HysteresisComp.MtrNm_f32 AssistFirewall.MEC_Counter.Cnt_enum AssistFirewall.VehicleSpeed.Kph_f32 /end SUB_GROUP
 /begin FUNCTION_LIST /end FUNCTION_LIST
 /begin REF_CHARACTERISTIC /end REF_CHARACTERISTIC
 /begin REF_MEASUREMENT /end REF_MEASUREMENT
/end GROUP
/begin GROUP AssistFirewall.SenderPorts "MICROSAR RTE"
 /begin SUB_GROUP AssistFirewall.AsstFirewallActive.Uls_f32 AssistFirewall.CombinedAssist.MtrNm_f32 /end SUB_GROUP
 /begin FUNCTION_LIST /end FUNCTION_LIST
 /begin REF_CHARACTERISTIC /end REF_CHARACTERISTIC
 /begin REF_MEASUREMENT /end REF_MEASUREMENT
/end GROUP
/begin GROUP AssistFirewall.SystemState.Mode "MICROSAR RTE" /begin SUB_GROUP /end SUB_GROUP /begin FUNCTION_LIST /end FUNCTION_LIST /begin REF_CHARACTERISTIC /end REF_CHARACTERISTIC /begin REF_MEASUREMENT Rte_ModeMachine_StaMd_SystemState_Mode /end REF_MEASUREMENT /end GROUP
/begin GROUP AssistFirewall.VehicleSpeed.Kph_f32 "MICROSAR RTE" /begin SUB_GROUP /end SUB_GROUP /begin FUNCTION_LIST /end FUNCTION_LIST /begin REF_CHARACTERISTIC /end REF_CHARACTERISTIC /begin REF_MEASUREMENT Rte_SignlCondn_VehicleSpeed_Kph_f32 /end REF_MEASUREMENT /end GROUP
/begin GROUP AstLmt "MICROSAR RTE"
 /begin SUB_GROUP AstLmt.PerInstanceMemories AstLmt.ReceiverPorts AstLmt.SenderPorts /end SUB_GROUP
 /begin FUNCTION_LIST /end FUNCTION_LIST
 /begin REF_CHARACTERISTIC /end REF_CHARACTERISTIC
 /begin REF_MEASUREMENT /end REF_MEASUREMENT
/end GROUP
/begin GROUP AstLmt.AssistCmd.MtrNm_f32 "MICROSAR RTE" /begin SUB_GROUP /end SUB_GROUP /begin FUNCTION_LIST /end FUNCTION_LIST /begin REF_CHARACTERISTIC /end REF_CHARACTERISTIC /begin REF_MEASUREMENT Rte_StabilityComp_AssistCmd_MtrNm_f32 /end REF_MEASUREMENT /end GROUP
/begin GROUP AstLmt.AssistEOTDamping.MtrNm_f32 "MICROSAR RTE" /begin SUB_GROUP /end SUB_GROUP /begin FUNCTION_LIST /end FUNCTION_LIST /begin REF_CHARACTERISTIC /end REF_CHARACTERISTIC /begin REF_MEASUREMENT Rte_EtDmpFw_EOTDampingLtd_MtrNm_f32 /end REF_MEASUREMENT /end GROUP
/begin GROUP AstLmt.AssistEOTGain.Uls_f32 "MICROSAR RTE" /begin SUB_GROUP /end SUB_GROUP /begin FUNCTION_LIST /end FUNCTION_LIST /begin REF_CHARACTERISTIC /end REF_CHARACTERISTIC /begin REF_MEASUREMENT Rte_LmtCod_EOTGainLtd_Uls_f32 /end REF_MEASUREMENT /end GROUP
/begin GROUP AstLmt.AssistEOTLimit.MtrNm_f32 "MICROSAR RTE" /begin SUB_GROUP /end SUB_GROUP /begin FUNCTION_LIST /end FUNCTION_LIST /begin REF_CHARACTERISTIC /end REF_CHARACTERISTIC /begin REF_MEASUREMENT Rte_LmtCod_EOTLimitLtd_MtrNm_f32 /end REF_MEASUREMENT /end GROUP
/begin GROUP AstLmt.AssistStallLimit.MtrNm_f32 "MICROSAR RTE" /begin SUB_GROUP /end SUB_GROUP /begin FUNCTION_LIST /end FUNCTION_LIST /begin REF_CHARACTERISTIC /end REF_CHARACTERISTIC /begin REF_MEASUREMENT Rte_LmtCod_StallLimitLtd_MtrNm_f32 /end REF_MEASUREMENT /end GROUP
/begin GROUP AstLmt.AssistVehSpdLimit.MtrNm_f32 "MICROSAR RTE" /begin SUB_GROUP /end SUB_GROUP /begin FUNCTION_LIST /end FUNCTION_LIST /begin REF_CHARACTERISTIC /end REF_CHARACTERISTIC /begin REF_MEASUREMENT Rte_LmtCod_VehSpdLimitLtd_MtrNm_f32 /end REF_MEASUREMENT /end GROUP
/begin GROUP AstLmt.CombinedDamping.MtrNm_f32 "MICROSAR RTE" /begin SUB_GROUP /end SUB_GROUP /begin FUNCTION_LIST /end FUNCTION_LIST /begin REF_CHARACTERISTIC /end REF_CHARACTERISTIC /begin REF_MEASUREMENT Rte_DampingFirewall_CombinedDamping_MtrNm_f32 /end REF_MEASUREMENT /end GROUP
/begin GROUP AstLmt.DefeatLimitService.Cnt_lgc "MICROSAR RTE" /begin SUB_GROUP /end SUB_GROUP /begin FUNCTION_LIST /end FUNCTION_LIST /begin REF_CHARACTERISTIC /end REF_CHARACTERISTIC /begin REF_MEASUREMENT Rte_CDDInterface_LimitSrlComSvcDft_Cnt_lgc /end REF_MEASUREMENT /end GROUP
/begin GROUP AstLmt.LimitPercentFiltered.Uls_f32 "MICROSAR RTE" /begin SUB_GROUP /end SUB_GROUP /begin FUNCTION_LIST /end FUNCTION_LIST /begin REF_CHARACTERISTIC /end REF_CHARACTERISTIC /begin REF_MEASUREMENT Rte_AstLmt_LimitPercentFiltered_Uls_f32 /end REF_MEASUREMENT /end GROUP
/begin GROUP AstLmt.LimitedReturn.MtrNm_f32 "MICROSAR RTE" /begin SUB_GROUP /end SUB_GROUP /begin FUNCTION_LIST /end FUNCTION_LIST /begin REF_CHARACTERISTIC /end REF_CHARACTERISTIC /begin REF_MEASUREMENT Rte_ReturnFirewall_LimitedReturn_MtrNm_f32 /end REF_MEASUREMENT /end GROUP
/begin GROUP AstLmt.LrnPnCtrCCDisable.Cnt_lgc "MICROSAR RTE" /begin SUB_GROUP /end SUB_GROUP /begin FUNCTION_LIST /end FUNCTION_LIST /begin REF_CHARACTERISTIC /end REF_CHARACTERISTIC /begin REF_MEASUREMENT Rte_AstLmt_LrnPnCtrCCDisable_Cnt_lgc /end REF_MEASUREMENT /end GROUP
/begin GROUP AstLmt.LrnPnCtrEnable.Cnt_lgc "MICROSAR RTE" /begin SUB_GROUP /end SUB_GROUP /begin FUNCTION_LIST /end FUNCTION_LIST /begin REF_CHARACTERISTIC /end REF_CHARACTERISTIC /begin REF_MEASUREMENT Rte_AstLmt_LrnPnCtrEnable_Cnt_lgc /end REF_MEASUREMENT /end GROUP
/begin GROUP AstLmt.LrnPnCtrTCmd.MtrNm_f32 "MICROSAR RTE" /begin SUB_GROUP /end SUB_GROUP /begin FUNCTION_LIST /end FUNCTION_LIST /begin REF_CHARACTERISTIC /end REF_CHARACTERISTIC /begin REF_MEASUREMENT Rte_AstLmt_LrnPnCtrTCmd_MtrNm_f32 /end REF_MEASUREMENT /end GROUP
/begin GROUP AstLmt.OpTrqOvr.MtrNm_f32 "MICROSAR RTE" /begin SUB_GROUP /end SUB_GROUP /begin FUNCTION_LIST /end FUNCTION_LIST /begin REF_CHARACTERISTIC /end REF_CHARACTERISTIC /begin REF_MEASUREMENT Rte_AstLmt_OpTrqOvr_MtrNm_f32 /end REF_MEASUREMENT /end GROUP
/begin GROUP AstLmt.OutputRampMult.Uls_f32 "MICROSAR RTE" /begin SUB_GROUP /end SUB_GROUP /begin FUNCTION_LIST /end FUNCTION_LIST /begin REF_CHARACTERISTIC /end REF_CHARACTERISTIC /begin REF_MEASUREMENT Rte_LmtCod_OutputRampMultLtd_Uls_f32 /end REF_MEASUREMENT /end GROUP
/begin GROUP AstLmt.PerInstanceMemories "MICROSAR RTE" /begin SUB_GROUP AstLmt.SteerAsstDefeat /end SUB_GROUP /begin FUNCTION_LIST /end FUNCTION_LIST /begin REF_CHARACTERISTIC /end REF_CHARACTERISTIC /begin REF_MEASUREMENT /end REF_MEASUREMENT /end GROUP
/begin GROUP AstLmt.PosServCCDisable.Cnt_lgc "MICROSAR RTE" /begin SUB_GROUP /end SUB_GROUP /begin FUNCTION_LIST /end FUNCTION_LIST /begin REF_CHARACTERISTIC /end REF_CHARACTERISTIC /begin REF_MEASUREMENT Rte_AstLmt_PosServCCDisable_Cnt_lgc /end REF_MEASUREMENT /end GROUP
/begin GROUP AstLmt.PowerLimitPerc.Uls_f32 "MICROSAR RTE" /begin SUB_GROUP /end SUB_GROUP /begin FUNCTION_LIST /end FUNCTION_LIST /begin REF_CHARACTERISTIC /end REF_CHARACTERISTIC /begin REF_MEASUREMENT Rte_PwrLmtFuncCr_FltTrqLmt_Uls_f32 /end REF_MEASUREMENT /end GROUP
/begin GROUP AstLmt.PreLimitForStall.MtrNm_f32 "MICROSAR RTE" /begin SUB_GROUP /end SUB_GROUP /begin FUNCTION_LIST /end FUNCTION_LIST /begin REF_CHARACTERISTIC /end REF_CHARACTERISTIC /begin REF_MEASUREMENT Rte_AstLmt_PreLimitForStall_MtrNm_f32 /end REF_MEASUREMENT /end GROUP
/begin GROUP AstLmt.PreLimitTorque.MtrNm_f32 "MICROSAR RTE" /begin SUB_GROUP /end SUB_GROUP /begin FUNCTION_LIST /end FUNCTION_LIST /begin REF_CHARACTERISTIC /end REF_CHARACTERISTIC /begin REF_MEASUREMENT Rte_AstLmt_PreLimitTorque_MtrNm_f32 /end REF_MEASUREMENT /end GROUP
/begin GROUP AstLmt.PrkAssistCmd.MtrNm_f32 "MICROSAR RTE" /begin SUB_GROUP /end SUB_GROUP /begin FUNCTION_LIST /end FUNCTION_LIST /begin REF_CHARACTERISTIC /end REF_CHARACTERISTIC /begin REF_MEASUREMENT Rte_AstLmt_PrkAssistCmd_MtrNm_f32 /end REF_MEASUREMENT /end GROUP
/begin GROUP AstLmt.PullCompCmd.MtrNm_f32 "MICROSAR RTE" /begin SUB_GROUP /end SUB_GROUP /begin FUNCTION_LIST /end FUNCTION_LIST /begin REF_CHARACTERISTIC /end REF_CHARACTERISTIC /begin REF_MEASUREMENT Rte_ActivePull_PullCompCmd_MtrNm_f32 /end REF_MEASUREMENT /end GROUP
/begin GROUP AstLmt.ReceiverPorts "MICROSAR RTE"
 /begin SUB_GROUP AstLmt.AssistCmd.MtrNm_f32 AstLmt.AssistEOTDamping.MtrNm_f32 AstLmt.AssistEOTGain.Uls_f32 AstLmt.AssistEOTLimit.MtrNm_f32 AstLmt.AssistStallLimit.MtrNm_f32 AstLmt.AssistVehSpdLimit.MtrNm_f32 AstLmt.CombinedDamping.MtrNm_f32 AstLmt.DefeatLimitService.Cnt_lgc AstLmt.LimitedReturn.MtrNm_f32 AstLmt.LrnPnCtrCCDisable.Cnt_lgc AstLmt.LrnPnCtrEnable.Cnt_lgc AstLmt.LrnPnCtrTCmd.MtrNm_f32 AstLmt.OpTrqOvr.MtrNm_f32 AstLmt.OutputRampMult.Uls_f32 AstLmt.PosServCCDisable.Cnt_lgc AstLmt.PowerLimitPerc.Uls_f32 AstLmt.PrkAssistCmd.MtrNm_f32 AstLmt.PullCompCmd.MtrNm_f32 AstLmt.TSMitCommand.MtrNm_f32 AstLmt.ThermalLimit.MtrNm_f32 AstLmt.ThermalLimitPerc.Uls_f32 AstLmt.VehSpd.Kph_f32 AstLmt.WheelImbalanceCmd.MtrNm_f32 /end SUB_GROUP
 /begin FUNCTION_LIST /end FUNCTION_LIST
 /begin REF_CHARACTERISTIC /end REF_CHARACTERISTIC
 /begin REF_MEASUREMENT /end REF_MEASUREMENT
/end GROUP
/begin GROUP AstLmt.SenderPorts "MICROSAR RTE"
 /begin SUB_GROUP AstLmt.LimitPercentFiltered.Uls_f32 AstLmt.PreLimitForStall.MtrNm_f32 AstLmt.PreLimitTorque.MtrNm_f32 AstLmt.SumLimTrqCmd.MtrNm_f32 AstLmt.TrqLimitMin.MtrNm_f32 /end SUB_GROUP
 /begin FUNCTION_LIST /end FUNCTION_LIST
 /begin REF_CHARACTERISTIC /end REF_CHARACTERISTIC
 /begin REF_MEASUREMENT /end REF_MEASUREMENT
/end GROUP
/begin GROUP AstLmt.SteerAsstDefeat "MICROSAR RTE" /begin SUB_GROUP /end SUB_GROUP /begin FUNCTION_LIST /end FUNCTION_LIST /begin REF_CHARACTERISTIC /end REF_CHARACTERISTIC /begin REF_MEASUREMENT Rte_AstLmt_SteerAsstDefeat /end REF_MEASUREMENT /end GROUP
/begin GROUP AstLmt.SumLimTrqCmd.MtrNm_f32 "MICROSAR RTE" /begin SUB_GROUP /end SUB_GROUP /begin FUNCTION_LIST /end FUNCTION_LIST /begin REF_CHARACTERISTIC /end REF_CHARACTERISTIC /begin REF_MEASUREMENT Rte_AstLmt_SumLimTrqCmd_MtrNm_f32 /end REF_MEASUREMENT /end GROUP
/begin GROUP AstLmt.TSMitCommand.MtrNm_f32 "MICROSAR RTE" /begin SUB_GROUP /end SUB_GROUP /begin FUNCTION_LIST /end FUNCTION_LIST /begin REF_CHARACTERISTIC /end REF_CHARACTERISTIC /begin REF_MEASUREMENT Rte_AstLmt_TSMitCommand_MtrNm_f32 /end REF_MEASUREMENT /end GROUP
/begin GROUP AstLmt.ThermalLimit.MtrNm_f32 "MICROSAR RTE" /begin SUB_GROUP /end SUB_GROUP /begin FUNCTION_LIST /end FUNCTION_LIST /begin REF_CHARACTERISTIC /end REF_CHARACTERISTIC /begin REF_MEASUREMENT Rte_LmtCod_ThermalLimitLtd_MtrNm_f32 /end REF_MEASUREMENT /end GROUP
/begin GROUP AstLmt.ThermalLimitPerc.Uls_f32 "MICROSAR RTE" /begin SUB_GROUP /end SUB_GROUP /begin FUNCTION_LIST /end FUNCTION_LIST /begin REF_CHARACTERISTIC /end REF_CHARACTERISTIC /begin REF_MEASUREMENT Rte_ThrmlDutyCycle_ThermLimitPerc_Uls_f32 /end REF_MEASUREMENT /end GROUP
/begin GROUP AstLmt.TrqLimitMin.MtrNm_f32 "MICROSAR RTE" /begin SUB_GROUP /end SUB_GROUP /begin FUNCTION_LIST /end FUNCTION_LIST /begin REF_CHARACTERISTIC /end REF_CHARACTERISTIC /begin REF_MEASUREMENT Rte_AstLmt_TrqLimitMin_MtrNm_f32 /end REF_MEASUREMENT /end GROUP
/begin GROUP AstLmt.VehSpd.Kph_f32 "MICROSAR RTE" /begin SUB_GROUP /end SUB_GROUP /begin FUNCTION_LIST /end FUNCTION_LIST /begin REF_CHARACTERISTIC /end REF_CHARACTERISTIC /begin REF_MEASUREMENT Rte_SignlCondn_VehicleSpeed_Kph_f32 /end REF_MEASUREMENT /end GROUP
/begin GROUP AstLmt.WheelImbalanceCmd.MtrNm_f32 "MICROSAR RTE" /begin SUB_GROUP /end SUB_GROUP /begin FUNCTION_LIST /end FUNCTION_LIST /begin REF_CHARACTERISTIC /end REF_CHARACTERISTIC /begin REF_MEASUREMENT Rte_AstLmt_WheelImbalanceCmd_MtrNm_f32 /end REF_MEASUREMENT /end GROUP
/begin GROUP AvgFricLrn "MICROSAR RTE"
 /begin SUB_GROUP AvgFricLrn.ModeRequirePorts AvgFricLrn.PerInstanceMemories AvgFricLrn.ReceiverPorts AvgFricLrn.SenderPorts /end SUB_GROUP
 /begin FUNCTION_LIST /end FUNCTION_LIST
 /begin REF_CHARACTERISTIC /end REF_CHARACTERISTIC
 /begin REF_MEASUREMENT /end REF_MEASUREMENT
/end GROUP
/begin GROUP AvgFricLrn.AvgFricLrnData "MICROSAR RTE" /begin SUB_GROUP /end SUB_GROUP /begin FUNCTION_LIST /end FUNCTION_LIST /begin REF_CHARACTERISTIC /end REF_CHARACTERISTIC
 /begin REF_MEASUREMENT Rte_AvgFricLrn_AvgFricLrnData.EOLFric_HwNm_f32 Rte_AvgFricLrn_AvgFricLrnData.EnableFricLearning_Cnt_lgc Rte_AvgFricLrn_AvgFricLrnData.EnableFricOffsetOutput_Cnt_lgc Rte_AvgFricLrn_AvgFricLrnData.FricOffset_HwNm_f32 Rte_AvgFricLrn_AvgFricLrnData.OpMode_Cnt_enum Rte_AvgFricLrn_AvgFricLrnData.RangeCounter_Cnt_u16 Rte_AvgFricLrn_AvgFricLrnData.Theta_HwNm_f32 Rte_AvgFricLrn_AvgFricLrnData.VehLearnedFric_HwNm_f32 /end REF_MEASUREMENT
/end GROUP
/begin GROUP AvgFricLrn.CRFMtrTrq.MtrNm_f32 "MICROSAR RTE" /begin SUB_GROUP /end SUB_GROUP /begin FUNCTION_LIST /end FUNCTION_LIST /begin REF_CHARACTERISTIC /end REF_CHARACTERISTIC /begin REF_MEASUREMENT Rte_CtrldDisShtdn_CntDisMtrTrqCmdCRF_MtrNm_f32 /end REF_MEASUREMENT /end GROUP
/begin GROUP AvgFricLrn.DefeatFricLearning.Cnt_lgc "MICROSAR RTE" /begin SUB_GROUP /end SUB_GROUP /begin FUNCTION_LIST /end FUNCTION_LIST /begin REF_CHARACTERISTIC /end REF_CHARACTERISTIC /begin REF_MEASUREMENT Rte_CDDInterface_FricLrnSrlComSvcDft_Cnt_lgc /end REF_MEASUREMENT /end GROUP
/begin GROUP AvgFricLrn.EstFric.HwNm_f32 "MICROSAR RTE" /begin SUB_GROUP /end SUB_GROUP /begin FUNCTION_LIST /end FUNCTION_LIST /begin REF_CHARACTERISTIC /end REF_CHARACTERISTIC /begin REF_MEASUREMENT Rte_AvgFricLrn_EstFric_HwNm_f32 /end REF_MEASUREMENT /end GROUP
/begin GROUP AvgFricLrn.FricOffset.HwNm_f32 "MICROSAR RTE" /begin SUB_GROUP /end SUB_GROUP /begin FUNCTION_LIST /end FUNCTION_LIST /begin REF_CHARACTERISTIC /end REF_CHARACTERISTIC /begin REF_MEASUREMENT Rte_AvgFricLrn_FricOffset_HwNm_f32 /end REF_MEASUREMENT /end GROUP
/begin GROUP AvgFricLrn.HwAng.HwDeg_f32 "MICROSAR RTE" /begin SUB_GROUP /end SUB_GROUP /begin FUNCTION_LIST /end FUNCTION_LIST /begin REF_CHARACTERISTIC /end REF_CHARACTERISTIC /begin REF_MEASUREMENT Rte_AbsHwPos_HandwheelPosition_HwDeg_f32 /end REF_MEASUREMENT /end GROUP
/begin GROUP AvgFricLrn.HwPosAuthority.Uls_f32 "MICROSAR RTE" /begin SUB_GROUP /end SUB_GROUP /begin FUNCTION_LIST /end FUNCTION_LIST /begin REF_CHARACTERISTIC /end REF_CHARACTERISTIC /begin REF_MEASUREMENT Rte_AbsHwPos_HandwheelAuthority_Uls_f32 /end REF_MEASUREMENT /end GROUP
/begin GROUP AvgFricLrn.HwTrq.HwNm_f32 "MICROSAR RTE" /begin SUB_GROUP /end SUB_GROUP /begin FUNCTION_LIST /end FUNCTION_LIST /begin REF_CHARACTERISTIC /end REF_CHARACTERISTIC /begin REF_MEASUREMENT Rte_Sweep_OutputHwTrq_HwNm_f32 /end REF_MEASUREMENT /end GROUP
/begin GROUP AvgFricLrn.HwVel.HwRadpS_f32 "MICROSAR RTE" /begin SUB_GROUP /end SUB_GROUP /begin FUNCTION_LIST /end FUNCTION_LIST /begin REF_CHARACTERISTIC /end REF_CHARACTERISTIC /begin REF_MEASUREMENT Rte_MtrVel_HandwheelVel_HwRadpS_f32 /end REF_MEASUREMENT /end GROUP
/begin GROUP AvgFricLrn.ModeRequirePorts "MICROSAR RTE" /begin SUB_GROUP AvgFricLrn.SystemState.Mode /end SUB_GROUP /begin FUNCTION_LIST /end FUNCTION_LIST /begin REF_CHARACTERISTIC /end REF_CHARACTERISTIC /begin REF_MEASUREMENT /end REF_MEASUREMENT /end GROUP
/begin GROUP AvgFricLrn.PerInstanceMemories "MICROSAR RTE" /begin SUB_GROUP AvgFricLrn.AvgFricLrnData /end SUB_GROUP /begin FUNCTION_LIST /end FUNCTION_LIST /begin REF_CHARACTERISTIC /end REF_CHARACTERISTIC /begin REF_MEASUREMENT /end REF_MEASUREMENT /end GROUP
/begin GROUP AvgFricLrn.ReceiverPorts "MICROSAR RTE"
 /begin SUB_GROUP AvgFricLrn.CRFMtrTrq.MtrNm_f32 AvgFricLrn.DefeatFricLearning.Cnt_lgc AvgFricLrn.HwAng.HwDeg_f32 AvgFricLrn.HwPosAuthority.Uls_f32 AvgFricLrn.HwTrq.HwNm_f32 AvgFricLrn.HwVel.HwRadpS_f32 AvgFricLrn.Temperature.DegC_f32 AvgFricLrn.VehSpd.Kph_f32 AvgFricLrn.VehicleSpeedValid.Cnt_lgc /end SUB_GROUP
 /begin FUNCTION_LIST /end FUNCTION_LIST
 /begin REF_CHARACTERISTIC /end REF_CHARACTERISTIC
 /begin REF_MEASUREMENT /end REF_MEASUREMENT
/end GROUP
/begin GROUP AvgFricLrn.SatEstFric.HwNm_f32 "MICROSAR RTE" /begin SUB_GROUP /end SUB_GROUP /begin FUNCTION_LIST /end FUNCTION_LIST /begin REF_CHARACTERISTIC /end REF_CHARACTERISTIC /begin REF_MEASUREMENT Rte_AvgFricLrn_SatEstFric_HwNm_f32 /end REF_MEASUREMENT /end GROUP
/begin GROUP AvgFricLrn.SenderPorts "MICROSAR RTE"
 /begin SUB_GROUP AvgFricLrn.EstFric.HwNm_f32 AvgFricLrn.FricOffset.HwNm_f32 AvgFricLrn.SatEstFric.HwNm_f32 /end SUB_GROUP
 /begin FUNCTION_LIST /end FUNCTION_LIST
 /begin REF_CHARACTERISTIC /end REF_CHARACTERISTIC
 /begin REF_MEASUREMENT /end REF_MEASUREMENT
/end GROUP
/begin GROUP AvgFricLrn.SystemState.Mode "MICROSAR RTE" /begin SUB_GROUP /end SUB_GROUP /begin FUNCTION_LIST /end FUNCTION_LIST /begin REF_CHARACTERISTIC /end REF_CHARACTERISTIC /begin REF_MEASUREMENT Rte_ModeMachine_StaMd9_SystemState9_Mode /end REF_MEASUREMENT /end GROUP
/begin GROUP AvgFricLrn.Temperature.DegC_f32 "MICROSAR RTE" /begin SUB_GROUP /end SUB_GROUP /begin FUNCTION_LIST /end FUNCTION_LIST /begin REF_CHARACTERISTIC /end REF_CHARACTERISTIC /begin REF_MEASUREMENT Rte_MtrTempEst_AssistMechTempEst_DegC_f32 /end REF_MEASUREMENT /end GROUP
/begin GROUP AvgFricLrn.VehSpd.Kph_f32 "MICROSAR RTE" /begin SUB_GROUP /end SUB_GROUP /begin FUNCTION_LIST /end FUNCTION_LIST /begin REF_CHARACTERISTIC /end REF_CHARACTERISTIC /begin REF_MEASUREMENT Rte_SignlCondn_VehicleSpeed_Kph_f32 /end REF_MEASUREMENT /end GROUP
/begin GROUP AvgFricLrn.VehicleSpeedValid.Cnt_lgc "MICROSAR RTE" /begin SUB_GROUP /end SUB_GROUP /begin FUNCTION_LIST /end FUNCTION_LIST /begin REF_CHARACTERISTIC /end REF_CHARACTERISTIC /begin REF_MEASUREMENT Rte_SrlComInput_VehicleSpeedValid_Cnt_lgc /end REF_MEASUREMENT /end GROUP
/begin GROUP BVDiag "MICROSAR RTE" /begin SUB_GROUP BVDiag.ReceiverPorts /end SUB_GROUP /begin FUNCTION_LIST /end FUNCTION_LIST /begin REF_CHARACTERISTIC /end REF_CHARACTERISTIC /begin REF_MEASUREMENT /end REF_MEASUREMENT /end GROUP
/begin GROUP BVDiag.Batt.Volt_f32 "MICROSAR RTE" /begin SUB_GROUP /end SUB_GROUP /begin FUNCTION_LIST /end FUNCTION_LIST /begin REF_CHARACTERISTIC /end REF_CHARACTERISTIC /begin REF_MEASUREMENT Rte_IoHwAbstractionUsr_Batt_Volt_f32 /end REF_MEASUREMENT /end GROUP
/begin GROUP BVDiag.CCLMSAActive.Cnt_lgc "MICROSAR RTE" /begin SUB_GROUP /end SUB_GROUP /begin FUNCTION_LIST /end FUNCTION_LIST /begin REF_CHARACTERISTIC /end REF_CHARACTERISTIC /begin REF_MEASUREMENT Rte_BVDiag_CCLMSAActive_Cnt_lgc /end REF_MEASUREMENT /end GROUP
/begin GROUP BVDiag.NTCB0Enbl.Cnt_lgc "MICROSAR RTE" /begin SUB_GROUP /end SUB_GROUP /begin FUNCTION_LIST /end FUNCTION_LIST /begin REF_CHARACTERISTIC /end REF_CHARACTERISTIC /begin REF_MEASUREMENT Rte_BVDiag_NTCB0Enbl_Cnt_lgc /end REF_MEASUREMENT /end GROUP
/begin GROUP BVDiag.NTCB1Enbl.Cnt_lgc "MICROSAR RTE" /begin SUB_GROUP /end SUB_GROUP /begin FUNCTION_LIST /end FUNCTION_LIST /begin REF_CHARACTERISTIC /end REF_CHARACTERISTIC /begin REF_MEASUREMENT Rte_BVDiag_NTCB1Enbl_Cnt_lgc /end REF_MEASUREMENT /end GROUP
/begin GROUP BVDiag.ReceiverPorts "MICROSAR RTE"
 /begin SUB_GROUP BVDiag.Batt.Volt_f32 BVDiag.CCLMSAActive.Cnt_lgc BVDiag.NTCB0Enbl.Cnt_lgc BVDiag.NTCB1Enbl.Cnt_lgc /end SUB_GROUP
 /begin FUNCTION_LIST /end FUNCTION_LIST
 /begin REF_CHARACTERISTIC /end REF_CHARACTERISTIC
 /begin REF_MEASUREMENT /end REF_MEASUREMENT
/end GROUP
/begin GROUP BatteryVoltage "MICROSAR RTE"
 /begin SUB_GROUP BatteryVoltage.ModeRequirePorts BatteryVoltage.PerInstanceMemories BatteryVoltage.ReceiverPorts BatteryVoltage.SenderPorts /end SUB_GROUP
 /begin FUNCTION_LIST /end FUNCTION_LIST
 /begin REF_CHARACTERISTIC /end REF_CHARACTERISTIC
 /begin REF_MEASUREMENT /end REF_MEASUREMENT
/end GROUP
/begin GROUP BatteryVoltage.Batt.Volt_f32 "MICROSAR RTE" /begin SUB_GROUP /end SUB_GROUP /begin FUNCTION_LIST /end FUNCTION_LIST /begin REF_CHARACTERISTIC /end REF_CHARACTERISTIC /begin REF_MEASUREMENT Rte_IoHwAbstractionUsr_Batt_Volt_f32 /end REF_MEASUREMENT /end GROUP
/begin GROUP BatteryVoltage.BattSwitched.Volt_f32 "MICROSAR RTE" /begin SUB_GROUP /end SUB_GROUP /begin FUNCTION_LIST /end FUNCTION_LIST /begin REF_CHARACTERISTIC /end REF_CHARACTERISTIC /begin REF_MEASUREMENT Rte_IoHwAbstractionUsr_BattSwitched_Volt_f32 /end REF_MEASUREMENT /end GROUP
/begin GROUP BatteryVoltage.ModeRequirePorts "MICROSAR RTE" /begin SUB_GROUP BatteryVoltage.SystemState.Mode /end SUB_GROUP /begin FUNCTION_LIST /end FUNCTION_LIST /begin REF_CHARACTERISTIC /end REF_CHARACTERISTIC /begin REF_MEASUREMENT /end REF_MEASUREMENT /end GROUP
/begin GROUP BatteryVoltage.OvervoltageData "MICROSAR RTE" /begin SUB_GROUP /end SUB_GROUP /begin FUNCTION_LIST /end FUNCTION_LIST /begin REF_CHARACTERISTIC /end REF_CHARACTERISTIC
 /begin REF_MEASUREMENT Rte_BatteryVoltage_OvervoltageData.MaxBattVoltage_Volts_f32 Rte_BatteryVoltage_OvervoltageData.OvervoltageCounter_Cnt_u16 /end REF_MEASUREMENT
/end GROUP
/begin GROUP BatteryVoltage.PerInstanceMemories "MICROSAR RTE" /begin SUB_GROUP BatteryVoltage.OvervoltageData /end SUB_GROUP /begin FUNCTION_LIST /end FUNCTION_LIST /begin REF_CHARACTERISTIC /end REF_CHARACTERISTIC /begin REF_MEASUREMENT /end REF_MEASUREMENT /end GROUP
/begin GROUP BatteryVoltage.ReceiverPorts "MICROSAR RTE"
 /begin SUB_GROUP BatteryVoltage.Batt.Volt_f32 BatteryVoltage.BattSwitched.Volt_f32 BatteryVoltage.SysCVSwitch.Volt_f32 /end SUB_GROUP
 /begin FUNCTION_LIST /end FUNCTION_LIST
 /begin REF_CHARACTERISTIC /end REF_CHARACTERISTIC
 /begin REF_MEASUREMENT /end REF_MEASUREMENT
/end GROUP
/begin GROUP BatteryVoltage.SenderPorts "MICROSAR RTE"
 /begin SUB_GROUP BatteryVoltage.SysC_Vecu.Volt_f32 BatteryVoltage.Vecu.Volt_f32 BatteryVoltage.VswitchClosed.Cnt_lgc /end SUB_GROUP
 /begin FUNCTION_LIST /end FUNCTION_LIST
 /begin REF_CHARACTERISTIC /end REF_CHARACTERISTIC
 /begin REF_MEASUREMENT /end REF_MEASUREMENT
/end GROUP
/begin GROUP BatteryVoltage.SysCVSwitch.Volt_f32 "MICROSAR RTE" /begin SUB_GROUP /end SUB_GROUP /begin FUNCTION_LIST /end FUNCTION_LIST /begin REF_CHARACTERISTIC /end REF_CHARACTERISTIC /begin REF_MEASUREMENT Rte_IoHwAbstractionUsr_SysCVSwitch_Volt_f32 /end REF_MEASUREMENT /end GROUP
/begin GROUP BatteryVoltage.SysC_Vecu.Volt_f32 "MICROSAR RTE" /begin SUB_GROUP /end SUB_GROUP /begin FUNCTION_LIST /end FUNCTION_LIST /begin REF_CHARACTERISTIC /end REF_CHARACTERISTIC /begin REF_MEASUREMENT Rte_BatteryVoltage_SysC_Vecu_Volt_f32 /end REF_MEASUREMENT /end GROUP
/begin GROUP BatteryVoltage.SystemState.Mode "MICROSAR RTE" /begin SUB_GROUP /end SUB_GROUP /begin FUNCTION_LIST /end FUNCTION_LIST /begin REF_CHARACTERISTIC /end REF_CHARACTERISTIC /begin REF_MEASUREMENT Rte_ModeMachine_StaMd_SystemState_Mode /end REF_MEASUREMENT /end GROUP
/begin GROUP BatteryVoltage.Vecu.Volt_f32 "MICROSAR RTE" /begin SUB_GROUP /end SUB_GROUP /begin FUNCTION_LIST /end FUNCTION_LIST /begin REF_CHARACTERISTIC /end REF_CHARACTERISTIC /begin REF_MEASUREMENT Rte_BatteryVoltage_Vecu_Volt_f32 /end REF_MEASUREMENT /end GROUP
/begin GROUP BatteryVoltage.VswitchClosed.Cnt_lgc "MICROSAR RTE" /begin SUB_GROUP /end SUB_GROUP /begin FUNCTION_LIST /end FUNCTION_LIST /begin REF_CHARACTERISTIC /end REF_CHARACTERISTIC /begin REF_MEASUREMENT Rte_BatteryVoltage_VswitchClosed_Cnt_lgc /end REF_MEASUREMENT /end GROUP
/begin GROUP BkCpPc "MICROSAR RTE"
 /begin SUB_GROUP BkCpPc.ModeRequirePorts BkCpPc.ReceiverPorts BkCpPc.SenderPorts /end SUB_GROUP
 /begin FUNCTION_LIST /end FUNCTION_LIST
 /begin REF_CHARACTERISTIC /end REF_CHARACTERISTIC
 /begin REF_MEASUREMENT /end REF_MEASUREMENT
/end GROUP
/begin GROUP BkCpPc.Batt.Volt_f32 "MICROSAR RTE" /begin SUB_GROUP /end SUB_GROUP /begin FUNCTION_LIST /end FUNCTION_LIST /begin REF_CHARACTERISTIC /end REF_CHARACTERISTIC /begin REF_MEASUREMENT Rte_IoHwAbstractionUsr_Batt_Volt_f32 /end REF_MEASUREMENT /end GROUP
/begin GROUP BkCpPc.BattSwitched.Volt_f32 "MICROSAR RTE" /begin SUB_GROUP /end SUB_GROUP /begin FUNCTION_LIST /end FUNCTION_LIST /begin REF_CHARACTERISTIC /end REF_CHARACTERISTIC /begin REF_MEASUREMENT Rte_IoHwAbstractionUsr_BattSwitched_Volt_f32 /end REF_MEASUREMENT /end GROUP
/begin GROUP BkCpPc.ModeRequirePorts "MICROSAR RTE" /begin SUB_GROUP BkCpPc.SystemState.Mode /end SUB_GROUP /begin FUNCTION_LIST /end FUNCTION_LIST /begin REF_CHARACTERISTIC /end REF_CHARACTERISTIC /begin REF_MEASUREMENT /end REF_MEASUREMENT /end GROUP
/begin GROUP BkCpPc.MotorVelocityMRFUnfiltered.MtrRadpS_f32 "MICROSAR RTE" /begin SUB_GROUP /end SUB_GROUP /begin FUNCTION_LIST /end FUNCTION_LIST /begin REF_CHARACTERISTIC /end REF_CHARACTERISTIC /begin REF_MEASUREMENT Rte_MtrVel_MotorVelMRF_MtrRadpS_f32 /end REF_MEASUREMENT /end GROUP
/begin GROUP BkCpPc.OVERRIDESIGDIAGADC.Volt_f32 "MICROSAR RTE" /begin SUB_GROUP /end SUB_GROUP /begin FUNCTION_LIST /end FUNCTION_LIST /begin REF_CHARACTERISTIC /end REF_CHARACTERISTIC /begin REF_MEASUREMENT Rte_BkCpPc_OVERRIDESIGDIAGADC_Volt_f32 /end REF_MEASUREMENT /end GROUP
/begin GROUP BkCpPc.PMOSDIAGADC.Volt_f32 "MICROSAR RTE" /begin SUB_GROUP /end SUB_GROUP /begin FUNCTION_LIST /end FUNCTION_LIST /begin REF_CHARACTERISTIC /end REF_CHARACTERISTIC /begin REF_MEASUREMENT Rte_BkCpPc_PMOSDIAGADC_Volt_f32 /end REF_MEASUREMENT /end GROUP
/begin GROUP BkCpPc.PwrDiscATestComplete.Cnt_lgc "MICROSAR RTE" /begin SUB_GROUP /end SUB_GROUP /begin FUNCTION_LIST /end FUNCTION_LIST /begin REF_CHARACTERISTIC /end REF_CHARACTERISTIC /begin REF_MEASUREMENT Rte_BkCpPc_PwrDiscATestComplete_Cnt_lgc /end REF_MEASUREMENT /end GROUP
/begin GROUP BkCpPc.PwrDiscATestStart.Cnt_lgc "MICROSAR RTE" /begin SUB_GROUP /end SUB_GROUP /begin FUNCTION_LIST /end FUNCTION_LIST /begin REF_CHARACTERISTIC /end REF_CHARACTERISTIC /begin REF_MEASUREMENT Rte_HwPwUp_PwrDiscATestStart_Cnt_lgc /end REF_MEASUREMENT /end GROUP
/begin GROUP BkCpPc.PwrDiscBTestComplete.Cnt_lgc "MICROSAR RTE" /begin SUB_GROUP /end SUB_GROUP /begin FUNCTION_LIST /end FUNCTION_LIST /begin REF_CHARACTERISTIC /end REF_CHARACTERISTIC /begin REF_MEASUREMENT Rte_BkCpPc_PwrDiscBTestComplete_Cnt_lgc /end REF_MEASUREMENT /end GROUP
/begin GROUP BkCpPc.PwrDiscBTestStart.Cnt_lgc "MICROSAR RTE" /begin SUB_GROUP /end SUB_GROUP /begin FUNCTION_LIST /end FUNCTION_LIST /begin REF_CHARACTERISTIC /end REF_CHARACTERISTIC /begin REF_MEASUREMENT Rte_HwPwUp_PwrDiscBTestStart_Cnt_lgc /end REF_MEASUREMENT /end GROUP
/begin GROUP BkCpPc.PwrDiscClosed.Cnt_lgc "MICROSAR RTE" /begin SUB_GROUP /end SUB_GROUP /begin FUNCTION_LIST /end FUNCTION_LIST /begin REF_CHARACTERISTIC /end REF_CHARACTERISTIC /begin REF_MEASUREMENT Rte_BkCpPc_PwrDiscClosed_Cnt_lgc /end REF_MEASUREMENT /end GROUP
/begin GROUP BkCpPc.ReceiverPorts "MICROSAR RTE"
 /begin SUB_GROUP BkCpPc.Batt.Volt_f32 BkCpPc.BattSwitched.Volt_f32 BkCpPc.MotorVelocityMRFUnfiltered.MtrRadpS_f32 BkCpPc.OVERRIDESIGDIAGADC.Volt_f32 BkCpPc.PMOSDIAGADC.Volt_f32 BkCpPc.PwrDiscATestStart.Cnt_lgc BkCpPc.PwrDiscBTestStart.Cnt_lgc /end SUB_GROUP
 /begin FUNCTION_LIST /end FUNCTION_LIST
 /begin REF_CHARACTERISTIC /end REF_CHARACTERISTIC
 /begin REF_MEASUREMENT /end REF_MEASUREMENT
/end GROUP
/begin GROUP BkCpPc.SenderPorts "MICROSAR RTE"
 /begin SUB_GROUP BkCpPc.PwrDiscATestComplete.Cnt_lgc BkCpPc.PwrDiscBTestComplete.Cnt_lgc BkCpPc.PwrDiscClosed.Cnt_lgc /end SUB_GROUP
 /begin FUNCTION_LIST /end FUNCTION_LIST
 /begin REF_CHARACTERISTIC /end REF_CHARACTERISTIC
 /begin REF_MEASUREMENT /end REF_MEASUREMENT
/end GROUP
/begin GROUP BkCpPc.SystemState.Mode "MICROSAR RTE" /begin SUB_GROUP /end SUB_GROUP /begin FUNCTION_LIST /end FUNCTION_LIST /begin REF_CHARACTERISTIC /end REF_CHARACTERISTIC /begin REF_MEASUREMENT Rte_ModeMachine_StaMd9_SystemState9_Mode /end REF_MEASUREMENT /end GROUP
/begin GROUP CDDInterface "MICROSAR RTE"
 /begin SUB_GROUP CDDInterface.ModeRequirePorts CDDInterface.ReceiverPorts CDDInterface.SenderPorts /end SUB_GROUP
 /begin FUNCTION_LIST /end FUNCTION_LIST
 /begin REF_CHARACTERISTIC /end REF_CHARACTERISTIC
 /begin REF_MEASUREMENT /end REF_MEASUREMENT
/end GROUP
/begin GROUP CDDInterface.ADCMtrCurr1.Volts_f32 "MICROSAR RTE" /begin SUB_GROUP /end SUB_GROUP /begin FUNCTION_LIST /end FUNCTION_LIST /begin REF_CHARACTERISTIC /end REF_CHARACTERISTIC /begin REF_MEASUREMENT Rte_CDDInterface_ADCMtrCurr1_Volts_f32 /end REF_MEASUREMENT /end GROUP
/begin GROUP CDDInterface.ADCMtrCurr2.Volts_f32 "MICROSAR RTE" /begin SUB_GROUP /end SUB_GROUP /begin FUNCTION_LIST /end FUNCTION_LIST /begin REF_CHARACTERISTIC /end REF_CHARACTERISTIC /begin REF_MEASUREMENT Rte_CDDInterface_ADCMtrCurr2_Volts_f32 /end REF_MEASUREMENT /end GROUP
/begin GROUP CDDInterface.CommOffset.Cnt_u16 "MICROSAR RTE" /begin SUB_GROUP /end SUB_GROUP /begin FUNCTION_LIST /end FUNCTION_LIST /begin REF_CHARACTERISTIC /end REF_CHARACTERISTIC /begin REF_MEASUREMENT Rte_CmMtrCurr_ComOffset_Cnt_u16 /end REF_MEASUREMENT /end GROUP
/begin GROUP CDDInterface.CorrMtrCurrPosition.Rev_f32 "MICROSAR RTE" /begin SUB_GROUP /end SUB_GROUP /begin FUNCTION_LIST /end FUNCTION_LIST /begin REF_CHARACTERISTIC /end REF_CHARACTERISTIC /begin REF_MEASUREMENT Rte_CDDInterface_CorrMtrCurrPosition_Rev_f32 /end REF_MEASUREMENT /end GROUP
/begin GROUP CDDInterface.CorrMtrPosElec.Rev_f32 "MICROSAR RTE" /begin SUB_GROUP /end SUB_GROUP /begin FUNCTION_LIST /end FUNCTION_LIST /begin REF_CHARACTERISTIC /end REF_CHARACTERISTIC /begin REF_MEASUREMENT Rte_CDDInterface_CorrMtrPosElec_Rev_f32 /end REF_MEASUREMENT /end GROUP
/begin GROUP CDDInterface.CorrectedElecMtrPos.Rev_u0p16 "MICROSAR RTE" /begin SUB_GROUP /end SUB_GROUP /begin FUNCTION_LIST /end FUNCTION_LIST /begin REF_CHARACTERISTIC /end REF_CHARACTERISTIC /begin REF_MEASUREMENT Rte_CDDInterface_CorrectedElecMtrPos_Rev_u0p16 /end REF_MEASUREMENT /end GROUP
/begin GROUP CDDInterface.CumMechMtrPos.Rev_f32 "MICROSAR RTE" /begin SUB_GROUP /end SUB_GROUP /begin FUNCTION_LIST /end FUNCTION_LIST /begin REF_CHARACTERISTIC /end REF_CHARACTERISTIC /begin REF_MEASUREMENT Rte_CDDInterface_CumMechMtrPos_Rev_f32 /end REF_MEASUREMENT /end GROUP
/begin GROUP CDDInterface.DampingSrlComSvcDft.Cnt_lgc "MICROSAR RTE" /begin SUB_GROUP /end SUB_GROUP /begin FUNCTION_LIST /end FUNCTION_LIST /begin REF_CHARACTERISTIC /end REF_CHARACTERISTIC /begin REF_MEASUREMENT Rte_CDDInterface_DampingSrlComSvcDft_Cnt_lgc /end REF_MEASUREMENT /end GROUP
/begin GROUP CDDInterface.DftAsstTbl.Cnt_lgc "MICROSAR RTE" /begin SUB_GROUP /end SUB_GROUP /begin FUNCTION_LIST /end FUNCTION_LIST /begin REF_CHARACTERISTIC /end REF_CHARACTERISTIC /begin REF_MEASUREMENT Rte_CDDInterface_DftAsstTbl_Cnt_lgc /end REF_MEASUREMENT /end GROUP
/begin GROUP CDDInterface.Die1RxError.Cnt_u16 "MICROSAR RTE" /begin SUB_GROUP /end SUB_GROUP /begin FUNCTION_LIST /end FUNCTION_LIST /begin REF_CHARACTERISTIC /end REF_CHARACTERISTIC /begin REF_MEASUREMENT Rte_CDDInterface_Die1RxError_Cnt_u16 /end REF_MEASUREMENT /end GROUP
/begin GROUP CDDInterface.Die1RxMtrPos.Cnt_u16 "MICROSAR RTE" /begin SUB_GROUP /end SUB_GROUP /begin FUNCTION_LIST /end FUNCTION_LIST /begin REF_CHARACTERISTIC /end REF_CHARACTERISTIC /begin REF_MEASUREMENT Rte_CDDInterface_Die1RxMtrPos_Cnt_u16 /end REF_MEASUREMENT /end GROUP
/begin GROUP CDDInterface.Die1RxRevCtr.Cnt_u16 "MICROSAR RTE" /begin SUB_GROUP /end SUB_GROUP /begin FUNCTION_LIST /end FUNCTION_LIST /begin REF_CHARACTERISTIC /end REF_CHARACTERISTIC /begin REF_MEASUREMENT Rte_CDDInterface_Die1RxRevCtr_Cnt_u16 /end REF_MEASUREMENT /end GROUP
/begin GROUP CDDInterface.Die1UnderVoltgFltAccum.Cnt_u16 "MICROSAR RTE" /begin SUB_GROUP /end SUB_GROUP /begin FUNCTION_LIST /end FUNCTION_LIST /begin REF_CHARACTERISTIC /end REF_CHARACTERISTIC /begin REF_MEASUREMENT Rte_CDDInterface_Die1UnderVoltgFltAccum_Cnt_u16 /end REF_MEASUREMENT /end GROUP
/begin GROUP CDDInterface.Die2RxError.Cnt_u16 "MICROSAR RTE" /begin SUB_GROUP /end SUB_GROUP /begin FUNCTION_LIST /end FUNCTION_LIST /begin REF_CHARACTERISTIC /end REF_CHARACTERISTIC /begin REF_MEASUREMENT Rte_CDDInterface_Die2RxError_Cnt_u16 /end REF_MEASUREMENT /end GROUP
/begin GROUP CDDInterface.Die2RxMtrPos.Cnt_u16 "MICROSAR RTE" /begin SUB_GROUP /end SUB_GROUP /begin FUNCTION_LIST /end FUNCTION_LIST /begin REF_CHARACTERISTIC /end REF_CHARACTERISTIC /begin REF_MEASUREMENT Rte_CDDInterface_Die2RxMtrPos_Cnt_u16 /end REF_MEASUREMENT /end GROUP
/begin GROUP CDDInterface.Die2RxRevCtr.Cnt_u16 "MICROSAR RTE" /begin SUB_GROUP /end SUB_GROUP /begin FUNCTION_LIST /end FUNCTION_LIST /begin REF_CHARACTERISTIC /end REF_CHARACTERISTIC /begin REF_MEASUREMENT Rte_CDDInterface_Die2RxRevCtr_Cnt_u16 /end REF_MEASUREMENT /end GROUP
/begin GROUP CDDInterface.DrivingDynSrlComSvcDft.Cnt_lgc "MICROSAR RTE" /begin SUB_GROUP /end SUB_GROUP /begin FUNCTION_LIST /end FUNCTION_LIST /begin REF_CHARACTERISTIC /end REF_CHARACTERISTIC /begin REF_MEASUREMENT Rte_CDDInterface_DrivingDynSrlComSvcDft_Cnt_lgc /end REF_MEASUREMENT /end GROUP
/begin GROUP CDDInterface.DwnldAsstGain.Uls_f32 "MICROSAR RTE" /begin SUB_GROUP /end SUB_GROUP /begin FUNCTION_LIST /end FUNCTION_LIST /begin REF_CHARACTERISTIC /end REF_CHARACTERISTIC /begin REF_MEASUREMENT Rte_CDDInterface_DwnldAsstGain_Uls_f32 /end REF_MEASUREMENT /end GROUP
/begin GROUP CDDInterface.EOTImpactSrlComSvcDft.Cnt_lgc "MICROSAR RTE" /begin SUB_GROUP /end SUB_GROUP /begin FUNCTION_LIST /end FUNCTION_LIST /begin REF_CHARACTERISTIC /end REF_CHARACTERISTIC /begin REF_MEASUREMENT Rte_CDDInterface_EOTImpactSrlComSvcDft_Cnt_lgc /end REF_MEASUREMENT /end GROUP
/begin GROUP CDDInterface.EOTThermalSrlComSvcDft.Cnt_lgc "MICROSAR RTE" /begin SUB_GROUP /end SUB_GROUP /begin FUNCTION_LIST /end FUNCTION_LIST /begin REF_CHARACTERISTIC /end REF_CHARACTERISTIC /begin REF_MEASUREMENT Rte_CDDInterface_EOTThermalSrlComSvcDft_Cnt_lgc /end REF_MEASUREMENT /end GROUP
/begin GROUP CDDInterface.EngONSrlComSvcDft.Cnt_lgc "MICROSAR RTE" /begin SUB_GROUP /end SUB_GROUP /begin FUNCTION_LIST /end FUNCTION_LIST /begin REF_CHARACTERISTIC /end REF_CHARACTERISTIC /begin REF_MEASUREMENT Rte_CDDInterface_EngONSrlComSvcDft_Cnt_lgc /end REF_MEASUREMENT /end GROUP
/begin GROUP CDDInterface.ExpectedOnTimeA.Cnt_u32 "MICROSAR RTE" /begin SUB_GROUP /end SUB_GROUP /begin FUNCTION_LIST /end FUNCTION_LIST /begin REF_CHARACTERISTIC /end REF_CHARACTERISTIC /begin REF_MEASUREMENT Rte_CDDInterface_ExpectedOnTimeA_Cnt_u32 /end REF_MEASUREMENT /end GROUP
/begin GROUP CDDInterface.ExpectedOnTimeB.Cnt_u32 "MICROSAR RTE" /begin SUB_GROUP /end SUB_GROUP /begin FUNCTION_LIST /end FUNCTION_LIST /begin REF_CHARACTERISTIC /end REF_CHARACTERISTIC /begin REF_MEASUREMENT Rte_CDDInterface_ExpectedOnTimeB_Cnt_u32 /end REF_MEASUREMENT /end GROUP
/begin GROUP CDDInterface.ExpectedOnTimeC.Cnt_u32 "MICROSAR RTE" /begin SUB_GROUP /end SUB_GROUP /begin FUNCTION_LIST /end FUNCTION_LIST /begin REF_CHARACTERISTIC /end REF_CHARACTERISTIC /begin REF_MEASUREMENT Rte_CDDInterface_ExpectedOnTimeC_Cnt_u32 /end REF_MEASUREMENT /end GROUP
/begin GROUP CDDInterface.FreqDepDmpSrlComSvcDft.Cnt_lgc "MICROSAR RTE" /begin SUB_GROUP /end SUB_GROUP /begin FUNCTION_LIST /end FUNCTION_LIST /begin REF_CHARACTERISTIC /end REF_CHARACTERISTIC /begin REF_MEASUREMENT Rte_CDDInterface_FreqDepDmpSrlComSvcDft_Cnt_lgc /end REF_MEASUREMENT /end GROUP
/begin GROUP CDDInterface.FricLrnSrlComSvcDft.Cnt_lgc "MICROSAR RTE" /begin SUB_GROUP /end SUB_GROUP /begin FUNCTION_LIST /end FUNCTION_LIST /begin REF_CHARACTERISTIC /end REF_CHARACTERISTIC /begin REF_MEASUREMENT Rte_CDDInterface_FricLrnSrlComSvcDft_Cnt_lgc /end REF_MEASUREMENT /end GROUP
/begin GROUP CDDInterface.HysAddSrlComSvcDft.Cnt_lgc "MICROSAR RTE" /begin SUB_GROUP /end SUB_GROUP /begin FUNCTION_LIST /end FUNCTION_LIST /begin REF_CHARACTERISTIC /end REF_CHARACTERISTIC /begin REF_MEASUREMENT Rte_CDDInterface_HysAddSrlComSvcDft_Cnt_lgc /end REF_MEASUREMENT /end GROUP
/begin GROUP CDDInterface.HystCompSrlComSvcDft.Cnt_lgc "MICROSAR RTE" /begin SUB_GROUP /end SUB_GROUP /begin FUNCTION_LIST /end FUNCTION_LIST /begin REF_CHARACTERISTIC /end REF_CHARACTERISTIC /begin REF_MEASUREMENT Rte_CDDInterface_HystCompSrlComSvcDft_Cnt_lgc /end REF_MEASUREMENT /end GROUP
/begin GROUP CDDInterface.IgnCnt.Cnt_u16 "MICROSAR RTE" /begin SUB_GROUP /end SUB_GROUP /begin FUNCTION_LIST /end FUNCTION_LIST /begin REF_CHARACTERISTIC /end REF_CHARACTERISTIC /begin REF_MEASUREMENT Rte_CDDInterface_IgnCnt_Cnt_u16 /end REF_MEASUREMENT /end GROUP
/begin GROUP CDDInterface.KinIntDiagSrlComSvcDft.Cnt_lgc "MICROSAR RTE" /begin SUB_GROUP /end SUB_GROUP /begin FUNCTION_LIST /end FUNCTION_LIST /begin REF_CHARACTERISTIC /end REF_CHARACTERISTIC /begin REF_MEASUREMENT Rte_CDDInterface_KinIntDiagSrlComSvcDft_Cnt_lgc /end REF_MEASUREMENT /end GROUP
/begin GROUP CDDInterface.LRPRPhaseadvanceCaptured.Cnt_s16 "MICROSAR RTE" /begin SUB_GROUP /end SUB_GROUP /begin FUNCTION_LIST /end FUNCTION_LIST /begin REF_CHARACTERISTIC /end REF_CHARACTERISTIC /begin REF_MEASUREMENT Rte_CDDInterface_LRPRPhaseadvanceCaptured_Cnt_s16 /end REF_MEASUREMENT /end GROUP
/begin GROUP CDDInterface.LimitSrlComSvcDft.Cnt_lgc "MICROSAR RTE" /begin SUB_GROUP /end SUB_GROUP /begin FUNCTION_LIST /end FUNCTION_LIST /begin REF_CHARACTERISTIC /end REF_CHARACTERISTIC /begin REF_MEASUREMENT Rte_CDDInterface_LimitSrlComSvcDft_Cnt_lgc /end REF_MEASUREMENT /end GROUP
/begin GROUP CDDInterface.MEC.Cnt_enum "MICROSAR RTE" /begin SUB_GROUP /end SUB_GROUP /begin FUNCTION_LIST /end FUNCTION_LIST /begin REF_CHARACTERISTIC /end REF_CHARACTERISTIC /begin REF_MEASUREMENT Rte_CDDInterface_MEC_Cnt_enum /end REF_MEASUREMENT /end GROUP
/begin GROUP CDDInterface.MRFMtrVel.MtrRadpS_f32 "MICROSAR RTE" /begin SUB_GROUP /end SUB_GROUP /begin FUNCTION_LIST /end FUNCTION_LIST /begin REF_CHARACTERISTIC /end REF_CHARACTERISTIC /begin REF_MEASUREMENT Rte_MtrVel_MotorVelMRF_MtrRadpS_f32 /end REF_MEASUREMENT /end GROUP
/begin GROUP CDDInterface.MeasuredOnTimeA.Cnt_u32 "MICROSAR RTE" /begin SUB_GROUP /end SUB_GROUP /begin FUNCTION_LIST /end FUNCTION_LIST /begin REF_CHARACTERISTIC /end REF_CHARACTERISTIC /begin REF_MEASUREMENT Rte_CDDInterface_MeasuredOnTimeA_Cnt_u32 /end REF_MEASUREMENT /end GROUP
/begin GROUP CDDInterface.MeasuredOnTimeB.Cnt_u32 "MICROSAR RTE" /begin SUB_GROUP /end SUB_GROUP /begin FUNCTION_LIST /end FUNCTION_LIST /begin REF_CHARACTERISTIC /end REF_CHARACTERISTIC /begin REF_MEASUREMENT Rte_CDDInterface_MeasuredOnTimeB_Cnt_u32 /end REF_MEASUREMENT /end GROUP
/begin GROUP CDDInterface.MeasuredOnTimeC.Cnt_u32 "MICROSAR RTE" /begin SUB_GROUP /end SUB_GROUP /begin FUNCTION_LIST /end FUNCTION_LIST /begin REF_CHARACTERISTIC /end REF_CHARACTERISTIC /begin REF_MEASUREMENT Rte_CDDInterface_MeasuredOnTimeC_Cnt_u32 /end REF_MEASUREMENT /end GROUP
/begin GROUP CDDInterface.MechMtrPos1.Rev_f32 "MICROSAR RTE" /begin SUB_GROUP /end SUB_GROUP /begin FUNCTION_LIST /end FUNCTION_LIST /begin REF_CHARACTERISTIC /end REF_CHARACTERISTIC /begin REF_MEASUREMENT Rte_CDDInterface_MechMtrPos1_Rev_f32 /end REF_MEASUREMENT /end GROUP
/begin GROUP CDDInterface.MechMtrPos1TimeStamp.USec_u32 "MICROSAR RTE" /begin SUB_GROUP /end SUB_GROUP /begin FUNCTION_LIST /end FUNCTION_LIST /begin REF_CHARACTERISTIC /end REF_CHARACTERISTIC /begin REF_MEASUREMENT Rte_CDDInterface_MechMtrPos1TimeStamp_USec_u32 /end REF_MEASUREMENT /end GROUP
/begin GROUP CDDInterface.MechMtrPos2TimeStamp.USec_u32 "MICROSAR RTE" /begin SUB_GROUP /end SUB_GROUP /begin FUNCTION_LIST /end FUNCTION_LIST /begin REF_CHARACTERISTIC /end REF_CHARACTERISTIC /begin REF_MEASUREMENT Rte_CDDInterface_MechMtrPos2TimeStamp_USec_u32 /end REF_MEASUREMENT /end GROUP
/begin GROUP CDDInterface.MfgDiagInhibit.Cnt_lgc "MICROSAR RTE" /begin SUB_GROUP /end SUB_GROUP /begin FUNCTION_LIST /end FUNCTION_LIST /begin REF_CHARACTERISTIC /end REF_CHARACTERISTIC /begin REF_MEASUREMENT Rte_CDDInterface_MfgDiagInhibit_Cnt_lgc /end REF_MEASUREMENT /end GROUP
/begin GROUP CDDInterface.ModIdxFinal.Uls_f32 "MICROSAR RTE" /begin SUB_GROUP /end SUB_GROUP /begin FUNCTION_LIST /end FUNCTION_LIST /begin REF_CHARACTERISTIC /end REF_CHARACTERISTIC /begin REF_MEASUREMENT Rte_CDDInterface_ModIdxFinal_Uls_f32 /end REF_MEASUREMENT /end GROUP
/begin GROUP CDDInterface.ModIdxSrlComSvcDft.Cnt_lgc "MICROSAR RTE" /begin SUB_GROUP /end SUB_GROUP /begin FUNCTION_LIST /end FUNCTION_LIST /begin REF_CHARACTERISTIC /end REF_CHARACTERISTIC /begin REF_MEASUREMENT Rte_CDDInterface_ModIdxSrlComSvcDft_Cnt_lgc /end REF_MEASUREMENT /end GROUP
/begin GROUP CDDInterface.ModeRequirePorts "MICROSAR RTE" /begin SUB_GROUP CDDInterface.SystemState.Mode /end SUB_GROUP /begin FUNCTION_LIST /end FUNCTION_LIST /begin REF_CHARACTERISTIC /end REF_CHARACTERISTIC /begin REF_MEASUREMENT /end REF_MEASUREMENT /end GROUP
/begin GROUP CDDInterface.MtrCurr1TempOffset.Volt_f32 "MICROSAR RTE" /begin SUB_GROUP /end SUB_GROUP /begin FUNCTION_LIST /end FUNCTION_LIST /begin REF_CHARACTERISTIC /end REF_CHARACTERISTIC /begin REF_MEASUREMENT Rte_CmMtrCurr_MtrCurr1TempOffset_Volt_f32 /end REF_MEASUREMENT /end GROUP
/begin GROUP CDDInterface.MtrCurr2TempOffset.Volt_f32 "MICROSAR RTE" /begin SUB_GROUP /end SUB_GROUP /begin FUNCTION_LIST /end FUNCTION_LIST /begin REF_CHARACTERISTIC /end REF_CHARACTERISTIC /begin REF_MEASUREMENT Rte_CmMtrCurr_MtrCurr2TempOffset_Volt_f32 /end REF_MEASUREMENT /end GROUP
/begin GROUP CDDInterface.MtrCurrDax.Amp_f32 "MICROSAR RTE" /begin SUB_GROUP /end SUB_GROUP /begin FUNCTION_LIST /end FUNCTION_LIST /begin REF_CHARACTERISTIC /end REF_CHARACTERISTIC /begin REF_MEASUREMENT Rte_CDDInterface_MtrCurrDax_Amp_f32 /end REF_MEASUREMENT /end GROUP
/begin GROUP CDDInterface.MtrCurrK1.Amp_f32 "MICROSAR RTE" /begin SUB_GROUP /end SUB_GROUP /begin FUNCTION_LIST /end FUNCTION_LIST /begin REF_CHARACTERISTIC /end REF_CHARACTERISTIC /begin REF_MEASUREMENT Rte_CDDInterface_MtrCurrK1_Amp_f32 /end REF_MEASUREMENT /end GROUP
/begin GROUP CDDInterface.MtrCurrK2.Amp_f32 "MICROSAR RTE" /begin SUB_GROUP /end SUB_GROUP /begin FUNCTION_LIST /end FUNCTION_LIST /begin REF_CHARACTERISTIC /end REF_CHARACTERISTIC /begin REF_MEASUREMENT Rte_CDDInterface_MtrCurrK2_Amp_f32 /end REF_MEASUREMENT /end GROUP
/begin GROUP CDDInterface.MtrCurrQax.Amp_f32 "MICROSAR RTE" /begin SUB_GROUP /end SUB_GROUP /begin FUNCTION_LIST /end FUNCTION_LIST /begin REF_CHARACTERISTIC /end REF_CHARACTERISTIC /begin REF_MEASUREMENT Rte_CDDInterface_MtrCurrQax_Amp_f32 /end REF_MEASUREMENT /end GROUP
/begin GROUP CDDInterface.MtrCurrQaxFinalRef.Amp_f32 "MICROSAR RTE" /begin SUB_GROUP /end SUB_GROUP /begin FUNCTION_LIST /end FUNCTION_LIST /begin REF_CHARACTERISTIC /end REF_CHARACTERISTIC /begin REF_MEASUREMENT Rte_CDDInterface_MtrCurrQaxFinalRef_Amp_f32 /end REF_MEASUREMENT /end GROUP
/begin GROUP CDDInterface.MtrElecMechPolarity.Cnt_s08 "MICROSAR RTE" /begin SUB_GROUP /end SUB_GROUP /begin FUNCTION_LIST /end FUNCTION_LIST /begin REF_CHARACTERISTIC /end REF_CHARACTERISTIC /begin REF_MEASUREMENT Rte_Polarity_MtrElecMechPolarity_Cnt_s08 /end REF_MEASUREMENT /end GROUP
/begin GROUP CDDInterface.MtrParmNrmLrnSrlComSvcDft.Cnt_lgc "MICROSAR RTE" /begin SUB_GROUP /end SUB_GROUP /begin FUNCTION_LIST /end FUNCTION_LIST /begin REF_CHARACTERISTIC /end REF_CHARACTERISTIC /begin REF_MEASUREMENT Rte_CDDInterface_MtrParmNrmLrnSrlComSvcDft_Cnt_lgc /end REF_MEASUREMENT /end GROUP
/begin GROUP CDDInterface.MtrPosPolarity.Cnt_s08 "MICROSAR RTE" /begin SUB_GROUP /end SUB_GROUP /begin FUNCTION_LIST /end FUNCTION_LIST /begin REF_CHARACTERISTIC /end REF_CHARACTERISTIC /begin REF_MEASUREMENT Rte_Polarity_MtrPosPolarity_Cnt_s08 /end REF_MEASUREMENT /end GROUP
/begin GROUP CDDInterface.MtrTrqCmdSign.Cnt_s16 "MICROSAR RTE" /begin SUB_GROUP /end SUB_GROUP /begin FUNCTION_LIST /end FUNCTION_LIST /begin REF_CHARACTERISTIC /end REF_CHARACTERISTIC /begin REF_MEASUREMENT Rte_CDDInterface_MtrTrqCmdSign_Cnt_s16 /end REF_MEASUREMENT /end GROUP
/begin GROUP CDDInterface.MtrVelNrmLrnSrlComSvcDft.Cnt_lgc "MICROSAR RTE" /begin SUB_GROUP /end SUB_GROUP /begin FUNCTION_LIST /end FUNCTION_LIST /begin REF_CHARACTERISTIC /end REF_CHARACTERISTIC /begin REF_MEASUREMENT Rte_CDDInterface_MtrVelNrmLrnSrlComSvcDft_Cnt_lgc /end REF_MEASUREMENT /end GROUP
/begin GROUP CDDInterface.MtrVoltDax.Volt_f32 "MICROSAR RTE" /begin SUB_GROUP /end SUB_GROUP /begin FUNCTION_LIST /end FUNCTION_LIST /begin REF_CHARACTERISTIC /end REF_CHARACTERISTIC /begin REF_MEASUREMENT Rte_CDDInterface_MtrVoltDax_Volt_f32 /end REF_MEASUREMENT /end GROUP
/begin GROUP CDDInterface.MtrVoltQax.Volt_f32 "MICROSAR RTE" /begin SUB_GROUP /end SUB_GROUP /begin FUNCTION_LIST /end FUNCTION_LIST /begin REF_CHARACTERISTIC /end REF_CHARACTERISTIC /begin REF_MEASUREMENT Rte_CDDInterface_MtrVoltQax_Volt_f32 /end REF_MEASUREMENT /end GROUP
/begin GROUP CDDInterface.MultIgnSrlComSvcDft.Cnt_lgc "MICROSAR RTE" /begin SUB_GROUP /end SUB_GROUP /begin FUNCTION_LIST /end FUNCTION_LIST /begin REF_CHARACTERISTIC /end REF_CHARACTERISTIC /begin REF_MEASUREMENT Rte_CDDInterface_MultIgnSrlComSvcDft_Cnt_lgc /end REF_MEASUREMENT /end GROUP
/begin GROUP CDDInterface.ParkAstSrlComSvcDft.Cnt_lgc "MICROSAR RTE" /begin SUB_GROUP /end SUB_GROUP /begin FUNCTION_LIST /end FUNCTION_LIST /begin REF_CHARACTERISTIC /end REF_CHARACTERISTIC /begin REF_MEASUREMENT Rte_CDDInterface_ParkAstSrlComSvcDft_Cnt_lgc /end REF_MEASUREMENT /end GROUP
/begin GROUP CDDInterface.PullCompSrlComSvcDft.Cnt_lgc "MICROSAR RTE" /begin SUB_GROUP /end SUB_GROUP /begin FUNCTION_LIST /end FUNCTION_LIST /begin REF_CHARACTERISTIC /end REF_CHARACTERISTIC /begin REF_MEASUREMENT Rte_CDDInterface_PullCompSrlComSvcDft_Cnt_lgc /end REF_MEASUREMENT /end GROUP
/begin GROUP CDDInterface.ReceiverPorts "MICROSAR RTE"
 /begin SUB_GROUP CDDInterface.CommOffset.Cnt_u16 CDDInterface.MRFMtrVel.MtrRadpS_f32 CDDInterface.MtrCurr1TempOffset.Volt_f32 CDDInterface.MtrCurr2TempOffset.Volt_f32 CDDInterface.MtrElecMechPolarity.Cnt_s08 CDDInterface.MtrPosPolarity.Cnt_s08 CDDInterface.MtrTrqCmdSign.Cnt_s16 CDDInterface.Vecu.Volt_f32 /end SUB_GROUP
 /begin FUNCTION_LIST /end FUNCTION_LIST
 /begin REF_CHARACTERISTIC /end REF_CHARACTERISTIC
 /begin REF_MEASUREMENT /end REF_MEASUREMENT
/end GROUP
/begin GROUP CDDInterface.ReturnSrlComSvcDft.Cnt_lgc "MICROSAR RTE" /begin SUB_GROUP /end SUB_GROUP /begin FUNCTION_LIST /end FUNCTION_LIST /begin REF_CHARACTERISTIC /end REF_CHARACTERISTIC /begin REF_MEASUREMENT Rte_CDDInterface_ReturnSrlComSvcDft_Cnt_lgc /end REF_MEASUREMENT /end GROUP
/begin GROUP CDDInterface.RxMsgsSrlComSvcDft.Cnt_lgc "MICROSAR RTE" /begin SUB_GROUP /end SUB_GROUP /begin FUNCTION_LIST /end FUNCTION_LIST /begin REF_CHARACTERISTIC /end REF_CHARACTERISTIC /begin REF_MEASUREMENT Rte_CDDInterface_RxMsgsSrlComSvcDft_Cnt_lgc /end REF_MEASUREMENT /end GROUP
/begin GROUP CDDInterface.RxMtrPosParityAccum.Cnt_u16 "MICROSAR RTE" /begin SUB_GROUP /end SUB_GROUP /begin FUNCTION_LIST /end FUNCTION_LIST /begin REF_CHARACTERISTIC /end REF_CHARACTERISTIC /begin REF_MEASUREMENT Rte_CDDInterface_RxMtrPosParityAccum_Cnt_u16 /end REF_MEASUREMENT /end GROUP
/begin GROUP CDDInterface.SystemState.Mode "MICROSAR RTE" /begin REF_MEASUREMENT Rte_ModeMachine_StaMd_SystemState_Mode /end REF_MEASUREMENT /end GROUP
/begin GROUP CDDInterface.Vecu.Volt_f32 "MICROSAR RTE" /begin REF_MEASUREMENT Rte_BatteryVoltage_Vecu_Volt_f32 /end REF_MEASUREMENT /end GROUP
/begin GROUP CmMtrCurr.ADCMtrCurr1.Volts_f32 "MICROSAR RTE" /begin REF_MEASUREMENT Rte_CDDInterface_ADCMtrCurr1_Volts_f32 /end REF_MEASUREMENT /end GROUP
/begin GROUP CmMtrCurr.ADCMtrCurr2.Volts_f32 "MICROSAR RTE" /begin REF_MEASUREMENT Rte_CDDInterface_ADCMtrCurr2_Volts_f32 /end REF_MEASUREMENT /end GROUP
/begin GROUP CmMtrCurr.ComOffset.Cnt_u16 "MICROSAR RTE" /begin REF_MEASUREMENT Rte_CmMtrCurr_ComOffset_Cnt_u16 /end REF_MEASUREMENT /end GROUP
/begin GROUP CmMtrCurr.CorrMtrCurrPosition.Rev_f32 "MICROSAR RTE" /begin REF_MEASUREMENT Rte_CDDInterface_CorrMtrCurrPosition_Rev_f32 /end REF_MEASUREMENT /end GROUP
/begin GROUP CmMtrCurr.MEC.Cnt_enum "MICROSAR RTE" /begin REF_MEASUREMENT Rte_CDDInterface_MEC_Cnt_enum /end REF_MEASUREMENT /end GROUP
/begin GROUP CmMtrCurr.MtrCurr1TempOffset.Volt_f32 "MICROSAR RTE" /begin REF_MEASUREMENT Rte_CmMtrCurr_MtrCurr1TempOffset_Volt_f32 /end REF_MEASUREMENT /end GROUP
/begin GROUP CmMtrCurr.MtrCurr2TempOffset.Volt_f32 "MICROSAR RTE" /begin REF_MEASUREMENT Rte_CmMtrCurr_MtrCurr2TempOffset_Volt_f32 /end REF_MEASUREMENT /end GROUP
/begin GROUP CmMtrCurr.MtrCurrK1.Amp_f32 "MICROSAR RTE" /begin REF_MEASUREMENT Rte_CDDInterface_MtrCurrK1_Amp_f32 /end REF_MEASUREMENT /end GROUP
/begin GROUP CmMtrCurr.MtrCurrK2.Amp_f32 "MICROSAR RTE" /begin REF_MEASUREMENT Rte_CDDInterface_MtrCurrK2_Amp_f32 /end REF_MEASUREMENT /end GROUP
/begin GROUP CmMtrCurr.MtrVel.MtrRadpS_f32 "MICROSAR RTE" /begin REF_MEASUREMENT Rte_MtrVel_MotorVelMRF_MtrRadpS_f32 /end REF_MEASUREMENT /end GROUP
/begin GROUP CmMtrCurr.SystemState.Mode "MICROSAR RTE" /begin REF_MEASUREMENT Rte_ModeMachine_StaMd_SystemState_Mode /end REF_MEASUREMENT /end GROUP
/begin GROUP CmMtrCurr.Vecu.Volt_f32 "MICROSAR RTE" /begin REF_MEASUREMENT Rte_BatteryVoltage_Vecu_Volt_f32 /end REF_MEASUREMENT /end GROUP
/begin GROUP CmMtrCurr.VehSpd.Kph_f32 "MICROSAR RTE" /begin REF_MEASUREMENT Rte_SignlCondn_VehicleSpeed_Kph_f32 /end REF_MEASUREMENT /end GROUP
/begin GROUP CmMtrCurr.VhSpdValid.Cnt_lgc "MICROSAR RTE" /begin REF_MEASUREMENT Rte_SrlComInput_VehicleSpeedValid_Cnt_lgc /end REF_MEASUREMENT /end GROUP
/begin GROUP ComplErr.ComplErr.HwDeg_f32 "MICROSAR RTE" /begin REF_MEASUREMENT Rte_ComplErr_ComplErr_HwDeg_f32 /end REF_MEASUREMENT /end GROUP
/begin GROUP ComplErr.TorqueCmdCRF.MtrNm_f32 "MICROSAR RTE" /begin REF_MEASUREMENT Rte_CtrldDisShtdn_CntDisMtrTrqCmdCRF_MtrNm_f32 /end REF_MEASUREMENT /end GROUP
/begin GROUP CtrldDisShtdn.CntDisMtrTrqCmdCRF.MtrNm_f32 "MICROSAR RTE" /begin REF_MEASUREMENT Rte_CtrldDisShtdn_CntDisMtrTrqCmdCRF_MtrNm_f32 /end REF_MEASUREMENT /end GROUP
/begin GROUP CtrldDisShtdn.SystemState.Mode "MICROSAR RTE" /begin REF_MEASUREMENT Rte_ModeMachine_StaMd_SystemState_Mode /end REF_MEASUREMENT /end GROUP
/begin GROUP CurrCmd.MRFMtrVel.MtrRadpS_f32 "MICROSAR RTE" /begin REF_MEASUREMENT Rte_MtrVel_MotorVelMRF_MtrRadpS_f32 /end REF_MEASUREMENT /end GROUP
/begin GROUP CurrCmd.Vecu.Volt_f32 "MICROSAR RTE" /begin REF_MEASUREMENT Rte_BatteryVoltage_Vecu_Volt_f32 /end REF_MEASUREMENT /end GROUP
/begin GROUP CurrCmd.VehSpd.Kph_f32 "MICROSAR RTE" /begin REF_MEASUREMENT Rte_SignlCondn_VehicleSpeed_Kph_f32 /end REF_MEASUREMENT /end GROUP
/begin GROUP Damping.AssistCmd.MtrNm_f32 "MICROSAR RTE" /begin REF_MEASUREMENT Rte_StabilityComp_AssistCmd_MtrNm_f32 /end REF_MEASUREMENT /end GROUP
/begin GROUP Damping.AssistMechTempEst.DegC_f32 "MICROSAR RTE" /begin REF_MEASUREMENT Rte_MtrTempEst_AssistMechTempEst_DegC_f32 /end REF_MEASUREMENT /end GROUP
/begin GROUP Damping.DefeatDampingSvc.Cnt_lgc "MICROSAR RTE" /begin REF_MEASUREMENT Rte_CDDInterface_DampingSrlComSvcDft_Cnt_lgc /end REF_MEASUREMENT /end GROUP
/begin GROUP Damping.HwTorque.HwNm_f32 "MICROSAR RTE" /begin REF_MEASUREMENT Rte_Sweep_OutputHwTrq_HwNm_f32 /end REF_MEASUREMENT /end GROUP
/begin GROUP Damping.VehicleSpeed.Kph_f32 "MICROSAR RTE" /begin REF_MEASUREMENT Rte_SignlCondn_VehicleSpeed_Kph_f32 /end REF_MEASUREMENT /end GROUP
/begin GROUP DampingFirewall.AsstFirewallActive.Uls_f32 "MICROSAR RTE" /begin REF_MEASUREMENT Rte_AssistFirewall_AsstFirewallActive_Uls_f32 /end REF_MEASUREMENT /end GROUP
/begin GROUP DampingFirewall.BaseAssistCmd.MtrNm_f32 "MICROSAR RTE" /begin REF_MEASUREMENT Rte_Assist_BaseAssistCmd_MtrNm_f32 /end REF_MEASUREMENT /end GROUP
/begin GROUP DampingFirewall.CombinedDamping.MtrNm_f32 "MICROSAR RTE" /begin REF_MEASUREMENT Rte_DampingFirewall_CombinedDamping_MtrNm_f32 /end REF_MEASUREMENT /end GROUP
/begin GROUP DampingFirewall.Defeat_Damping_Svc.Cnt_lgc "MICROSAR RTE" /begin REF_MEASUREMENT Rte_CDDInterface_DampingSrlComSvcDft_Cnt_lgc /end REF_MEASUREMENT /end GROUP
/begin GROUP DampingFirewall.FreqDepDmpSrlComSvcDft.Cnt_lgc "MICROSAR RTE" /begin REF_MEASUREMENT Rte_CDDInterface_FreqDepDmpSrlComSvcDft_Cnt_lgc /end REF_MEASUREMENT /end GROUP
/begin GROUP DampingFirewall.HwTorque.HwNm_f32 "MICROSAR RTE" /begin REF_MEASUREMENT Rte_Sweep_OutputHwTrq_HwNm_f32 /end REF_MEASUREMENT /end GROUP
/begin GROUP DampingFirewall.MEC_Counter.Cnt_enum "MICROSAR RTE" /begin REF_MEASUREMENT Rte_CDDInterface_MEC_Cnt_enum /end REF_MEASUREMENT /end GROUP
/begin GROUP DampingFirewall.SystemState.Mode "MICROSAR RTE" /begin REF_MEASUREMENT Rte_ModeMachine_StaMd_SystemState_Mode /end REF_MEASUREMENT /end GROUP
/begin GROUP DampingFirewall.VehicleSpeed.Kph_f32 "MICROSAR RTE" /begin REF_MEASUREMENT Rte_SignlCondn_VehicleSpeed_Kph_f32 /end REF_MEASUREMENT /end GROUP
/begin GROUP DiagMgr10.DiagStsHWASbSystmFltPres.Cnt_lgc "MICROSAR RTE" /begin REF_MEASUREMENT Rte_DiagMgr10_DiagStsHWASbSystmFltPres_Cnt_lgc /end REF_MEASUREMENT /end GROUP
/begin GROUP DiagMgr10.HwTrq.HwNm_f32 "MICROSAR RTE" /begin REF_MEASUREMENT Rte_Sweep_OutputHwTrq_HwNm_f32 /end REF_MEASUREMENT /end GROUP
/begin GROUP DiagMgr10.IgnCnt.Cnt_u16 "MICROSAR RTE" /begin REF_MEASUREMENT Rte_CDDInterface_IgnCnt_Cnt_u16 /end REF_MEASUREMENT /end GROUP
/begin GROUP DiagMgr10.MEC.Cnt_enum "MICROSAR RTE" /begin REF_MEASUREMENT Rte_CDDInterface_MEC_Cnt_enum /end REF_MEASUREMENT /end GROUP
/begin GROUP DiagMgr10.MfgDiagInhibit.Cnt_lgc "MICROSAR RTE" /begin REF_MEASUREMENT Rte_CDDInterface_MfgDiagInhibit_Cnt_lgc /end REF_MEASUREMENT /end GROUP
/begin GROUP DiagMgr10.SystemState.Mode "MICROSAR RTE" /begin REF_MEASUREMENT Rte_ModeMachine_StaMd_SystemState_Mode /end REF_MEASUREMENT /end GROUP
/begin GROUP DiagMgr10.VehSpd.Kph_f32 "MICROSAR RTE" /begin REF_MEASUREMENT Rte_SignlCondn_VehicleSpeed_Kph_f32 /end REF_MEASUREMENT /end GROUP
/begin GROUP DiagMgr8.HwTrq.HwNm_f32 "MICROSAR RTE" /begin REF_MEASUREMENT Rte_Sweep_OutputHwTrq_HwNm_f32 /end REF_MEASUREMENT /end GROUP
/begin GROUP DiagMgr8.IgnCnt.Cnt_u16 "MICROSAR RTE" /begin REF_MEASUREMENT Rte_CDDInterface_IgnCnt_Cnt_u16 /end REF_MEASUREMENT /end GROUP
/begin GROUP DiagMgr8.MEC.Cnt_enum "MICROSAR RTE" /begin REF_MEASUREMENT Rte_CDDInterface_MEC_Cnt_enum /end REF_MEASUREMENT /end GROUP
/begin GROUP DiagMgr8.MfgDiagInhibit.Cnt_lgc "MICROSAR RTE" /begin REF_MEASUREMENT Rte_CDDInterface_MfgDiagInhibit_Cnt_lgc /end REF_MEASUREMENT /end GROUP
/begin GROUP DiagMgr8.VehSpd.Kph_f32 "MICROSAR RTE" /begin REF_MEASUREMENT Rte_SignlCondn_VehicleSpeed_Kph_f32 /end REF_MEASUREMENT /end GROUP
/begin GROUP DiagMgr9.HwTrq.HwNm_f32 "MICROSAR RTE" /begin REF_MEASUREMENT Rte_Sweep_OutputHwTrq_HwNm_f32 /end REF_MEASUREMENT /end GROUP
/begin GROUP DiagMgr9.IgnCnt.Cnt_u16 "MICROSAR RTE" /begin REF_MEASUREMENT Rte_CDDInterface_IgnCnt_Cnt_u16 /end REF_MEASUREMENT /end GROUP
/begin GROUP DiagMgr9.MEC.Cnt_enum "MICROSAR RTE" /begin REF_MEASUREMENT Rte_CDDInterface_MEC_Cnt_enum /end REF_MEASUREMENT /end GROUP
/begin GROUP DiagMgr9.MfgDiagInhibit.Cnt_lgc "MICROSAR RTE" /begin REF_MEASUREMENT Rte_CDDInterface_MfgDiagInhibit_Cnt_lgc /end REF_MEASUREMENT /end GROUP
/begin GROUP DiagMgr9.SystemState.Mode "MICROSAR RTE" /begin REF_MEASUREMENT Rte_ModeMachine_StaMd9_SystemState9_Mode /end REF_MEASUREMENT /end GROUP
/begin GROUP DiagMgr9.VehSpd.Kph_f32 "MICROSAR RTE" /begin REF_MEASUREMENT Rte_SignlCondn_VehicleSpeed_Kph_f32 /end REF_MEASUREMENT /end GROUP
/begin GROUP DiagSvc.DesiredTunSet.Cnt_u16 "MICROSAR RTE" /begin REF_MEASUREMENT Rte_DiagSvc_DesiredTunSet_Cnt_u16 /end REF_MEASUREMENT /end GROUP
/begin GROUP DiagSvc.HwPos.HwDeg_f32 "MICROSAR RTE" /begin REF_MEASUREMENT Rte_AbsHwPos_HandwheelPosition_HwDeg_f32 /end REF_MEASUREMENT /end GROUP
/begin GROUP DiagSvc.HwTrq.HwNm_f32 "MICROSAR RTE" /begin REF_MEASUREMENT Rte_Sweep_OutputHwTrq_HwNm_f32 /end REF_MEASUREMENT /end GROUP
/begin GROUP DiagSvc.MEC.Cnt_enum "MICROSAR RTE" /begin REF_MEASUREMENT Rte_CDDInterface_MEC_Cnt_enum /end REF_MEASUREMENT /end GROUP
/begin GROUP DiagSvc.SystemState.Mode "MICROSAR RTE" /begin REF_MEASUREMENT Rte_ModeMachine_StaMd9_SystemState9_Mode /end REF_MEASUREMENT /end GROUP
/begin GROUP DiagSvc.Vecu_Volt_f32.Volt_f32 "MICROSAR RTE" /begin REF_MEASUREMENT Rte_BatteryVoltage_Vecu_Volt_f32 /end REF_MEASUREMENT /end GROUP
/begin GROUP DiagSvc.VehSpd.Kph_f32 "MICROSAR RTE" /begin REF_MEASUREMENT Rte_SignlCondn_VehicleSpeed_Kph_f32 /end REF_MEASUREMENT /end GROUP
/begin GROUP DigHwTrqSENT.MECCounter.Cnt_enum "MICROSAR RTE" /begin REF_MEASUREMENT Rte_CDDInterface_MEC_Cnt_enum /end REF_MEASUREMENT /end GROUP
/begin GROUP DigMSB.AlignedCumMechMtrPosCRF.Deg_f32 "MICROSAR RTE" /begin REF_MEASUREMENT Rte_DigMSB_AlignedCumMechMtrPosCRF_Deg_f32 /end REF_MEASUREMENT /end GROUP
/begin GROUP DigMSB.AlignedCumMechMtrPosStatus.Cnt_u08 "MICROSAR RTE" /begin REF_MEASUREMENT Rte_DigMSB_AlignedCumMechMtrPosStatus_Cnt_u08 /end REF_MEASUREMENT /end GROUP
/begin GROUP DigMSB.CorrectedElecMtrPos.Rev_u0p16 "MICROSAR RTE" /begin REF_MEASUREMENT Rte_CDDInterface_CorrectedElecMtrPos_Rev_u0p16 /end REF_MEASUREMENT /end GROUP
/begin GROUP DigMSB.CumMechMtrPos.Rev_f32 "MICROSAR RTE" /begin REF_MEASUREMENT Rte_CDDInterface_CumMechMtrPos_Rev_f32 /end REF_MEASUREMENT /end GROUP
/begin GROUP DigMSB.CumMechMtrPosCRF.Deg_f32 "MICROSAR RTE" /begin REF_MEASUREMENT Rte_DigMSB_CumMechMtrPosCRF_Deg_f32 /end REF_MEASUREMENT /end GROUP
/begin GROUP DigMSB.Die1RxError.Cnt_u16 "MICROSAR RTE" /begin REF_MEASUREMENT Rte_CDDInterface_Die1RxError_Cnt_u16 /end REF_MEASUREMENT /end GROUP
/begin GROUP DigMSB.Die1RxMtrPos.Cnt_u16 "MICROSAR RTE" /begin REF_MEASUREMENT Rte_CDDInterface_Die1RxMtrPos_Cnt_u16 /end REF_MEASUREMENT /end GROUP
/begin GROUP DigMSB.Die1RxRevCtr.Cnt_u16 "MICROSAR RTE" /begin REF_MEASUREMENT Rte_CDDInterface_Die1RxRevCtr_Cnt_u16 /end REF_MEASUREMENT /end GROUP
/begin GROUP DigMSB.Die1UnderVoltgFltAccum.Cnt_u16 "MICROSAR RTE" /begin REF_MEASUREMENT Rte_CDDInterface_Die1UnderVoltgFltAccum_Cnt_u16 /end REF_MEASUREMENT /end GROUP
/begin GROUP DigMSB.Die2RxError.Cnt_u16 "MICROSAR RTE" /begin REF_MEASUREMENT Rte_CDDInterface_Die2RxError_Cnt_u16 /end REF_MEASUREMENT /end GROUP
/begin GROUP DigMSB.Die2RxMtrPos.Cnt_u16 "MICROSAR RTE" /begin REF_MEASUREMENT Rte_CDDInterface_Die2RxMtrPos_Cnt_u16 /end REF_MEASUREMENT /end GROUP
/begin GROUP DigMSB.Die2RxRevCtr.Cnt_u16 "MICROSAR RTE" /begin REF_MEASUREMENT Rte_CDDInterface_Die2RxRevCtr_Cnt_u16 /end REF_MEASUREMENT /end GROUP
/begin GROUP DigMSB.MtrPosPolarity.Cnt_s08 "MICROSAR RTE" /begin REF_MEASUREMENT Rte_Polarity_MtrPosPolarity_Cnt_s08 /end REF_MEASUREMENT /end GROUP
/begin GROUP DigMSB.RxMtrPosParityAccum.Cnt_u16 "MICROSAR RTE" /begin REF_MEASUREMENT Rte_CDDInterface_RxMtrPosParityAccum_Cnt_u16 /end REF_MEASUREMENT /end GROUP
/begin GROUP DigPhsReasDiag.ExpectedOnTimeA.Cnt_u32 "MICROSAR RTE" /begin REF_MEASUREMENT Rte_CDDInterface_ExpectedOnTimeA_Cnt_u32 /end REF_MEASUREMENT /end GROUP
/begin GROUP DigPhsReasDiag.ExpectedOnTimeB.Cnt_u32 "MICROSAR RTE" /begin REF_MEASUREMENT Rte_CDDInterface_ExpectedOnTimeB_Cnt_u32 /end REF_MEASUREMENT /end GROUP
/begin GROUP DigPhsReasDiag.ExpectedOnTimeC.Cnt_u32 "MICROSAR RTE" /begin REF_MEASUREMENT Rte_CDDInterface_ExpectedOnTimeC_Cnt_u32 /end REF_MEASUREMENT /end GROUP
/begin GROUP DigPhsReasDiag.LRPRCorrectedMtrPosCaptured.Rev_f32 "MICROSAR RTE" /begin REF_MEASUREMENT Rte_CDDInterface_CorrMtrPosElec_Rev_f32 /end REF_MEASUREMENT /end GROUP
/begin GROUP DigPhsReasDiag.LRPRModulationIndexCaptured.Uls_f32 "MICROSAR RTE" /begin REF_MEASUREMENT Rte_CDDInterface_ModIdxFinal_Uls_f32 /end REF_MEASUREMENT /end GROUP
/begin GROUP DigPhsReasDiag.LRPRPhaseadvanceCaptured.Cnt_s16 "MICROSAR RTE" /begin REF_MEASUREMENT Rte_CDDInterface_LRPRPhaseadvanceCaptured_Cnt_s16 /end REF_MEASUREMENT /end GROUP
/begin GROUP DigPhsReasDiag.MeasuredOnTimeA.Cnt_u32 "MICROSAR RTE" /begin REF_MEASUREMENT Rte_CDDInterface_MeasuredOnTimeA_Cnt_u32 /end REF_MEASUREMENT /end GROUP
/begin GROUP DigPhsReasDiag.MeasuredOnTimeB.Cnt_u32 "MICROSAR RTE" /begin REF_MEASUREMENT Rte_CDDInterface_MeasuredOnTimeB_Cnt_u32 /end REF_MEASUREMENT /end GROUP
/begin GROUP DigPhsReasDiag.MeasuredOnTimeC.Cnt_u32 "MICROSAR RTE" /begin REF_MEASUREMENT Rte_CDDInterface_MeasuredOnTimeC_Cnt_u32 /end REF_MEASUREMENT /end GROUP
/begin GROUP DigPhsReasDiag.MotorVelMRFUnfiltered.MtrRadpS_f32 "MICROSAR RTE" /begin REF_MEASUREMENT Rte_MtrVel_MotorVelMRF_MtrRadpS_f32 /end REF_MEASUREMENT /end GROUP
/begin GROUP DigPhsReasDiag.MtrElecMechPolarity.Cnt_s08 "MICROSAR RTE" /begin REF_MEASUREMENT Rte_Polarity_MtrElecMechPolarity_Cnt_s08 /end REF_MEASUREMENT /end GROUP
/begin GROUP DigPhsReasDiag.SystemState.Mode "MICROSAR RTE" /begin REF_MEASUREMENT Rte_ModeMachine_StaMd_SystemState_Mode /end REF_MEASUREMENT /end GROUP
/begin GROUP EOTActuatorMng.EOTDisable.Cnt_lgc "MICROSAR RTE" /begin REF_MEASUREMENT Rte_CDDInterface_EOTImpactSrlComSvcDft_Cnt_lgc /end REF_MEASUREMENT /end GROUP
/begin GROUP EOTActuatorMng.HandWheelAuth.Uls_f32 "MICROSAR RTE" /begin REF_MEASUREMENT Rte_AbsHwPos_HandwheelAuthority_Uls_f32 /end REF_MEASUREMENT /end GROUP
/begin GROUP EOTActuatorMng.HandWheelPos.HwDeg_f32 "MICROSAR RTE" /begin REF_MEASUREMENT Rte_AbsHwPos_HandwheelPosition_HwDeg_f32 /end REF_MEASUREMENT /end GROUP
/begin GROUP EOTActuatorMng.HwTorque.HwNm_f32 "MICROSAR RTE" /begin REF_MEASUREMENT Rte_Sweep_OutputHwTrq_HwNm_f32 /end REF_MEASUREMENT /end GROUP
/begin GROUP EOTActuatorMng.OutputRampMultLtd.Uls_f32 "MICROSAR RTE" /begin REF_MEASUREMENT Rte_LmtCod_OutputRampMultLtd_Uls_f32 /end REF_MEASUREMENT /end GROUP
/begin GROUP EOTActuatorMng.PreLimitTorque.MtrNm_f32 "MICROSAR RTE" /begin REF_MEASUREMENT Rte_AstLmt_PreLimitTorque_MtrNm_f32 /end REF_MEASUREMENT /end GROUP
/begin GROUP EOTActuatorMng.VehicleSpeed.Kph_f32 "MICROSAR RTE" /begin REF_MEASUREMENT Rte_SignlCondn_VehicleSpeed_Kph_f32 /end REF_MEASUREMENT /end GROUP
/begin GROUP ElePwr.MtrCurrDax.Amp_f32 "MICROSAR RTE" /begin REF_MEASUREMENT Rte_CDDInterface_MtrCurrDax_Amp_f32 /end REF_MEASUREMENT /end GROUP
/begin GROUP ElePwr.MtrCurrQax.Amp_f32 "MICROSAR RTE" /begin REF_MEASUREMENT Rte_CDDInterface_MtrCurrQax_Amp_f32 /end REF_MEASUREMENT /end GROUP
/begin GROUP ElePwr.MtrVoltDax.Volt_f32 "MICROSAR RTE" /begin REF_MEASUREMENT Rte_CDDInterface_MtrVoltDax_Volt_f32 /end REF_MEASUREMENT /end GROUP
/begin GROUP ElePwr.MtrVoltQax.Volt_f32 "MICROSAR RTE" /begin REF_MEASUREMENT Rte_CDDInterface_MtrVoltQax_Volt_f32 /end REF_MEASUREMENT /end GROUP
/begin GROUP ElePwr.Vecu.Volt_f32 "MICROSAR RTE" /begin REF_MEASUREMENT Rte_BatteryVoltage_Vecu_Volt_f32 /end REF_MEASUREMENT /end GROUP
/begin GROUP EtDmpFw.EOTDampingLtd.MtrNm_f32 "MICROSAR RTE" /begin REF_MEASUREMENT Rte_EtDmpFw_EOTDampingLtd_MtrNm_f32 /end REF_MEASUREMENT /end GROUP
/begin GROUP EtDmpFw.EOTDisable.Cnt_lgc "MICROSAR RTE" /begin REF_MEASUREMENT Rte_CDDInterface_EOTImpactSrlComSvcDft_Cnt_lgc /end REF_MEASUREMENT /end GROUP
/begin GROUP EtDmpFw.HandwheelAuthority.Uls_f32 "MICROSAR RTE" /begin REF_MEASUREMENT Rte_AbsHwPos_HandwheelAuthority_Uls_f32 /end REF_MEASUREMENT /end GROUP
/begin GROUP EtDmpFw.HandwheelPosition.HwDeg_f32 "MICROSAR RTE" /begin REF_MEASUREMENT Rte_AbsHwPos_HandwheelPosition_HwDeg_f32 /end REF_MEASUREMENT /end GROUP
/begin GROUP EtDmpFw.MEC_Counter.Cnt_enum "MICROSAR RTE" /begin REF_MEASUREMENT Rte_CDDInterface_MEC_Cnt_enum /end REF_MEASUREMENT /end GROUP
/begin GROUP EtDmpFw.Vehicle_Speed.Kph_f32 "MICROSAR RTE" /begin REF_MEASUREMENT Rte_SignlCondn_VehicleSpeed_Kph_f32 /end REF_MEASUREMENT /end GROUP
/begin GROUP FrqDepDmpnInrtCmp.BaseAssistCmd.MtrNm_f32 "MICROSAR RTE" /begin REF_MEASUREMENT Rte_Assist_BaseAssistCmd_MtrNm_f32 /end REF_MEASUREMENT /end GROUP
/begin GROUP FrqDepDmpnInrtCmp.FreqDepDmpSrlComSvcDft.Cnt_lgc "MICROSAR RTE" /begin REF_MEASUREMENT Rte_CDDInterface_FreqDepDmpSrlComSvcDft_Cnt_lgc /end REF_MEASUREMENT /end GROUP
/begin GROUP FrqDepDmpnInrtCmp.HwTorque.HwNm_f32 "MICROSAR RTE" /begin REF_MEASUREMENT Rte_Sweep_OutputHwTrq_HwNm_f32 /end REF_MEASUREMENT /end GROUP
/begin GROUP FrqDepDmpnInrtCmp.SystemState.Mode "MICROSAR RTE" /begin REF_MEASUREMENT Rte_ModeMachine_StaMd_SystemState_Mode /end REF_MEASUREMENT /end GROUP
/begin GROUP FrqDepDmpnInrtCmp.VehicleSpeed.Kph_f32 "MICROSAR RTE" /begin REF_MEASUREMENT Rte_SignlCondn_VehicleSpeed_Kph_f32 /end REF_MEASUREMENT /end GROUP
/begin GROUP Gsod.Corrected_MtrPos.Rev_f32 "MICROSAR RTE" /begin REF_MEASUREMENT Rte_CDDInterface_CorrMtrPosElec_Rev_f32 /end REF_MEASUREMENT /end GROUP
/begin GROUP Gsod.MtrElecMech_Polarity.Cnt_s08 "MICROSAR RTE" /begin REF_MEASUREMENT Rte_Polarity_MtrElecMechPolarity_Cnt_s08 /end REF_MEASUREMENT /end GROUP
/begin GROUP Gsod.SysC_Vecu.Volt_f32 "MICROSAR RTE" /begin REF_MEASUREMENT Rte_BatteryVoltage_SysC_Vecu_Volt_f32 /end REF_MEASUREMENT /end GROUP
/begin GROUP Gsod.SystemState.Mode "MICROSAR RTE" /begin REF_MEASUREMENT Rte_ModeMachine_StaMd_SystemState_Mode /end REF_MEASUREMENT /end GROUP
/begin GROUP Gsod.Torque_Cmd_CRF.MtrNm_f32 "MICROSAR RTE" /begin REF_MEASUREMENT Rte_CtrldDisShtdn_CntDisMtrTrqCmdCRF_MtrNm_f32 /end REF_MEASUREMENT /end GROUP
/begin GROUP Gsod.Vecu.Volt_f32 "MICROSAR RTE" /begin REF_MEASUREMENT Rte_BatteryVoltage_Vecu_Volt_f32 /end REF_MEASUREMENT /end GROUP
/begin GROUP HiLoadStall.DftStallLimit.Cnt_lgc "MICROSAR RTE" /begin REF_MEASUREMENT Rte_CDDInterface_EOTThermalSrlComSvcDft_Cnt_lgc /end REF_MEASUREMENT /end GROUP
/begin GROUP HiLoadStall.PreLimitForStall.MtrNm_f32 "MICROSAR RTE" /begin REF_MEASUREMENT Rte_AstLmt_PreLimitForStall_MtrNm_f32 /end REF_MEASUREMENT /end GROUP
/begin GROUP HighFreqAssist.HighFreqAssist.MtrNm_f32 "MICROSAR RTE" /begin REF_MEASUREMENT Rte_HighFreqAssist_HighFreqAssist_MtrNm_f32 /end REF_MEASUREMENT /end GROUP
/begin GROUP HighFreqAssist.HwTorque.HwNm_f32 "MICROSAR RTE" /begin REF_MEASUREMENT Rte_Sweep_OutputHwTrq_HwNm_f32 /end REF_MEASUREMENT /end GROUP
/begin GROUP HighFreqAssist.VehicleSpeed.Kph_f32 "MICROSAR RTE" /begin REF_MEASUREMENT Rte_SignlCondn_VehicleSpeed_Kph_f32 /end REF_MEASUREMENT /end GROUP
/begin GROUP HwPwUp.PwrDiscATestComplete.Cnt_lgc "MICROSAR RTE" /begin REF_MEASUREMENT Rte_BkCpPc_PwrDiscATestComplete_Cnt_lgc /end REF_MEASUREMENT /end GROUP
/begin GROUP HwPwUp.PwrDiscATestStart.Cnt_lgc "MICROSAR RTE" /begin REF_MEASUREMENT Rte_HwPwUp_PwrDiscATestStart_Cnt_lgc /end REF_MEASUREMENT /end GROUP
/begin GROUP HwPwUp.PwrDiscBTestComplete.Cnt_lgc "MICROSAR RTE" /begin REF_MEASUREMENT Rte_BkCpPc_PwrDiscBTestComplete_Cnt_lgc /end REF_MEASUREMENT /end GROUP
/begin GROUP HwPwUp.PwrDiscBTestStart.Cnt_lgc "MICROSAR RTE" /begin REF_MEASUREMENT Rte_HwPwUp_PwrDiscBTestStart_Cnt_lgc /end REF_MEASUREMENT /end GROUP
/begin GROUP HwPwUp.SystemState.Mode "MICROSAR RTE" /begin REF_MEASUREMENT Rte_ModeMachine_StaMd_SystemState_Mode /end REF_MEASUREMENT /end GROUP
/begin GROUP HystComp.AssistMechTempEst.DegC_f32 "MICROSAR RTE" /begin REF_MEASUREMENT Rte_MtrTempEst_AssistMechTempEst_DegC_f32 /end REF_MEASUREMENT /end GROUP
/begin GROUP HystComp.BaseAssistCmd.MtrNm_f32 "MICROSAR RTE" /begin REF_MEASUREMENT Rte_Assist_BaseAssistCmd_MtrNm_f32 /end REF_MEASUREMENT /end GROUP
/begin GROUP HystComp.DefeatHystService.Cnt_lgc "MICROSAR RTE" /begin REF_MEASUREMENT Rte_CDDInterface_HystCompSrlComSvcDft_Cnt_lgc /end REF_MEASUREMENT /end GROUP
/begin GROUP HystComp.FricOffset.HwNm_f32 "MICROSAR RTE" /begin REF_MEASUREMENT Rte_AvgFricLrn_FricOffset_HwNm_f32 /end REF_MEASUREMENT /end GROUP
/begin GROUP HystComp.HwTorque.HwNm_f32 "MICROSAR RTE" /begin REF_MEASUREMENT Rte_Sweep_OutputHwTrq_HwNm_f32 /end REF_MEASUREMENT /end GROUP
/begin GROUP HystComp.HysteresisComp.MtrNm_f32 "MICROSAR RTE" /begin REF_MEASUREMENT Rte_HystComp_HysteresisComp_MtrNm_f32 /end REF_MEASUREMENT /end GROUP
/begin GROUP HystComp.VehicleSpeed.Kph_f32 "MICROSAR RTE" /begin REF_MEASUREMENT Rte_SignlCondn_VehicleSpeed_Kph_f32 /end REF_MEASUREMENT /end GROUP
/begin GROUP IoHwAbstractionUsr.Batt.Volt_f32 "MICROSAR RTE" /begin REF_MEASUREMENT Rte_IoHwAbstractionUsr_Batt_Volt_f32 /end REF_MEASUREMENT /end GROUP
/begin GROUP IoHwAbstractionUsr.BattSwitched.Volt_f32 "MICROSAR RTE" /begin REF_MEASUREMENT Rte_IoHwAbstractionUsr_BattSwitched_Volt_f32 /end REF_MEASUREMENT /end GROUP
/begin GROUP IoHwAbstractionUsr.SysCVSwitch.Volt_f32 "MICROSAR RTE" /begin REF_MEASUREMENT Rte_IoHwAbstractionUsr_SysCVSwitch_Volt_f32 /end REF_MEASUREMENT /end GROUP
/begin GROUP LmtCod.EOTGainLtd.Uls_f32 "MICROSAR RTE" /begin REF_MEASUREMENT Rte_LmtCod_EOTGainLtd_Uls_f32 /end REF_MEASUREMENT /end GROUP
/begin GROUP LmtCod.EOTLimitLtd.MtrNm_f32 "MICROSAR RTE" /begin REF_MEASUREMENT Rte_LmtCod_EOTLimitLtd_MtrNm_f32 /end REF_MEASUREMENT /end GROUP
/begin GROUP LmtCod.OutputRampMultLtd.Uls_f32 "MICROSAR RTE" /begin REF_MEASUREMENT Rte_LmtCod_OutputRampMultLtd_Uls_f32 /end REF_MEASUREMENT /end GROUP
/begin GROUP LmtCod.StallLimitLtd.MtrNm_f32 "MICROSAR RTE" /begin REF_MEASUREMENT Rte_LmtCod_StallLimitLtd_MtrNm_f32 /end REF_MEASUREMENT /end GROUP
/begin GROUP LmtCod.ThermalLimitLtd.MtrNm_f32 "MICROSAR RTE" /begin REF_MEASUREMENT Rte_LmtCod_ThermalLimitLtd_MtrNm_f32 /end REF_MEASUREMENT /end GROUP
/begin GROUP LmtCod.VehSpdLimitLtd.MtrNm_f32 "MICROSAR RTE" /begin REF_MEASUREMENT Rte_LmtCod_VehSpdLimitLtd_MtrNm_f32 /end REF_MEASUREMENT /end GROUP
/begin GROUP LmtCod.VehicleSpeed.Kph_f32 "MICROSAR RTE" /begin REF_MEASUREMENT Rte_SignlCondn_VehicleSpeed_Kph_f32 /end REF_MEASUREMENT /end GROUP
/begin GROUP LrnEOT.DiagStsHwPosDis.Cnt_lgc "MICROSAR RTE" /begin REF_MEASUREMENT Rte_DiagMgr10_DiagStsHWASbSystmFltPres_Cnt_lgc /end REF_MEASUREMENT /end GROUP
/begin GROUP LrnEOT.HandwheelAuthority.Uls_f32 "MICROSAR RTE" /begin REF_MEASUREMENT Rte_AbsHwPos_HandwheelAuthority_Uls_f32 /end REF_MEASUREMENT /end GROUP
/begin GROUP LrnEOT.HandwheelPosition.HwDeg_f32 "MICROSAR RTE" /begin REF_MEASUREMENT Rte_AbsHwPos_HandwheelPosition_HwDeg_f32 /end REF_MEASUREMENT /end GROUP
/begin GROUP LrnEOT.HwTorque.HwNm_f32 "MICROSAR RTE" /begin REF_MEASUREMENT Rte_Sweep_OutputHwTrq_HwNm_f32 /end REF_MEASUREMENT /end GROUP
/begin GROUP MtrDrvDiag.SystemState.Mode "MICROSAR RTE" /begin REF_MEASUREMENT Rte_ModeMachine_StaMd_SystemState_Mode /end REF_MEASUREMENT /end GROUP
/begin GROUP MtrTempEst.AssistMechTempEst.DegC_f32 "MICROSAR RTE" /begin REF_MEASUREMENT Rte_MtrTempEst_AssistMechTempEst_DegC_f32 /end REF_MEASUREMENT /end GROUP
/begin GROUP MtrTempEst.HwVel.HwRadpS_f32 "MICROSAR RTE" /begin REF_MEASUREMENT Rte_MtrVel_HandwheelVel_HwRadpS_f32 /end REF_MEASUREMENT /end GROUP
/begin GROUP MtrVel.HandwheelVel.HwRadpS_f32 "MICROSAR RTE" /begin REF_MEASUREMENT Rte_MtrVel_HandwheelVel_HwRadpS_f32 /end REF_MEASUREMENT /end GROUP
/begin GROUP MtrVel.MechMtrPos2Timestamp.USec_u32 "MICROSAR RTE" /begin REF_MEASUREMENT Rte_CDDInterface_MechMtrPos2TimeStamp_USec_u32 /end REF_MEASUREMENT /end GROUP
/begin GROUP MtrVel.MotorVelMRF.MtrRadpS_f32 "MICROSAR RTE" /begin REF_MEASUREMENT Rte_MtrVel_MotorVelMRF_MtrRadpS_f32 /end REF_MEASUREMENT /end GROUP
/begin GROUP MtrVel2.HandwheelVel.HwRadpS_f32 "MICROSAR RTE" /begin REF_MEASUREMENT Rte_MtrVel_HandwheelVel_HwRadpS_f32 /end REF_MEASUREMENT /end GROUP
/begin GROUP MtrVel2.MechMtrPos1Timestamp.USec_u32 "MICROSAR RTE" /begin REF_MEASUREMENT Rte_CDDInterface_MechMtrPos1TimeStamp_USec_u32 /end REF_MEASUREMENT /end GROUP
/begin GROUP MtrVel2.MotorVelMRF.MtrRadpS_f32 "MICROSAR RTE" /begin REF_MEASUREMENT Rte_MtrVel_MotorVelMRF_MtrRadpS_f32 /end REF_MEASUREMENT /end GROUP
/begin GROUP OvrVoltMon.PwrDiscBTestStart.Cnt_lgc "MICROSAR RTE" /begin REF_MEASUREMENT Rte_HwPwUp_PwrDiscBTestStart_Cnt_lgc /end REF_MEASUREMENT /end GROUP
/begin GROUP OvrVoltMon.SystemState.Mode "MICROSAR RTE" /begin REF_MEASUREMENT Rte_ModeMachine_StaMd_SystemState_Mode /end REF_MEASUREMENT /end GROUP
/begin GROUP PICurrCntrl.CorrMtrPosElec.Rev_f32 "MICROSAR RTE" /begin REF_MEASUREMENT Rte_CDDInterface_CorrMtrPosElec_Rev_f32 /end REF_MEASUREMENT /end GROUP
/begin GROUP PICurrCntrl.MRFMtrVel.MtrRadpS_f32 "MICROSAR RTE" /begin REF_MEASUREMENT Rte_MtrVel_MotorVelMRF_MtrRadpS_f32 /end REF_MEASUREMENT /end GROUP
/begin GROUP PICurrCntrl.SystemState.Mode "MICROSAR RTE" /begin REF_MEASUREMENT Rte_ModeMachine_StaMd_SystemState_Mode /end REF_MEASUREMENT /end GROUP
/begin GROUP PeakCurrEst.MtrCurrDax.Amp_f32 "MICROSAR RTE" /begin REF_MEASUREMENT Rte_CDDInterface_MtrCurrDax_Amp_f32 /end REF_MEASUREMENT /end GROUP
/begin GROUP PeakCurrEst.MtrCurrQax.Amp_f32 "MICROSAR RTE" /begin REF_MEASUREMENT Rte_CDDInterface_MtrCurrQax_Amp_f32 /end REF_MEASUREMENT /end GROUP
/begin GROUP PeakCurrEst.SystemState.Mode "MICROSAR RTE" /begin REF_MEASUREMENT Rte_ModeMachine_StaMd_SystemState_Mode /end REF_MEASUREMENT /end GROUP
/begin GROUP Polarity.DiagMtrElecMechPolarity.Cnt_s08 "MICROSAR RTE" /begin REF_MEASUREMENT Rte_Polarity_MtrElecMechPolarity_Cnt_s08 /end REF_MEASUREMENT /end GROUP
/begin GROUP Polarity.DiagMtrPosPolarity.Cnt_s08 "MICROSAR RTE" /begin REF_MEASUREMENT Rte_Polarity_MtrPosPolarity_Cnt_s08 /end REF_MEASUREMENT /end GROUP
/begin GROUP Polarity.MtrElecMechPolarity.Cnt_s08 "MICROSAR RTE" /begin REF_MEASUREMENT Rte_Polarity_MtrElecMechPolarity_Cnt_s08 /end REF_MEASUREMENT /end GROUP
/begin GROUP Polarity.MtrPosPolarity.Cnt_s08 "MICROSAR RTE" /begin REF_MEASUREMENT Rte_Polarity_MtrPosPolarity_Cnt_s08 /end REF_MEASUREMENT /end GROUP
/begin GROUP PwrLmtFuncCr.FltTrqLmt.Uls_f32 "MICROSAR RTE" /begin REF_MEASUREMENT Rte_PwrLmtFuncCr_FltTrqLmt_Uls_f32 /end REF_MEASUREMENT /end GROUP
/begin GROUP PwrLmtFuncCr.MotorVelMRF.MtrRadpS_f32 "MICROSAR RTE" /begin REF_MEASUREMENT Rte_MtrVel_MotorVelMRF_MtrRadpS_f32 /end REF_MEASUREMENT /end GROUP
/begin GROUP PwrLmtFuncCr.SystemState.Mode "MICROSAR RTE" /begin REF_MEASUREMENT Rte_ModeMachine_StaMd_SystemState_Mode /end REF_MEASUREMENT /end GROUP
/begin GROUP PwrLmtFuncCr.Vecu.Volt_f32 "MICROSAR RTE" /begin REF_MEASUREMENT Rte_BatteryVoltage_Vecu_Volt_f32 /end REF_MEASUREMENT /end GROUP
/begin GROUP Return.AssistMechTempEst.DegC_f32 "MICROSAR RTE" /begin REF_MEASUREMENT Rte_MtrTempEst_AssistMechTempEst_DegC_f32 /end REF_MEASUREMENT /end GROUP
/begin GROUP Return.DefeatReturnSvc.Cnt_lgc "MICROSAR RTE" /begin REF_MEASUREMENT Rte_CDDInterface_ReturnSrlComSvcDft_Cnt_lgc /end REF_MEASUREMENT /end GROUP
/begin GROUP Return.DiagStsHwPosDis.Cnt_lgc "MICROSAR RTE" /begin REF_MEASUREMENT Rte_DiagMgr10_DiagStsHWASbSystmFltPres_Cnt_lgc /end REF_MEASUREMENT /end GROUP
/begin GROUP Return.HandwheelAuthority.Uls_f32 "MICROSAR RTE" /begin REF_MEASUREMENT Rte_AbsHwPos_HandwheelAuthority_Uls_f32 /end REF_MEASUREMENT /end GROUP
/begin GROUP Return.HandwheelPosition.HwDeg_f32 "MICROSAR RTE" /begin REF_MEASUREMENT Rte_AbsHwPos_HandwheelPosition_HwDeg_f32 /end REF_MEASUREMENT /end GROUP
/begin GROUP Return.HandwheelVel.HwRadpS_f32 "MICROSAR RTE" /begin REF_MEASUREMENT Rte_MtrVel_HandwheelVel_HwRadpS_f32 /end REF_MEASUREMENT /end GROUP
/begin GROUP Return.HwTorque.HwNm_f32 "MICROSAR RTE" /begin REF_MEASUREMENT Rte_Sweep_OutputHwTrq_HwNm_f32 /end REF_MEASUREMENT /end GROUP
/begin GROUP Return.VehicleSpeed.Kph_f32 "MICROSAR RTE" /begin REF_MEASUREMENT Rte_SignlCondn_VehicleSpeed_Kph_f32 /end REF_MEASUREMENT /end GROUP
/begin GROUP ReturnFirewall.Defeat_Return_Svc.Cnt_lgc "MICROSAR RTE" /begin REF_MEASUREMENT Rte_CDDInterface_ReturnSrlComSvcDft_Cnt_lgc /end REF_MEASUREMENT /end GROUP
/begin GROUP ReturnFirewall.HandwheelPosition.HwDeg_f32 "MICROSAR RTE" /begin REF_MEASUREMENT Rte_AbsHwPos_HandwheelPosition_HwDeg_f32 /end REF_MEASUREMENT /end GROUP
/begin GROUP ReturnFirewall.LimitedReturn.MtrNm_f32 "MICROSAR RTE" /begin REF_MEASUREMENT Rte_ReturnFirewall_LimitedReturn_MtrNm_f32 /end REF_MEASUREMENT /end GROUP
/begin GROUP ReturnFirewall.MEC_Counter.Cnt_enum "MICROSAR RTE" /begin REF_MEASUREMENT Rte_CDDInterface_MEC_Cnt_enum /end REF_MEASUREMENT /end GROUP
/begin GROUP ReturnFirewall.SystemState.Mode "MICROSAR RTE" /begin REF_MEASUREMENT Rte_ModeMachine_StaMd_SystemState_Mode /end REF_MEASUREMENT /end GROUP
/begin GROUP ReturnFirewall.VehicleSpeed.Kph_f32 "MICROSAR RTE" /begin REF_MEASUREMENT Rte_SignlCondn_VehicleSpeed_Kph_f32 /end REF_MEASUREMENT /end GROUP
/begin GROUP RteErrata.SystemState.Mode "MICROSAR RTE" /begin REF_MEASUREMENT Rte_ModeMachine_StaMd_SystemState_Mode /end REF_MEASUREMENT /end GROUP
/begin GROUP RteErrata9.SystemState.Mode "MICROSAR RTE" /begin REF_MEASUREMENT Rte_ModeMachine_StaMd9_SystemState9_Mode /end REF_MEASUREMENT /end GROUP
/begin GROUP Sa_DigColPs.I2CHwAbsPos.HwDeg_f32 "MICROSAR RTE" /begin REF_MEASUREMENT Rte_Sa_DigColPs_I2CHwAbsPos_HwDeg_f32 /end REF_MEASUREMENT /end GROUP
/begin GROUP Sa_DigColPs.I2CHwAbsPosValid.Cnt_lgc "MICROSAR RTE" /begin REF_MEASUREMENT Rte_Sa_DigColPs_I2CHwAbsPosValid_Cnt_lgc /end REF_MEASUREMENT /end GROUP
/begin GROUP Sa_DigColPs.MecState.Cnt_enum "MICROSAR RTE" /begin REF_MEASUREMENT Rte_CDDInterface_MEC_Cnt_enum /end REF_MEASUREMENT /end GROUP
/begin GROUP SignlCondn.VehicleSpeed.Kph_f32 "MICROSAR RTE" /begin REF_MEASUREMENT Rte_SignlCondn_VehicleSpeed_Kph_f32 /end REF_MEASUREMENT /end GROUP
/begin GROUP SrlComInput.Batt.Volt_f32 "MICROSAR RTE" /begin REF_MEASUREMENT Rte_IoHwAbstractionUsr_Batt_Volt_f32 /end REF_MEASUREMENT /end GROUP
/begin GROUP SrlComInput.MEC.Cnt_enum "MICROSAR RTE" /begin REF_MEASUREMENT Rte_CDDInterface_MEC_Cnt_enum /end REF_MEASUREMENT /end GROUP
/begin GROUP SrlComInput.RxMsgsSrlComSvcDft.Cnt_lgc "MICROSAR RTE" /begin REF_MEASUREMENT Rte_CDDInterface_RxMsgsSrlComSvcDft_Cnt_lgc /end REF_MEASUREMENT /end GROUP
/begin GROUP SrlComInput.SystemState.Mode "MICROSAR RTE" /begin REF_MEASUREMENT Rte_ModeMachine_StaMd9_SystemState9_Mode /end REF_MEASUREMENT /end GROUP
/begin GROUP SrlComOutput.HandwheelAuthority.Uls_f32 "MICROSAR RTE" /begin REF_MEASUREMENT Rte_AbsHwPos_HandwheelAuthority_Uls_f32 /end REF_MEASUREMENT /end GROUP
/begin GROUP SrlComOutput.HandwheelPosition.HwDeg_f32 "MICROSAR RTE" /begin REF_MEASUREMENT Rte_AbsHwPos_SrlComHwPos_HwDeg_f32 /end REF_MEASUREMENT /end GROUP
/begin GROUP SrlComOutput.SrlComHwPosStatus.Cnt_u16 "MICROSAR RTE" /begin REF_MEASUREMENT Rte_AbsHwPos_SrlComHwPosStatus_Cnt_u16 /end REF_MEASUREMENT /end GROUP
/begin GROUP SrlComOutput.SystemState.Mode "MICROSAR RTE" /begin REF_MEASUREMENT Rte_ModeMachine_StaMd9_SystemState9_Mode /end REF_MEASUREMENT /end GROUP
/begin GROUP StaMd.CurrentSystemState.Mode "MICROSAR RTE" /begin REF_MEASUREMENT Rte_ModeMachine_StaMd_SystemState_Mode /end REF_MEASUREMENT /end GROUP
/begin GROUP StaMd.SystemState.Mode "MICROSAR RTE" /begin REF_MEASUREMENT Rte_ModeMachine_StaMd_SystemState_Mode /end REF_MEASUREMENT /end GROUP
/begin GROUP StaMd9.SystemState9.Mode "MICROSAR RTE" /begin REF_MEASUREMENT Rte_ModeMachine_StaMd9_SystemState9_Mode /end REF_MEASUREMENT /end GROUP
/begin GROUP StabilityComp.AssistCmd.MtrNm_f32 "MICROSAR RTE" /begin REF_MEASUREMENT Rte_StabilityComp_AssistCmd_MtrNm_f32 /end REF_MEASUREMENT /end GROUP
/begin GROUP StabilityComp.AsstFWActive.Uls_f32 "MICROSAR RTE" /begin REF_MEASUREMENT Rte_AssistFirewall_AsstFirewallActive_Uls_f32 /end REF_MEASUREMENT /end GROUP
/begin GROUP StabilityComp.CombinedAssist.MtrNm_f32 "MICROSAR RTE" /begin REF_MEASUREMENT Rte_AssistFirewall_CombinedAssist_MtrNm_f32 /end REF_MEASUREMENT /end GROUP
/begin GROUP StabilityComp.HwTorque.HwNm_f32 "MICROSAR RTE" /begin REF_MEASUREMENT Rte_Sweep_OutputHwTrq_HwNm_f32 /end REF_MEASUREMENT /end GROUP
/begin GROUP StabilityComp.VehicleSpeed.Kph_f32 "MICROSAR RTE" /begin REF_MEASUREMENT Rte_SignlCondn_VehicleSpeed_Kph_f32 /end REF_MEASUREMENT /end GROUP
/begin GROUP StabilityComp2.AsstFWActive.Uls_f32 "MICROSAR RTE" /begin REF_MEASUREMENT Rte_AssistFirewall_AsstFirewallActive_Uls_f32 /end REF_MEASUREMENT /end GROUP
/begin GROUP StabilityComp2.CombinedAssist.MtrNm_f32 "MICROSAR RTE" /begin REF_MEASUREMENT Rte_AssistFirewall_CombinedAssist_MtrNm_f32 /end REF_MEASUREMENT /end GROUP
/begin GROUP StabilityComp2.HwTorque.HwNm_f32 "MICROSAR RTE" /begin REF_MEASUREMENT Rte_Sweep_OutputHwTrq_HwNm_f32 /end REF_MEASUREMENT /end GROUP
/begin GROUP StabilityComp2.VehicleSpeed.Kph_f32 "MICROSAR RTE" /begin REF_MEASUREMENT Rte_SignlCondn_VehicleSpeed_Kph_f32 /end REF_MEASUREMENT /end GROUP
/begin GROUP Sweep.OutputHwTrq.HwNm_f32 "MICROSAR RTE" /begin REF_MEASUREMENT Rte_Sweep_OutputHwTrq_HwNm_f32 /end REF_MEASUREMENT /end GROUP
/begin GROUP Sweep.VehSpd.Kph_f32 "MICROSAR RTE" /begin REF_MEASUREMENT Rte_SignlCondn_VehicleSpeed_Kph_f32 /end REF_MEASUREMENT /end GROUP
/begin GROUP Sweep.VehSpdValid.Cnt_lgc "MICROSAR RTE" /begin REF_MEASUREMENT Rte_SrlComInput_VehicleSpeedValid_Cnt_lgc /end REF_MEASUREMENT /end GROUP
/begin GROUP Sweep2.InputMtrTrq.MtrNm_f32 "MICROSAR RTE" /begin REF_MEASUREMENT Rte_AstLmt_SumLimTrqCmd_MtrNm_f32 /end REF_MEASUREMENT /end GROUP
/begin GROUP ThrmlDutyCycle.DutyCycleLevel.Uls_f32 "MICROSAR RTE" /begin REF_MEASUREMENT Rte_ThrmlDutyCycle_DutyCycleLevel_Uls_f32 /end REF_MEASUREMENT /end GROUP
/begin GROUP ThrmlDutyCycle.ThermLimitPerc.Uls_f32 "MICROSAR RTE" /begin REF_MEASUREMENT Rte_ThrmlDutyCycle_ThermLimitPerc_Uls_f32 /end REF_MEASUREMENT /end GROUP
/begin GROUP TmprlMon.SystemState.Mode "MICROSAR RTE" /begin REF_MEASUREMENT Rte_ModeMachine_StaMd_SystemState_Mode /end REF_MEASUREMENT /end GROUP
/begin GROUP TqRsDg.SystemState.Mode "MICROSAR RTE" /begin REF_MEASUREMENT Rte_ModeMachine_StaMd_SystemState_Mode /end REF_MEASUREMENT /end GROUP
/begin GROUP TqRsDg.TrqLimitMin.MtrNm_f32 "MICROSAR RTE" /begin REF_MEASUREMENT Rte_AstLmt_TrqLimitMin_MtrNm_f32 /end REF_MEASUREMENT /end GROUP
/begin GROUP TrqCanc.MRFMtrVel.MtrRadpS_f32 "MICROSAR RTE" /begin REF_MEASUREMENT Rte_MtrVel_MotorVelMRF_MtrRadpS_f32 /end REF_MEASUREMENT /end GROUP
/begin GROUP TuningSelAuth.ActiveTunOvrPtrAddr.Cnt_u32 "MICROSAR RTE" /begin REF_MEASUREMENT Rte_ApXcp_ActiveTunOvrPtrAddr_Cnt_u32 /end REF_MEASUREMENT /end GROUP
/begin GROUP TuningSelAuth.ActiveTunPers.Cnt_u16 "MICROSAR RTE" /begin REF_MEASUREMENT Rte_TuningSelAuth_ActiveTunPers_Cnt_u16 /end REF_MEASUREMENT /end GROUP
/begin GROUP TuningSelAuth.ActiveTunSet.Cnt_u16 "MICROSAR RTE" /begin REF_MEASUREMENT Rte_TuningSelAuth_ActiveTunSet_Cnt_u16 /end REF_MEASUREMENT /end GROUP
/begin GROUP TuningSelAuth.DesiredTunSet.Cnt_u16 "MICROSAR RTE" /begin REF_MEASUREMENT Rte_DiagSvc_DesiredTunSet_Cnt_u16 /end REF_MEASUREMENT /end GROUP
/begin GROUP TuningSelAuth.HwTorque.HwNm_f32 "MICROSAR RTE" /begin REF_MEASUREMENT Rte_Sweep_OutputHwTrq_HwNm_f32 /end REF_MEASUREMENT /end GROUP
/begin GROUP TuningSelAuth.VehicleSpeed.Kph_f32 "MICROSAR RTE" /begin REF_MEASUREMENT Rte_SignlCondn_VehicleSpeed_Kph_f32 /end REF_MEASUREMENT /end GROUP
/begin GROUP VehDyn.HandwheelPosition.HwDeg_f32 "MICROSAR RTE" /begin REF_MEASUREMENT Rte_AbsHwPos_HandwheelPosition_HwDeg_f32 /end REF_MEASUREMENT /end GROUP
/begin GROUP VehDyn.HwAuth.Uls_f32 "MICROSAR RTE" /begin REF_MEASUREMENT Rte_AbsHwPos_HandwheelAuthority_Uls_f32 /end REF_MEASUREMENT /end GROUP
/begin GROUP VehDyn.HwTorque.HwNm_f32 "MICROSAR RTE" /begin REF_MEASUREMENT Rte_Sweep_OutputHwTrq_HwNm_f32 /end REF_MEASUREMENT /end GROUP
/begin GROUP VehDyn.MechMtrPos.Rev_f32 "MICROSAR RTE" /begin REF_MEASUREMENT Rte_CDDInterface_MechMtrPos1_Rev_f32 /end REF_MEASUREMENT /end GROUP
/begin GROUP VehDyn.RelHwPos.HwDeg_f32 "MICROSAR RTE" /begin REF_MEASUREMENT Rte_AbsHwPos_RelHwPos_HwDeg_f32 /end REF_MEASUREMENT /end GROUP
/begin GROUP VehDyn.SensorlessAuthority.Uls_f32 "MICROSAR RTE" /begin REF_MEASUREMENT Rte_VehDyn_SensorlessAuthority_Uls_f32 /end REF_MEASUREMENT /end GROUP
/begin GROUP VehDyn.SensorlessHwPos.HwDeg_f32 "MICROSAR RTE" /begin REF_MEASUREMENT Rte_VehDyn_SensorlessHwPos_HwDeg_f32 /end REF_MEASUREMENT /end GROUP
/begin GROUP VehDyn.SystemState.Mode "MICROSAR RTE" /begin REF_MEASUREMENT Rte_ModeMachine_StaMd_SystemState_Mode /end REF_MEASUREMENT /end GROUP
/begin GROUP VehDyn.TorqueCmdCRF.MtrNm_f32 "MICROSAR RTE" /begin REF_MEASUREMENT Rte_CtrldDisShtdn_CntDisMtrTrqCmdCRF_MtrNm_f32 /end REF_MEASUREMENT /end GROUP
/begin GROUP VehDyn.VehicleSpeed.Kph_f32 "MICROSAR RTE" /begin REF_MEASUREMENT Rte_SignlCondn_VehicleSpeed_Kph_f32 /end REF_MEASUREMENT /end GROUP
/begin GROUP VehDyn.VehicleSpeedValid.Cnt_lgc "MICROSAR RTE" /begin REF_MEASUREMENT Rte_SrlComInput_VehicleSpeedValid_Cnt_lgc /end REF_MEASUREMENT /end GROUP
/begin GROUP VehPwrMd.EngONSrlComSvcDft.Cnt_lgc "MICROSAR RTE" /begin REF_MEASUREMENT Rte_CDDInterface_EngONSrlComSvcDft_Cnt_lgc /end REF_MEASUREMENT /end GROUP
/begin GROUP VehPwrMd.MEC.Cnt_enum "MICROSAR RTE" /begin REF_MEASUREMENT Rte_CDDInterface_MEC_Cnt_enum /end REF_MEASUREMENT /end GROUP
/begin GROUP VehPwrMd.SystemState.Mode "MICROSAR RTE" /begin REF_MEASUREMENT Rte_ModeMachine_StaMd9_SystemState9_Mode /end REF_MEASUREMENT /end GROUP
/begin GROUP VehPwrMd.VehicleSpeed.Kph_f32 "MICROSAR RTE" /begin REF_MEASUREMENT Rte_SignlCondn_VehicleSpeed_Kph_f32 /end REF_MEASUREMENT /end GROUP
/begin GROUP VehSpdLmt.HwPos.HwDeg_f32 "MICROSAR RTE" /begin REF_MEASUREMENT Rte_AbsHwPos_HandwheelPosition_HwDeg_f32 /end REF_MEASUREMENT /end GROUP
/begin GROUP VehSpdLmt.HwPosAuth.Uls_f32 "MICROSAR RTE" /begin REF_MEASUREMENT Rte_AbsHwPos_HandwheelAuthority_Uls_f32 /end REF_MEASUREMENT /end GROUP
/begin GROUP VehSpdLmt.VehSpd.Kph_f32 "MICROSAR RTE" /begin REF_MEASUREMENT Rte_SignlCondn_VehicleSpeed_Kph_f32 /end REF_MEASUREMENT /end GROUP
/begin GROUP ePWM2.SystemState.Mode "MICROSAR RTE" /begin REF_MEASUREMENT Rte_ModeMachine_StaMd_SystemState_Mode /end REF_MEASUREMENT /end GROUP
/**********************************************************************************************************************
* RECORD_LAYOUT
*********************************************************************************************************************/
/begin RECORD_LAYOUT RTE_RL_UBYTE FNC_VALUES 1 UBYTE ROW_DIR DIRECT /end RECORD_LAYOUT
/begin RECORD_LAYOUT RTE_RL_UWORD FNC_VALUES 1 UWORD ROW_DIR DIRECT /end RECORD_LAYOUT
/**********************************************************************************************************************
* COMPU_METHOD / COMPU_VTAB_RANGE
*********************************************************************************************************************/
/begin COMPU_METHOD RTE_CM_BOOLEAN "" TAB_VERB "%3.1" "" COMPU_TAB_REF RTE_CM_BOOLEAN /end COMPU_METHOD
/begin COMPU_VTAB_RANGE RTE_CM_BOOLEAN "" 2 0 0 "false" 1 255 "true" /end COMPU_VTAB_RANGE
/begin COMPU_METHOD RTE_CM_ENUM_ManufModeType "" TAB_VERB "%.1" "" COMPU_TAB_REF RTE_CM_ENUM_ManufModeType /end COMPU_METHOD
/begin COMPU_VTAB_RANGE RTE_CM_ENUM_ManufModeType "" 3 0 0 "ProductionMode" 1 1 "ManufacturingMode" 2 2 "EngineeringMode" /end COMPU_VTAB_RANGE
/begin COMPU_METHOD RTE_CM_ENUM_StaMd_Mode "" TAB_VERB "%.1" "" COMPU_TAB_REF RTE_CM_ENUM_StaMd_Mode /end COMPU_METHOD
/begin COMPU_VTAB_RANGE RTE_CM_ENUM_StaMd_Mode "" 5 0 0 "RTE_MODE_StaMd_Mode_DISABLE" 1 1 "RTE_MODE_StaMd_Mode_OFF" 2 2 "RTE_MODE_StaMd_Mode_OPERATE" 3 3 "RTE_MODE_StaMd_Mode_WARMINIT" 4 4 "RTE_TRANSITION_StaMd_Mode" /end COMPU_VTAB_RANGE
